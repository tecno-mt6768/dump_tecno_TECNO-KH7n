/dts-v1/;

/ {

	__fixups__ {
		accdet = "/fragment@12:target:0";
		auxadc = "/fragment@28/__overlay__:io-channels:0", "/fragment@31:target:0", "/fragment@32/__overlay__:io-channels:0";
		charger = "/fragment@29:target:0";
		chosen = "/fragment@1:target:0";
		consys = "/fragment@18:target:0";
		dsi_te = "/fragment@50:target:0";
		extcon_usb = "/fragment@28:target:0";
		goodix_fp = "/fragment@47:target:0";
		gpio = "/fragment@44:target:0";
		gpio_usage_mapping = "/fragment@43:target:0";
		i2c0 = "/fragment@34:target:0";
		i2c1 = "/fragment@35:target:0";
		i2c2 = "/fragment@8:target:0", "/fragment@36:target:0";
		i2c3 = "/fragment@37:target:0";
		i2c4 = "/fragment@38:target:0";
		i2c5 = "/fragment@2:target:0", "/fragment@39:target:0";
		i2c6 = "/fragment@40:target:0";
		i2c7 = "/fragment@20:target:0", "/fragment@41:target:0";
		i2c8 = "/fragment@42:target:0";
		irtx_pwm = "/fragment@21:target:0";
		kd_camera_hw1 = "/fragment@6:target:0", "/fragment@7:target:0", "/fragment@60:target:0", "/fragment@64:target:0";
		keypad = "/fragment@13:target:0", "/fragment@62:target:0";
		lk_charger = "/fragment@30:target:0";
		main_pmic = "/fragment@6/__overlay__:pmic:0", "/fragment@7/__overlay__:pmic:0", "/fragment@51:target:0";
		md1_sim1_hot_plug_eint = "/fragment@52:target:0";
		md_auxadc = "/fragment@32:target:0";
		msdc1_ins = "/fragment@46:target:0";
		mt6370_pmu = "/fragment@15:target:0";
		mt6370_typec = "/fragment@16:target:0";
		mt_charger = "/fragment@28/__overlay__:charger:0";
		mt_pmic_vcama1_ldo_reg = "/fragment@53:target:0";
		mt_pmic_vcama2_ldo_reg = "/fragment@54:target:0", "/fragment@60/__overlay__:vcama_main2-supply:0", "/fragment@60/__overlay__:vcama_sub2-supply:0", "/fragment@64/__overlay__:cam2_vcama-supply:0", "/fragment@64/__overlay__:cam3_vcama-supply:0";
		mt_pmic_vcamd_ldo_reg = "/fragment@57:target:0", "/fragment@60/__overlay__:vcamd-supply:0", "/fragment@60/__overlay__:vcamd_sub-supply:0", "/fragment@64/__overlay__:cam0_vcamd-supply:0", "/fragment@64/__overlay__:cam1_vcamd-supply:0";
		mt_pmic_vcamio_ldo_reg = "/fragment@58:target:0", "/fragment@60/__overlay__:vcamio-supply:0", "/fragment@60/__overlay__:vcamio_sub-supply:0", "/fragment@60/__overlay__:vcamio_main2-supply:0", "/fragment@64/__overlay__:cam0_vcamio-supply:0", "/fragment@64/__overlay__:cam1_vcamio-supply:0", "/fragment@64/__overlay__:cam2_vcamio-supply:0";
		mt_pmic_vldo28_ldo_reg = "/fragment@3/__overlay__/camera_af_hw_node:camaf_m1_pmic-supply:0", "/fragment@59:target:0", "/fragment@60/__overlay__:vcamaf-supply:0", "/fragment@61/__overlay__:vtouch-supply:0", "/fragment@64/__overlay__:cam0_vcamaf-supply:0";
		mt_pmic_vsim1_ldo_reg = "/fragment@55:target:0";
		mt_pmic_vsim2_ldo_reg = "/fragment@56:target:0";
		mtkfb = "/fragment@24:target:0";
		odm = "/fragment@3:target:0", "/fragment@27:target:0";
		pio = "/fragment@2/__overlay__/sgm41516d@6B:sgm41516d,intr_gpio:0", "/fragment@2/__overlay__/sgm41516d@6B:led_ctl_gpio:0", "/fragment@3/__overlay__/tran_audio:fs_extamp_gpio:0", "/fragment@3/__overlay__/fingerprint:interrupt-parent:0", "/fragment@4/__overlay__/fingerprint@0:interrupt-parent:0", "/fragment@4/__overlay__/fingerprint@0:irq-gpio-std:0", "/fragment@4/__overlay__/fingerprint@0:reset-gpio-std:0", "/fragment@5:target:0", "/fragment@6/__overlay__:camera_input_gpio:0", "/fragment@7/__overlay__:camera_input_gpio:0", "/fragment@10:target:0", "/fragment@14:target:0", "/fragment@15/__overlay__:mt6370,intr_gpio:0", "/fragment@16/__overlay__:mt6370pd,intr_gpio:0", "/fragment@17:target:0", "/fragment@19:target:0", "/fragment@19/__overlay__/nfc:gpio-rst-std:0", "/fragment@19/__overlay__/nfc:gpio-irq-std:0", "/fragment@19/__overlay__/irq_nfc:interrupt-parent:0", "/fragment@20/__overlay__/nfc_nxp@28:nxp,pn544-irq:0", "/fragment@20/__overlay__/nfc_nxp@28:nxp,pn544-ven:0", "/fragment@20/__overlay__/nfc_nxp@28:nxp,pn544-fw-dwnld:0", "/fragment@22:target:0", "/fragment@23:target:0", "/fragment@25:target:0", "/fragment@27/__overlay__/otg_iddig:interrupt-parent:0", "/fragment@27/__overlay__/otg_iddig:deb-gpios:0", "/fragment@28/__overlay__:id-gpios:0", "/fragment@43/__overlay__:GPIO_SIM1_HOT_PLUG:0", "/fragment@43/__overlay__:GPIO_FDD_BAND_SUPPORT_DETECT_1ST_PIN:0", "/fragment@43/__overlay__:GPIO_FDD_BAND_SUPPORT_DETECT_2ND_PIN:0", "/fragment@43/__overlay__:GPIO_FDD_BAND_SUPPORT_DETECT_3RD_PIN:0", "/fragment@43/__overlay__:GPIO_SIM2_SIO:0", "/fragment@43/__overlay__:GPIO_SIM2_SRST:0", "/fragment@43/__overlay__:GPIO_SIM2_SCLK:0", "/fragment@43/__overlay__:GPIO_SIM1_SCLK:0", "/fragment@43/__overlay__:GPIO_SIM1_SRST:0", "/fragment@43/__overlay__:GPIO_SIM1_SIO:0", "/fragment@45/__overlay__:interrupt-parent:0", "/fragment@46/__overlay__:interrupt-parent:0", "/fragment@46/__overlay__:deb-gpios:0", "/fragment@47/__overlay__:interrupt-parent:0", "/fragment@48/__overlay__:interrupt-parent:0", "/fragment@49/__overlay__:interrupt-parent:0", "/fragment@50/__overlay__:interrupt-parent:0", "/fragment@51/__overlay__:interrupt-parent:0", "/fragment@63:target:0", "/fragment@65:target:0";
		pmic_clock_buffer_ctrl = "/fragment@33:target:0";
		reserved_memory = "/fragment@0:target:0";
		rt9465_slave_chr = "/fragment@49:target:0";
		spi0 = "/fragment@4:target:0";
		spi2 = "/fragment@11:target:0";
		subpmic_pmu_eint = "/fragment@48:target:0";
		touch = "/fragment@9:target:0", "/fragment@45:target:0", "/fragment@61:target:0";
		u2port0 = "/fragment@26:target:0";
	};

	__local_fixups__ {

		fragment@13 {

			__overlay__ {
				pinctrl-0 = <0x0>;
			};
		};

		fragment@18 {

			__overlay__ {
				pinctrl-0 = <0x0>;
				pinctrl-1 = <0x0>;
				pinctrl-2 = <0x0>;
				pinctrl-3 = <0x0>;
			};
		};

		fragment@21 {

			__overlay__ {
				pinctrl-0 = <0x0>;
				pinctrl-1 = <0x0>;
			};
		};

		fragment@24 {

			__overlay__ {
				pinctrl-0 = <0x0>;
				pinctrl-1 = <0x0>;
				pinctrl-2 = <0x0>;
				pinctrl-3 = <0x0>;
				pinctrl-4 = <0x0>;
				pinctrl-5 = <0x0>;
				pinctrl-6 = <0x0>;
			};
		};

		fragment@27 {

			__overlay__ {

				tran_battery {
					pinctrl-0 = <0x0>;
					pinctrl-1 = <0x0>;
					pinctrl-2 = <0x0>;
					pinctrl-3 = <0x0>;
					pinctrl-4 = <0x0>;
					pinctrl-5 = <0x0>;
				};
			};
		};

		fragment@3 {

			__overlay__ {

				fingerprint {
					pinctrl-0 = <0x0>;
					pinctrl-1 = <0x0>;
					pinctrl-2 = <0x0>;
					pinctrl-3 = <0x0>;
					pinctrl-4 = <0x0>;
				};

				flashlights_ocp81375 {
					pinctrl-0 = <0x0>;
					pinctrl-1 = <0x0>;
					pinctrl-2 = <0x0>;
				};
			};
		};

		fragment@4 {

			__overlay__ {

				fingerprint@0 {
					pinctrl-0 = <0x0>;
					pinctrl-1 = <0x0>;
					pinctrl-2 = <0x0>;
					pinctrl-3 = <0x0>;
					pinctrl-4 = <0x0>;
				};
			};
		};

		fragment@64 {

			__overlay__ {
				pinctrl-0 = <0x0>;
				pinctrl-1 = <0x0>;
				pinctrl-10 = <0x0>;
				pinctrl-11 = <0x0>;
				pinctrl-12 = <0x0>;
				pinctrl-13 = <0x0>;
				pinctrl-14 = <0x0>;
				pinctrl-15 = <0x0>;
				pinctrl-16 = <0x0>;
				pinctrl-17 = <0x0>;
				pinctrl-18 = <0x0>;
				pinctrl-19 = <0x0>;
				pinctrl-2 = <0x0>;
				pinctrl-20 = <0x0>;
				pinctrl-21 = <0x0>;
				pinctrl-22 = <0x0>;
				pinctrl-23 = <0x0>;
				pinctrl-24 = <0x0>;
				pinctrl-25 = <0x0>;
				pinctrl-26 = <0x0>;
				pinctrl-27 = <0x0>;
				pinctrl-28 = <0x0>;
				pinctrl-29 = <0x0>;
				pinctrl-3 = <0x0>;
				pinctrl-30 = <0x0>;
				pinctrl-31 = <0x0>;
				pinctrl-32 = <0x0>;
				pinctrl-33 = <0x0>;
				pinctrl-34 = <0x0>;
				pinctrl-35 = <0x0>;
				pinctrl-36 = <0x0>;
				pinctrl-37 = <0x0>;
				pinctrl-38 = <0x0>;
				pinctrl-39 = <0x0>;
				pinctrl-4 = <0x0>;
				pinctrl-40 = <0x0>;
				pinctrl-5 = <0x0>;
				pinctrl-6 = <0x0>;
				pinctrl-7 = <0x0>;
				pinctrl-8 = <0x0>;
				pinctrl-9 = <0x0>;
			};
		};

		fragment@9 {

			__overlay__ {
				pinctrl-0 = <0x0>;
				pinctrl-1 = <0x0>;
				pinctrl-2 = <0x0>;
				pinctrl-3 = <0x0>;
				pinctrl-4 = <0x0>;
				pinctrl-5 = <0x0>;
			};
		};
	};

	__symbols__ {
		camera0_mclk_2mA = "/fragment@63/__overlay__/camera0_mclk_2mA@gpio100";
		camera0_mclk_4mA = "/fragment@63/__overlay__/camera0_mclk_4mA@gpio100";
		camera0_mclk_6mA = "/fragment@63/__overlay__/camera0_mclk_6mA@gpio100";
		camera0_mclk_8mA = "/fragment@63/__overlay__/camera0_mclk_8mA@gpio100";
		camera0_mclk_off = "/fragment@63/__overlay__/camera0_mclk_gpio_mode@gpio100";
		camera0_pdn_high = "/fragment@63/__overlay__/camera0_pdn_output_high@gpio98";
		camera0_pdn_low = "/fragment@63/__overlay__/camera0_pdn_output_low@gpio98";
		camera0_rst_high = "/fragment@63/__overlay__/camera0_rst_output_high@gpio102";
		camera0_rst_low = "/fragment@63/__overlay__/camera0_rst_output_low@gpio102";
		camera0_vcama_off = "/fragment@63/__overlay__/camera0_vcama_output_low@gpio23";
		camera0_vcama_on = "/fragment@63/__overlay__/camera0_vcama_output_high@gpio23";
		camera1_mclk_2mA = "/fragment@63/__overlay__/camera1_mclk_2mA@gpio99";
		camera1_mclk_4mA = "/fragment@63/__overlay__/camera1_mclk_4mA@gpio99";
		camera1_mclk_6mA = "/fragment@63/__overlay__/camera1_mclk_6mA@gpio99";
		camera1_mclk_8mA = "/fragment@63/__overlay__/camera1_mclk_8mA@gpio99";
		camera1_mclk_off = "/fragment@63/__overlay__/camera1_mclk_gpio_mode@gpio99";
		camera1_pdn_high = "/fragment@63/__overlay__/camera1_pdn_output_high@gpio97";
		camera1_pdn_low = "/fragment@63/__overlay__/camera1_pdn_output_low@gpio97";
		camera1_rst_high = "/fragment@63/__overlay__/camera1_rst_output_high@gpio101";
		camera1_rst_low = "/fragment@63/__overlay__/camera1_rst_output_low@gpio101";
		camera1_vcama_off = "/fragment@63/__overlay__/camera1_vcama_output_low@gpio23";
		camera1_vcama_on = "/fragment@63/__overlay__/camera1_vcama_output_high@gpio23";
		camera2_mclk_2mA = "/fragment@63/__overlay__/camera2_mclk_2mA@gpio111";
		camera2_mclk_4mA = "/fragment@63/__overlay__/camera2_mclk_4mA@gpio111";
		camera2_mclk_6mA = "/fragment@63/__overlay__/camera2_mclk_6mA@gpio111";
		camera2_mclk_8mA = "/fragment@63/__overlay__/camera2_mclk_8mA@gpio111";
		camera2_mclk_off = "/fragment@63/__overlay__/camera2_mclk_gpio_mode@gpio111";
		camera2_pdn_high = "/fragment@63/__overlay__/camera2_pdn_output_high@gpio110";
		camera2_pdn_low = "/fragment@63/__overlay__/camera2_pdn_output_low@gpio110";
		camera2_rst_high = "/fragment@63/__overlay__/camera2_rst_output_high@gpio112";
		camera2_rst_low = "/fragment@63/__overlay__/camera2_rst_output_low@gpio112";
		camera3_mclk_2mA = "/fragment@63/__overlay__/camera3_mclk_2mA@gpio108";
		camera3_mclk_4mA = "/fragment@63/__overlay__/camera3_mclk_4mA@gpio108";
		camera3_mclk_6mA = "/fragment@63/__overlay__/camera3_mclk_6mA@gpio108";
		camera3_mclk_8mA = "/fragment@63/__overlay__/camera3_mclk_8mA@gpio108";
		camera3_mclk_off = "/fragment@63/__overlay__/camera3_mclk_gpio_mode@gpio108";
		camera3_pdn_high = "/fragment@63/__overlay__/camera3_pdn_output_high@gpio107";
		camera3_pdn_low = "/fragment@63/__overlay__/camera3_pdn_output_low@gpio107";
		camera3_rst_high = "/fragment@63/__overlay__/camera3_rst_output_high@gpio107";
		camera3_rst_low = "/fragment@63/__overlay__/camera3_rst_output_low@gpio107";
		camera_af_hw_node = "/fragment@3/__overlay__/camera_af_hw_node";
		camera_main_af_mtk = "/fragment@38/__overlay__/camera_main_af@0c";
		camera_main_eeprom_mtk = "/fragment@38/__overlay__/camera_main_eeprom@50";
		camera_main_mtk = "/fragment@38/__overlay__/camera_main@1a";
		camera_main_two_mtk = "/fragment@37/__overlay__/camera_main_two@10";
		camera_pins_default = "/fragment@63/__overlay__/camdefault";
		camera_sub_eeprom_mtk = "/fragment@37/__overlay__/camera_sub_eeprom@51";
		camera_sub_mtk = "/fragment@37/__overlay__/camera_sub@2d";
		ccu_sensor_i2c_2_hw_mtk = "/fragment@36/__overlay__/ccu_sensor_i2c_2_hw@11";
		ccu_sensor_i2c_4_hw_mtk = "/fragment@38/__overlay__/ccu_sensor_i2c_4_hw@12";
		consys_pins_default = "/fragment@17/__overlay__/consys_default";
		ctp_pins_default = "/fragment@10/__overlay__/eint0default";
		ctp_pins_eint_as_int = "/fragment@10/__overlay__/ctp_eint@1";
		ctp_pins_eint_output0 = "/fragment@10/__overlay__/eintoutput0";
		ctp_pins_eint_output1 = "/fragment@10/__overlay__/eintoutput1";
		ctp_pins_rst_output0 = "/fragment@10/__overlay__/rstoutput0";
		ctp_pins_rst_output1 = "/fragment@10/__overlay__/rstoutput1";
		fingerprint = "/fragment@3/__overlay__/fingerprint";
		fingerprint_default = "/fragment@5/__overlay__/fingerprint_default";
		fingerprint_eint = "/fragment@5/__overlay__/gpio7_eint";
		fingerprint_eint_pull_down = "/fragment@5/__overlay__/gpio7_eint_pull_down";
		fingerprint_rst_one = "/fragment@5/__overlay__/rst_out_one";
		fingerprint_rst_zero = "/fragment@5/__overlay__/rst_out_zero";
		flashlights_ocp81375 = "/fragment@3/__overlay__/flashlights_ocp81375";
		flashlights_ocp81375_pins_default = "/fragment@65/__overlay__/ocp81375default";
		flashlights_ocp81375_pins_hwen_high = "/fragment@65/__overlay__/ocp81375hwen_high";
		flashlights_ocp81375_pins_hwen_low = "/fragment@65/__overlay__/ocp81375hwen_low";
		gpio178_otg = "/fragment@25/__overlay__/otg_init";
		gpio178_otg_high = "/fragment@25/__overlay__/otg_high";
		gpio178_otg_low = "/fragment@25/__overlay__/otg_low";
		gpio8_meta = "/fragment@25/__overlay__/meta_init";
		gpio8_meta_high = "/fragment@25/__overlay__/meta_high";
		gpio8_meta_low = "/fragment@25/__overlay__/meta_low";
		gpslna_pins_init = "/fragment@17/__overlay__/gpslna@0";
		gpslna_pins_oh = "/fragment@17/__overlay__/gpslna@1";
		gpslna_pins_ol = "/fragment@17/__overlay__/gpslna@2";
		i2c_lcd_bias_mtk = "/fragment@40/__overlay__/i2c_lcd_bias@3e";
		irq_nfc = "/fragment@19/__overlay__/irq_nfc";
		irtx_gpio_led_default = "/fragment@22/__overlay__/irtx_gpio_led_def@gpio12";
		irtx_gpio_led_set = "/fragment@22/__overlay__/irtx_gpio_led_set@gpio12";
		kpd_pins_default = "/fragment@14/__overlay__/kpdgpiodefault";
		led0 = "/fragment@3/__overlay__/led@0";
		led1 = "/fragment@3/__overlay__/led@1";
		led2 = "/fragment@3/__overlay__/led@2";
		led3 = "/fragment@3/__overlay__/led@3";
		led4 = "/fragment@3/__overlay__/led@4";
		led5 = "/fragment@3/__overlay__/led@5";
		led6 = "/fragment@3/__overlay__/led@6";
		mtkfb_pins_lcd_bias_enn0 = "/fragment@23/__overlay__/lcd_bias_enn0_gpio";
		mtkfb_pins_lcd_bias_enn1 = "/fragment@23/__overlay__/lcd_bias_enn1_gpio";
		mtkfb_pins_lcd_bias_enp0 = "/fragment@23/__overlay__/lcd_bias_enp0_gpio";
		mtkfb_pins_lcd_bias_enp1 = "/fragment@23/__overlay__/lcd_bias_enp1_gpio";
		mtkfb_pins_lcm_dsi_te = "/fragment@23/__overlay__/lcm_dsi_te";
		mtkfb_pins_lcm_rst_out0_gpio = "/fragment@23/__overlay__/lcm_rst_out0_gpio";
		mtkfb_pins_lcm_rst_out1_gpio = "/fragment@23/__overlay__/lcm_rst_out1_gpio";
		nfc = "/fragment@19/__overlay__/nfc";
		nfc_mtk = "/fragment@41/__overlay__/nfc@28";
		otg_iddig = "/fragment@27/__overlay__/otg_iddig";
		sgm41516d = "/fragment@2/__overlay__/sgm41516d@6B";
		slave_charger_mtk = "/fragment@41/__overlay__/slave_charger@4b";
		strobe_main_mtk = "/fragment@40/__overlay__/strobe_main@63";
		subpmic_pmu_mtk = "/fragment@39/__overlay__/subpmic_pmu@34";
		tran_audio = "/fragment@3/__overlay__/tran_audio";
		tran_battery = "/fragment@27/__overlay__/tran_battery";
		tran_battery_aging = "/fragment@27/__overlay__/tran_battery_aging";
		tran_touch = "/fragment@11/__overlay__/touch@0";
		usb_type_c_mtk = "/fragment@39/__overlay__/usb_type_c@4e";
		vibrator0 = "/fragment@3/__overlay__/vibrator@0";
	};

	fragment@0 {
		target = <0xffffffff>;

		__overlay__ {

			reserve-memory-scp_share {
				alignment = <0x0 0x1000000>;
				alloc-ranges = <0x0 0x40000000 0x0 0x50000000>;
				compatible = "mediatek,reserve-memory-scp_share";
				no-map;
				size = <0x0 0xd00000>;
			};
		};
	};

	fragment@1 {
		target = <0xffffffff>;

		__overlay__ {
			atag,videolfb-fb_base_h = <0x0>;
			atag,videolfb-fb_base_l = "~`P";
			atag,videolfb-fps = <0x1770>;
			atag,videolfb-islcm_inited = <0x0>;
			atag,videolfb-islcmfound = <0x1>;
			atag,videolfb-lcmname = "hx83112b_fhdp_dsi_cmd_auo_rt5081_drv";
			atag,videolfb-vramSize = <0x17e8000>;
		};
	};

	fragment@10 {
		target = <0xffffffff>;

		__overlay__ {

			ctp_eint@1 {
				phandle = <0xa>;

				pins_cmd_dat {
					bias-pull-up = <0xb>;
					pinmux = <0x100>;
					slew-rate = <0x0>;
				};
			};

			eint0default {
				phandle = <0x9>;
			};

			eintoutput0 {
				phandle = <0xb>;

				pins_cmd_dat {
					output-low;
					pinmux = <0x100>;
					slew-rate = <0x1>;
				};
			};

			eintoutput1 {
				phandle = <0xc>;

				pins_cmd_dat {
					output-high;
					pinmux = <0x100>;
					slew-rate = <0x1>;
				};
			};

			rstoutput0 {
				phandle = <0xd>;

				pins_cmd_dat {
					output-low;
					pinmux = <0x0>;
					slew-rate = <0x1>;
				};
			};

			rstoutput1 {
				phandle = <0xe>;

				pins_cmd_dat {
					output-high;
					pinmux = <0x0>;
					slew-rate = <0x1>;
				};
			};
		};
	};

	fragment@11 {
		target = <0xffffffff>;

		__overlay__ {

			touch@0 {
				compatible = "focaltech,fts", "mediatek,cap_touch_2", "tddi,ili7807";
				omnivision,block-delay-us = <0x0>;
				omnivision,byte-delay-us = <0x0>;
				omnivision,irq-on-state = <0x0>;
				omnivision,power-delay-ms = <0xc8>;
				omnivision,reset-active-ms = <0x14>;
				omnivision,reset-delay-ms = <0xc8>;
				omnivision,reset-on-state = <0x0>;
				omnivision,spi-mode = <0x3>;
				omnivision,ubl-byte-delay-us = <0x14>;
				omnivision,ubl-max-freq = <0x7a1200>;
				phandle = <0x59>;
				pt11_hi_limits_01 = <0x64 0x64 0x64 0x64 0x64 0x64 0x64 0x64 0x64 0x64 0x64 0x64 0x64 0x64 0x64 0x64 0x64 0x64 0x64 0x64 0x64 0x64 0x64 0x64 0x64 0x64 0x64 0x64 0x64 0x64 0x64 0x64 0x64 0x64 0x64 0x64 0x64 0x64 0x64 0x64 0x64 0x64 0x64 0x64 0x64 0x64 0x64 0x64 0x64 0x64 0x64 0x64 0x64 0x64 0x64 0x64 0x64 0x64 0x64 0x64 0x64 0x64 0x64 0x64 0x64 0x64 0x64 0x64 0x64 0x64 0x64 0x64 0x64 0x64 0x64 0x64 0x64 0x64 0x64 0x64 0x64 0x64 0x64 0x64 0x64 0x64 0x64 0x64 0x64 0x64 0x64 0x64 0x64 0x64 0x64 0x64 0x64 0x64 0x64 0x64 0x64 0x64 0x64 0x64 0x64 0x64 0x64 0x64 0x64 0x64 0x64 0x64 0x64 0x64 0x64 0x64 0x64 0x64 0x64 0x64 0x64 0x64 0x64 0x64 0x64 0x64 0x64 0x64 0x64 0x64 0x64 0x64 0x64 0x64 0x64 0x64 0x64 0x64 0x64 0x64 0x64 0x64 0x64 0x64 0x64 0x64 0x64 0x64 0x64 0x64 0x64 0x64 0x64 0x64 0x64 0x64 0x64 0x64 0x64 0x64 0x64 0x64 0x64 0x64 0x64 0x64 0x64 0x64 0x64 0x64 0x64 0x64 0x64 0x64 0x64 0x64 0x64 0x64 0x64 0x64 0x64 0x64 0x64 0x64 0x64 0x64 0x64 0x64 0x64 0x64 0x64 0x64 0x64 0x64 0x64 0x64 0x64 0x64 0x64 0x64 0x64 0x64 0x64 0x64 0x64 0x64 0x64 0x64 0x64 0x64 0x64 0x64 0x64 0x64 0x64 0x64 0x64 0x64 0x64 0x64 0x64 0x64 0x64 0x64 0x64 0x64 0x64 0x64 0x64 0x64 0x64 0x64 0x64 0x64 0x64 0x64 0x64 0x64 0x64 0x64 0x64 0x64 0x64 0x64 0x64 0x64 0x64 0x64 0x64 0x64 0x64 0x64 0x64 0x64 0x64 0x64 0x64 0x64 0x64 0x64 0x64 0x64 0x64 0x64 0x64 0x64 0x64 0x64 0x64 0x64 0x64 0x64 0x64 0x64 0x64 0x64 0x64 0x64 0x64 0x64 0x64 0x64 0x64 0x64 0x64 0x64 0x64 0x64 0x64 0x64 0x64 0x64 0x64 0x64 0x64 0x64 0x64 0x64 0x64 0x64 0x64 0x64 0x64 0x64 0x64 0x64 0x64 0x64 0x64 0x64 0x64 0x64 0x64 0x64 0x64 0x64 0x64 0x64 0x64 0x64 0x64 0x64 0x64 0x64 0x64 0x64 0x64 0x64 0x64 0x64 0x64 0x64 0x64 0x64 0x64 0x64 0x64 0x64 0x64 0x64 0x64 0x64 0x64 0x64 0x64 0x64 0x64 0x64 0x64 0x64 0x64 0x64 0x64 0x64 0x64 0x64 0x64 0x64 0x64 0x64 0x64 0x64 0x64 0x64 0x64 0x64 0x64 0x64 0x64 0x64 0x64 0x64 0x64 0x64 0x64 0x64 0x64 0x64 0x64 0x64 0x64 0x64 0x64 0x64 0x64 0x64 0x64 0x64 0x64 0x64 0x64 0x64 0x64 0x64 0x64 0x64 0x64 0x64 0x64 0x64 0x64 0x64 0x64 0x64 0x64 0x64 0x64 0x64 0x64 0x64 0x64 0x64 0x64 0x64 0x64 0x64 0x64 0x64 0x64 0x64 0x64 0x64 0x64 0x64 0x64 0x64 0x64 0x64 0x64 0x64 0x64 0x64 0x64 0x64 0x64 0x64 0x64 0x64 0x64 0x64 0x64 0x64 0x64 0x64 0x64 0x64 0x64 0x64 0x64 0x64 0x64 0x64 0x64 0x64 0x64 0x64 0x64 0x64 0x64 0x64 0x64 0x64 0x64 0x64 0x64 0x64 0x64 0x64 0x64 0x64 0x64 0x64 0x64 0x64 0x64 0x64 0x64 0x64 0x64 0x64 0x64 0x64 0x64 0x64 0x64 0x64 0x64 0x64 0x64 0x64 0x64 0x64 0x64 0x64 0x64 0x64 0x64 0x64 0x64 0x64 0x64 0x64 0x64 0x64 0x64 0x64 0x64 0x64 0x64 0x64 0x64 0x64 0x64 0x64 0x64 0x64 0x64 0x64 0x64 0x64 0x64 0x64 0x64 0x64 0x64 0x64 0x64 0x64 0x64 0x64 0x64 0x64 0x64 0x64 0x64 0x64 0x64 0x64 0x64 0x64 0x64 0x64 0x64 0x64 0x64 0x64 0x64 0x64 0x64 0x64 0x64 0x64 0x64 0x64 0x64 0x64 0x64 0x64 0x64 0x64 0x64 0x64 0x64 0x64 0x64 0x64 0x64 0x64 0x64 0x64 0x64 0x64 0x64 0x64 0x64 0x64 0x64 0x64 0x64 0x64 0x64 0x64 0x64 0x64 0x64 0x64 0x64 0x64 0x64 0x64 0x64 0x64 0x64 0x64 0x64 0x64 0x64 0x64 0x64 0x64 0x64 0x64 0x64 0x64 0x64 0x64 0x64 0x64 0x64 0x64 0x64 0x64 0x64 0x64 0x64 0x64 0x64 0x64 0x64 0x64 0x64 0x64 0x64 0x64 0x64 0x64 0x64 0x64 0x64 0x64 0x64 0x64 0x64 0x64 0x64 0x64 0x64 0x64 0x64 0x64 0x64 0x64 0x64 0x64 0x64 0x64 0x64 0x64 0x64 0x64 0x64 0x64 0x64 0x64 0x64 0x64 0x64 0x64 0x64 0x64 0x64 0x64 0x64 0x64 0x64 0x64 0x64 0x64 0x64 0x64 0x64 0x64 0x64 0x64 0x64 0x64 0x64 0x64 0x64 0x64 0x64 0x64 0x64 0x64 0x64 0x64 0x64 0x64 0x64 0x64 0x64 0x64 0x64 0x64 0x64 0x64 0x64 0x64 0x64 0x64 0x64 0x64 0x64 0x64 0x64 0x64 0x64 0x64 0x64 0x64 0x64 0x64 0x64 0x64 0x64 0x64 0x64 0x64 0x64 0x64 0x64 0x64 0x64 0x64 0x64 0x64 0x64 0x64 0x64 0x64 0x64 0x64 0x64 0x64 0x64 0x64 0x64 0x64 0x64 0x64 0x64 0x64 0x64 0x64 0x64 0x64 0x64 0x64 0x64 0x64 0x64 0x64 0x64 0x64 0x64 0x64 0x64 0x64 0x64 0x64 0x64 0x64 0x64 0x64 0x64 0x64 0x64 0x64 0x64 0x64 0x64 0x64 0x64 0x64 0x64 0x64 0x64 0x64 0x64 0x64 0x64 0x64 0x64 0x64 0x64 0x64 0x64 0x64 0x64 0x64 0x64 0x64 0x64 0x64 0x64 0x64 0x64 0x64 0x64 0x64 0x64 0x64 0x64 0x64 0x64 0x64 0x64 0x64 0x64 0x64 0x64 0x64 0x64 0x64 0x64 0x64 0x64 0x64 0x64 0x64 0x64 0x64 0x64 0x64 0x64 0x64 0x64 0x64 0x64 0x64 0x64 0x64 0x64 0x64 0x64 0x64 0x64 0x64 0x64 0x64 0x64 0x64 0x64 0x64 0x64 0x64 0x64 0x64 0x64 0x64 0x64 0x64 0x64 0x64 0x64 0x64 0x64 0x64 0x64 0x64 0x64 0x64 0x64 0x64 0x64 0x64 0x64 0x64 0x64 0x64 0x64 0x64 0x64 0x64 0x64 0x64 0x64 0x64 0x64 0x64 0x64 0x64 0x64 0x64 0x64 0x64 0x64 0x64 0x64 0x64 0x64 0x64 0x64 0x64 0x64 0x64 0x64 0x64 0x64 0x64 0x64 0x64 0x64 0x64 0x64 0x64 0x64 0x64 0x64 0x64 0x64 0x64 0x64 0x64 0x64 0x64 0x64 0x64 0x64 0x64 0x64 0x64 0x64 0x64 0x64 0x64 0x64 0x64 0x64 0x64 0x64 0x64 0x64 0x64 0x64 0x64 0x64 0x64 0x64 0x64 0x64 0x64 0x64 0x64 0x64 0x64 0x64 0x64 0x64 0x64 0x64 0x64 0x64 0x64 0x64 0x64 0x64 0x64 0x64 0x64 0x64 0x64 0x64 0x64 0x64 0x64 0x64 0x64 0x64 0x64 0x64 0x64 0x64 0x64 0x64 0x64 0x64 0x64 0x64 0x64 0x64 0x64 0x64 0x64 0x64 0x64 0x64 0x64 0x64 0x64 0x64 0x64 0x64 0x64 0x64 0x64 0x64 0x64 0x64 0x64 0x64 0x64 0x64 0x64 0x64 0x64 0x64 0x64 0x64 0x64 0x64 0x64 0x64 0x64 0x64 0x64 0x64 0x64 0x64 0x64 0x64 0x64 0x64 0x64 0x64 0x64 0x64 0x64 0x64 0x64 0x64 0x64 0x64 0x64 0x64 0x64 0x64 0x64 0x64 0x64 0x64 0x64 0x64 0x64 0x64 0x64 0x64 0x64 0x64 0x64 0x64 0x64 0x64 0x64 0x64 0x64 0x64 0x64 0x64 0x64 0x64 0x64 0x64 0x64 0x64 0x64 0x64 0x64 0x64 0x64 0x64 0x64 0x64 0x64 0x64 0x64 0x64 0x64 0x64 0x64 0x64 0x64 0x64 0x64 0x64 0x64 0x64 0x64 0x64 0x64 0x64 0x64 0x64 0x64 0x64 0x64 0x64 0x64 0x64 0x64 0x64 0x64 0x64 0x64 0x64 0x64 0x64 0x64 0x64 0x64 0x64 0x64 0x64 0x64 0x64 0x64 0x64 0x64 0x64 0x64 0x64 0x64 0x64 0x64 0x64 0x64 0x64 0x64 0x64 0x64 0x64 0x64 0x64 0x64 0x64 0x64 0x64 0x64 0x64 0x64 0x64 0x64 0x64 0x64 0x64 0x64 0x64 0x64 0x64 0x64 0x64 0x64 0x64 0x64 0x64 0x64 0x64 0x64 0x64 0x64 0x64 0x64 0x64 0x64 0x64 0x64 0x64 0x64 0x64 0x64 0x64 0x64 0x64 0x64 0x64 0x64 0x64 0x64 0x64 0x64 0x64 0x64 0x64 0x64 0x64 0x64 0x64 0x64 0x64 0x64 0x64 0x64 0x64 0x64 0x64 0x64 0x64 0x64 0x64 0x64 0x64 0x64 0x64 0x64 0x64 0x64 0x64 0x64 0x64 0x64 0x64 0x64 0x64 0x64 0x64 0x64 0x64 0x64 0x64 0x64 0x64 0x64 0x64 0x64 0x64 0x64 0x64 0x64 0x64 0x64 0x64 0x64 0x64 0x64 0x64 0x64 0x64 0x64 0x64 0x64 0x64 0x64 0x64 0x64 0x64 0x64 0x64 0x64 0x64 0x64 0x64 0x64 0x64 0x64 0x64 0x64 0x64 0x64 0x64 0x64 0x64 0x64 0x64 0x64 0x64 0x64 0x64 0x64 0x64 0x64 0x64 0x64 0x64 0x64 0x64 0x64 0x64 0x64 0x64 0x64 0x64 0x64 0x64 0x64 0x64 0x64 0x64 0x64 0x64 0x64 0x64 0x64 0x64 0x64 0x64 0x64 0x64 0x64 0x64 0x64 0x64 0x64 0x64 0x64 0x64 0x64 0x64 0x64 0x64 0x64 0x64 0x64 0x64 0x64 0x64 0x64 0x64 0x64 0x64 0x64 0x64 0x64 0x64 0x64 0x64 0x64 0x64 0x64 0x64 0x64 0x64 0x64 0x64 0x64 0x64 0x64 0x64 0x352 0x352 0x64 0x64 0x64 0x64 0x64 0x64 0x64 0x64 0x64 0x64 0x64 0x64 0x64 0x64 0x64 0x64 0x64 0x64 0x64 0x64 0x64 0x64 0x64 0x64 0x64 0x64 0x64 0x64 0x64 0x64 0x64 0x64 0x64 0x64 0x64 0x64 0x64 0x64 0x64 0x64 0x64 0x64 0x64 0x64 0x64 0x64 0x64 0x64 0x64 0x64 0x64 0x64 0x64 0x64 0x64 0x64 0x64 0x64 0x64 0x64 0x64 0x64 0x64 0x64 0x64 0x64 0x64 0x64 0x64 0x64 0x64 0x64 0x64 0x64 0x64 0x64 0x64 0x64 0x64 0x64 0x64 0x64 0x64 0x64 0x64 0x64 0x64 0x64 0x64 0x64 0x64 0x64 0x64 0x64 0x64 0x64 0x64 0x64 0x64 0x64 0x64 0x64 0x64 0x64 0x64>;
				pt11_hi_limits_02 = <0x3c 0x3c 0x3c 0x3c 0x3c 0x3c 0x3c 0x3c 0x3c 0x3c 0x3c 0x3c 0x3c 0x3c 0x3c 0x3c 0x3c 0x3c 0x3c 0x3c 0x3c 0x3c 0x3c 0x3c 0x3c 0x3c 0x3c 0x3c 0x3c 0x3c 0x3c 0x3c 0x3c 0x3c 0x3c 0x3c 0x3c 0x3c 0x3c 0x3c 0x3c 0x3c 0x3c 0x3c 0x3c 0x3c 0x3c 0x3c 0x3c 0x3c 0x3c 0x3c 0x3c 0x3c 0x3c 0x3c 0x3c 0x3c 0x3c 0x3c 0x3c 0x3c 0x3c 0x3c 0x3c 0x3c 0x3c 0x3c 0x3c 0x3c 0x3c 0x3c 0x3c 0x3c 0x3c 0x3c 0x3c 0x3c 0x3c 0x3c 0x3c 0x3c 0x3c 0x3c 0x3c 0x3c 0x3c 0x3c 0x3c 0x3c 0x3c 0x3c 0x3c 0x3c 0x3c 0x3c 0x3c 0x3c 0x3c 0x3c 0x3c 0x3c 0x3c 0x3c 0x3c 0x3c 0x3c 0x3c 0x3c 0x3c 0x3c 0x3c 0x3c 0x3c 0x3c 0x3c 0x3c 0x3c 0x3c 0x3c 0x3c 0x3c 0x3c 0x3c 0x3c 0x3c 0x3c 0x3c 0x3c 0x3c 0x3c 0x3c 0x3c 0x3c 0x3c 0x3c 0x3c 0x3c 0x3c 0x3c 0x3c 0x3c 0x3c 0x3c 0x3c 0x3c 0x3c 0x3c 0x3c 0x3c 0x3c 0x3c 0x3c 0x3c 0x3c 0x3c 0x3c 0x3c 0x3c 0x3c 0x3c 0x3c 0x3c 0x3c 0x3c 0x3c 0x3c 0x3c 0x3c 0x3c 0x3c 0x3c 0x3c 0x3c 0x3c 0x3c 0x3c 0x3c 0x3c 0x3c 0x3c 0x3c 0x3c 0x3c 0x3c 0x3c 0x3c 0x3c 0x3c 0x3c 0x3c 0x3c 0x3c 0x3c 0x3c 0x3c 0x3c 0x3c 0x3c 0x3c 0x3c 0x3c 0x3c 0x3c 0x3c 0x3c 0x3c 0x3c 0x3c 0x3c 0x3c 0x3c 0x3c 0x3c 0x3c 0x3c 0x3c 0x3c 0x3c 0x3c 0x3c 0x3c 0x3c 0x3c 0x3c 0x3c 0x3c 0x3c 0x3c 0x3c 0x3c 0x3c 0x3c 0x3c 0x3c 0x3c 0x3c 0x3c 0x3c 0x3c 0x3c 0x3c 0x3c 0x3c 0x3c 0x3c 0x3c 0x3c 0x3c 0x3c 0x3c 0x3c 0x3c 0x3c 0x3c 0x3c 0x3c 0x3c 0x3c 0x3c 0x3c 0x3c 0x3c 0x3c 0x3c 0x3c 0x3c 0x3c 0x3c 0x3c 0x3c 0x3c 0x3c 0x3c 0x3c 0x3c 0x3c 0x3c 0x3c 0x3c 0x3c 0x3c 0x3c 0x3c 0x3c 0x3c 0x3c 0x3c 0x3c 0x3c 0x3c 0x3c 0x3c 0x3c 0x3c 0x3c 0x3c 0x3c 0x3c 0x3c 0x3c 0x3c 0x3c 0x3c 0x3c 0x3c 0x3c 0x3c 0x3c 0x3c 0x3c 0x3c 0x3c 0x3c 0x3c 0x3c 0x3c 0x3c 0x3c 0x3c 0x3c 0x3c 0x3c 0x3c 0x3c 0x3c 0x3c 0x3c 0x3c 0x3c 0x3c 0x3c 0x3c 0x3c 0x3c 0x3c 0x3c 0x3c 0x3c 0x3c 0x3c 0x3c 0x3c 0x3c 0x3c 0x3c 0x3c 0x3c 0x3c 0x3c 0x3c 0x3c 0x3c 0x3c 0x3c 0x3c 0x3c 0x3c 0x3c 0x3c 0x3c 0x3c 0x3c 0x3c 0x3c 0x3c 0x3c 0x3c 0x3c 0x3c 0x3c 0x3c 0x3c 0x3c 0x3c 0x3c 0x3c 0x3c 0x3c 0x3c 0x3c 0x3c 0x3c 0x3c 0x3c 0x3c 0x3c 0x3c 0x3c 0x3c 0x3c 0x3c 0x3c 0x3c 0x3c 0x3c 0x3c 0x3c 0x3c 0x3c 0x3c 0x3c 0x3c 0x3c 0x3c 0x3c 0x3c 0x3c 0x3c 0x3c 0x3c 0x3c 0x3c 0x3c 0x3c 0x3c 0x3c 0x3c 0x3c 0x3c 0x3c 0x3c 0x3c 0x3c 0x3c 0x3c 0x3c 0x3c 0x3c 0x3c 0x3c 0x3c 0x3c 0x3c 0x3c 0x3c 0x3c 0x3c 0x3c 0x3c 0x3c 0x3c 0x3c 0x3c 0x3c 0x3c 0x3c 0x3c 0x3c 0x3c 0x3c 0x3c 0x3c 0x3c 0x3c 0x3c 0x3c 0x3c 0x3c 0x3c 0x3c 0x3c 0x3c 0x3c 0x3c 0x3c 0x3c 0x3c 0x3c 0x3c 0x3c 0x3c 0x3c 0x3c 0x3c 0x3c 0x3c 0x3c 0x3c 0x3c 0x3c 0x3c 0x3c 0x3c 0x3c 0x3c 0x3c 0x3c 0x3c 0x3c 0x3c 0x3c 0x3c 0x3c 0x3c 0x3c 0x3c 0x3c 0x3c 0x3c 0x3c 0x3c 0x3c 0x3c 0x3c 0x3c 0x3c 0x3c 0x3c 0x3c 0x3c 0x3c 0x3c 0x3c 0x3c 0x3c 0x3c 0x3c 0x3c 0x3c 0x3c 0x3c 0x3c 0x3c 0x3c 0x3c 0x3c 0x3c 0x3c 0x3c 0x3c 0x3c 0x3c 0x3c 0x3c 0x3c 0x3c 0x3c 0x3c 0x3c 0x3c 0x3c 0x3c 0x3c 0x3c 0x3c 0x3c 0x3c 0x3c 0x3c 0x3c 0x3c 0x3c 0x3c 0x3c 0x3c 0x3c 0x3c 0x3c 0x3c 0x3c 0x3c 0x3c 0x3c 0x3c 0x3c 0x3c 0x3c 0x3c 0x3c 0x3c 0x3c 0x3c 0x3c 0x3c 0x3c 0x3c 0x3c 0x3c 0x3c 0x3c 0x3c 0x3c 0x3c 0x3c 0x3c 0x3c 0x3c 0x3c 0x3c 0x3c 0x3c 0x3c 0x3c 0x3c 0x3c 0x3c 0x3c 0x3c 0x3c 0x3c 0x3c 0x3c 0x3c 0x3c 0x3c 0x3c 0x3c 0x3c 0x3c 0x3c 0x3c 0x3c 0x3c 0x3c 0x3c 0x3c 0x3c 0x3c 0x3c 0x3c 0x3c 0x3c 0x3c 0x3c 0x3c 0x3c 0x3c 0x3c 0x3c 0x3c 0x3c 0x3c 0x3c 0x3c 0x3c 0x3c 0x3c 0x3c 0x3c 0x3c 0x3c 0x3c 0x3c 0x3c 0x3c 0x3c 0x3c 0x3c 0x3c 0x3c 0x3c 0x3c 0x3c 0x3c 0x3c 0x3c 0x3c 0x3c 0x3c 0x3c 0x3c 0x3c 0x3c 0x3c 0x3c 0x3c 0x3c 0x3c 0x3c 0x3c 0x3c 0x3c 0x3c 0x3c 0x3c 0x3c 0x3c 0x3c 0x3c 0x3c 0x3c 0x3c 0x3c 0x3c 0x3c 0x3c 0x3c 0x3c 0x3c 0x3c 0x3c 0x3c 0x3c 0x3c 0x3c 0x3c 0x3c 0x3c 0x3c 0x3c 0x3c 0x3c 0x3c 0x3c 0x3c 0x3c 0x3c 0x3c 0x3c 0x3c 0x3c 0x3c 0x3c 0x3c 0x3c 0x3c 0x3c 0x3c 0x3c 0x3c 0x3c 0x3c 0x3c 0x3c 0x3c 0x3c 0x3c 0x3c 0x3c 0x3c 0x3c 0x3c 0x3c 0x3c 0x3c 0x3c 0x3c 0x3c 0x3c 0x3c 0x3c 0x3c 0x3c 0x3c 0x3c 0x3c 0x3c 0x3c 0x3c 0x3c 0x3c 0x3c 0x3c 0x3c 0x3c 0x3c 0x3c 0x3c 0x3c 0x3c 0x3c 0x3c 0x3c 0x3c 0x3c 0x3c 0x3c 0x3c 0x3c 0x3c 0x3c 0x3c 0x3c 0x3c 0x3c 0x3c 0x3c 0x3c 0x3c 0x3c 0x3c 0x3c 0x3c 0x3c 0x3c 0x3c 0x3c 0x3c 0x3c 0x3c 0x3c 0x3c 0x3c 0x3c 0x3c 0x3c 0x3c 0x3c 0x3c 0x3c 0x3c 0x3c 0x3c 0x3c 0x3c 0x3c 0x3c 0x3c 0x3c 0x3c 0x3c 0x3c 0x3c 0x3c 0x3c 0x3c 0x3c 0x3c 0x3c 0x3c 0x3c 0x3c 0x3c 0x3c 0x3c 0x3c 0x3c 0x3c 0x3c 0x3c 0x3c 0x3c 0x3c 0x3c 0x3c 0x3c 0x3c 0x3c 0x3c 0x3c 0x3c 0x3c 0x3c 0x3c 0x3c 0x3c 0x3c 0x3c 0x3c 0x3c 0x3c 0x3c 0x3c 0x3c 0x3c 0x3c 0x3c 0x3c 0x3c 0x3c 0x3c 0x3c 0x3c 0x3c 0x3c 0x3c 0x3c 0x3c 0x3c 0x3c 0x3c 0x3c 0x3c 0x3c 0x3c 0x3c 0x3c 0x3c 0x3c 0x3c 0x3c 0x3c 0x3c 0x3c 0x3c 0x3c 0x3c 0x3c 0x3c 0x3c 0x3c 0x3c 0x3c 0x3c 0x3c 0x3c 0x3c 0x3c 0x3c 0x3c 0x3c 0x3c 0x3c 0x3c 0x3c 0x3c 0x3c 0x3c 0x3c 0x3c 0x3c 0x3c 0x3c 0x3c 0x3c 0x3c 0x3c 0x3c 0x3c 0x3c 0x3c 0x3c 0x3c 0x3c 0x3c 0x3c 0x3c 0x3c 0x3c 0x3c 0x3c 0x3c 0x3c 0x3c 0x3c 0x3c 0x3c 0x3c 0x3c 0x3c 0x3c 0x3c 0x3c 0x3c 0x3c 0x3c 0x3c 0x3c 0x3c 0x3c 0x3c 0x3c 0x3c 0x3c 0x3c 0x3c 0x3c 0x3c 0x3c 0x3c 0x3c 0x3c 0x3c 0x3c 0x3c 0x3c 0x3c 0x3c 0x3c 0x3c 0x3c 0x3c 0x3c 0x3c 0x3c 0x3c 0x3c 0x3c 0x3c 0x3c 0x3c 0x3c 0x3c 0x3c 0x3c 0x3c 0x3c 0x3c 0x3c 0x3c 0x3c 0x3c 0x3c 0x3c 0x3c 0x3c 0x3c 0x3c 0x3c 0x3c 0x3c 0x3c 0x3c 0x3c 0x3c 0x3c 0x3c 0x3c 0x3c 0x3c 0x3c 0x3c 0x3c 0x3c 0x3c 0x3c 0x3c 0x3c 0x3c 0x3c 0x3c 0x3c 0x3c 0x3c 0x3c 0x3c 0x3c 0x3c 0x3c 0x3c 0x3c 0x3c 0x3c 0x3c 0x3c 0x3c 0x3c 0x3c 0x3c 0x3c 0x3c 0x3c 0x3c 0x3c 0x3c 0x3c 0x3c 0x3c 0x3c 0x3c 0x3c 0x3c 0x3c 0x3c 0x3c 0x3c 0x3c 0x3c 0x3c 0x3c 0x3c 0x3c 0x3c 0x3c 0x3c 0x3c 0x3c 0x3c 0x3c 0x3c 0x3c 0x3c 0x3c 0x3c 0x3c 0x3c 0x3c 0x3c 0x3c 0x3c 0x3c 0x3c 0x3c 0x3c 0x3c 0x3c 0x3c 0x3c 0x3c 0x3c 0x3c 0x3c 0x3c 0x3c 0x3c 0x3c 0x3c 0x3c 0x3c 0x3c 0x3c 0x3c 0x3c 0x3c 0x3c 0x3c 0x3c 0x3c 0x3c 0x3c 0x3c 0x3c 0x3c 0x3c 0x3c 0x3c 0x3c 0x3c 0x3c 0x3c 0x3c 0x3c 0x3c 0x3c 0x3c 0x3c 0x3c 0x3c 0x3c 0x3c 0x3c 0x3c 0x3c 0x3c 0x3c 0x3c 0x3c 0x3c 0x3c 0x3c 0x3c 0x3c 0x3c 0x3c 0x3c 0x3c 0x3c 0x3c 0x3c 0x3c 0x3c 0x3c 0x3c 0x3c 0x3c 0x3c 0x3c 0x3c 0x3c 0x3c 0x3c 0x3c 0x3c 0x3c 0x3c 0x3c 0x3c 0x3c 0x3c 0x3c 0x3c 0x3c 0x3c 0x3c 0x3c 0x3c 0x3c 0x3c 0x3c 0x3c 0x3c 0x3c 0x3c 0x3c 0x3c 0x3c 0x3c 0x3c 0x3c 0x3c 0x3c 0x3c 0x3c 0x3c 0x3c 0x3c 0x3c 0x3c 0x3c 0x3c 0x3c 0x3c 0x3c 0x3c 0x3c 0x3c 0x3c 0x3c 0x3c 0x3c 0x3c 0x3c 0x3c 0x3c 0x3c 0x3c 0x3c 0x3c 0x3c 0x3c 0x3c 0x3c 0x3c 0x3c 0x3c 0x3c 0x3c 0x3c 0x3c 0x3c 0x3c 0x3c 0x3c 0x3c 0x3c 0x3c 0x3c 0x3c 0x3c 0x3c 0x3c 0x3c 0x3c 0x3c 0x3c 0x3c 0x3c 0x3c 0x3c 0x3c 0x3c 0x3c 0x3c 0x3c 0x3c 0x3c 0x3c 0x3c 0x3c 0x3c 0x3c 0x3c 0x3c 0x3c 0x3c 0x3c 0x3c 0x3c 0x3c 0x3c 0x3c 0x3c 0x3c 0x3c 0x3c 0x3c 0x3c 0x3c 0x3c 0x3c 0x3c 0x3c 0x3c 0x3c 0x3c 0x3c 0x3c 0x3c 0x3c 0x3c 0x3c 0x3c 0x3c 0x3c 0x3c 0x3c 0x3c 0x3c 0x3c 0x3c 0x3c 0x3c 0x3c 0x3c 0x3c 0x3c 0x3c 0x3c 0x3c 0x3c 0x3c 0x3c 0x3c 0x3c 0x3c 0x3c 0x3c 0x3c 0x3c 0x3c 0x3c 0x3c 0x3c 0x3c 0x3c 0x3c 0x3c 0x3c 0x3c 0x3c 0x3c 0x3c 0x3c 0x3c 0x3c 0x3c 0x3c 0x3c 0x3c 0x3c 0x3c 0x3c 0x3c 0x3c 0x3c 0x3c 0x3c 0x3c 0x3c 0x3c 0x3c 0x3c 0x3c 0x3c 0x3c 0x3c 0x3c 0x3c 0x3c 0x3c 0x3c 0x3c 0x3c 0x3c 0x3c 0x3c 0x3c 0x3c 0x3c 0x3c 0x3c 0x3c 0x3c 0x3c 0x3c 0x3c 0x3c 0x3c 0x3c 0x3c 0x3c 0x3c 0x3c 0x3c 0x3c 0x3c 0x3c 0x3c 0x3c 0x3c 0x3c 0x3c 0x3c 0x3c 0x3c 0x3c 0x3c 0x3c 0x3c 0x3c 0x3c 0x3c 0x3c 0x3c 0x3c 0x3c 0x3c 0x3c 0x3c 0x3c 0x3c 0x3c 0x3c 0x3c 0x3c 0x3c 0x3c 0x3c 0x3c 0x3c 0x3c 0x3c 0x3c 0x3c 0x3c 0x3c 0x3c 0x3c 0x3c 0x3c 0x3c 0x3c 0x3c 0x3c 0x3c 0x3c 0x3c 0x3c 0x3c 0x3c 0x3c 0x3c 0x3c>;
				pt11_hi_limits_cols_01 = <0x26>;
				pt11_hi_limits_cols_02 = <0x26>;
				pt11_hi_limits_row_01 = <0x26>;
				pt11_hi_limits_row_02 = <0x26>;
				pt11_lo_limits_01 = <0xffffff9c 0xffffff9c 0xffffff9c 0xffffff9c 0xffffff9c 0xffffff9c 0xffffff9c 0xffffff9c 0xffffff9c 0xffffff9c 0xffffff9c 0xffffff9c 0xffffff9c 0xffffff9c 0xffffff9c 0xffffff9c 0xffffff9c 0xffffff9c 0xffffff9c 0xffffff9c 0xffffff9c 0xffffff9c 0xffffff9c 0xffffff9c 0xffffff9c 0xffffff9c 0xffffff9c 0xffffff9c 0xffffff9c 0xffffff9c 0xffffff9c 0xffffff9c 0xffffff9c 0xffffff9c 0xffffff9c 0xffffff9c 0xffffff9c 0xffffff9c 0xffffff9c 0xffffff9c 0xffffff9c 0xffffff9c 0xffffff9c 0xffffff9c 0xffffff9c 0xffffff9c 0xffffff9c 0xffffff9c 0xffffff9c 0xffffff9c 0xffffff9c 0xffffff9c 0xffffff9c 0xffffff9c 0xffffff9c 0xffffff9c 0xffffff9c 0xffffff9c 0xffffff9c 0xffffff9c 0xffffff9c 0xffffff9c 0xffffff9c 0xffffff9c 0xffffff9c 0xffffff9c 0xffffff9c 0xffffff9c 0xffffff9c 0xffffff9c 0xffffff9c 0xffffff9c 0xffffff9c 0xffffff9c 0xffffff9c 0xffffff9c 0xffffff9c 0xffffff9c 0xffffff9c 0xffffff9c 0xffffff9c 0xffffff9c 0xffffff9c 0xffffff9c 0xffffff9c 0xffffff9c 0xffffff9c 0xffffff9c 0xffffff9c 0xffffff9c 0xffffff9c 0xffffff9c 0xffffff9c 0xffffff9c 0xffffff9c 0xffffff9c 0xffffff9c 0xffffff9c 0xffffff9c 0xffffff9c 0xffffff9c 0xffffff9c 0xffffff9c 0xffffff9c 0xffffff9c 0xffffff9c 0xffffff9c 0xffffff9c 0xffffff9c 0xffffff9c 0xffffff9c 0xffffff9c 0xffffff9c 0xffffff9c 0xffffff9c 0xffffff9c 0xffffff9c 0xffffff9c 0xffffff9c 0xffffff9c 0xffffff9c 0xffffff9c 0xffffff9c 0xffffff9c 0xffffff9c 0xffffff9c 0xffffff9c 0xffffff9c 0xffffff9c 0xffffff9c 0xffffff9c 0xffffff9c 0xffffff9c 0xffffff9c 0xffffff9c 0xffffff9c 0xffffff9c 0xffffff9c 0xffffff9c 0xffffff9c 0xffffff9c 0xffffff9c 0xffffff9c 0xffffff9c 0xffffff9c 0xffffff9c 0xffffff9c 0xffffff9c 0xffffff9c 0xffffff9c 0xffffff9c 0xffffff9c 0xffffff9c 0xffffff9c 0xffffff9c 0xffffff9c 0xffffff9c 0xffffff9c 0xffffff9c 0xffffff9c 0xffffff9c 0xffffff9c 0xffffff9c 0xffffff9c 0xffffff9c 0xffffff9c 0xffffff9c 0xffffff9c 0xffffff9c 0xffffff9c 0xffffff9c 0xffffff9c 0xffffff9c 0xffffff9c 0xffffff9c 0xffffff9c 0xffffff9c 0xffffff9c 0xffffff9c 0xffffff9c 0xffffff9c 0xffffff9c 0xffffff9c 0xffffff9c 0xffffff9c 0xffffff9c 0xffffff9c 0xffffff9c 0xffffff9c 0xffffff9c 0xffffff9c 0xffffff9c 0xffffff9c 0xffffff9c 0xffffff9c 0xffffff9c 0xffffff9c 0xffffff9c 0xffffff9c 0xffffff9c 0xffffff9c 0xffffff9c 0xffffff9c 0xffffff9c 0xffffff9c 0xffffff9c 0xffffff9c 0xffffff9c 0xffffff9c 0xffffff9c 0xffffff9c 0xffffff9c 0xffffff9c 0xffffff9c 0xffffff9c 0xffffff9c 0xffffff9c 0xffffff9c 0xffffff9c 0xffffff9c 0xffffff9c 0xffffff9c 0xffffff9c 0xffffff9c 0xffffff9c 0xffffff9c 0xffffff9c 0xffffff9c 0xffffff9c 0xffffff9c 0xffffff9c 0xffffff9c 0xffffff9c 0xffffff9c 0xffffff9c 0xffffff9c 0xffffff9c 0xffffff9c 0xffffff9c 0xffffff9c 0xffffff9c 0xffffff9c 0xffffff9c 0xffffff9c 0xffffff9c 0xffffff9c 0xffffff9c 0xffffff9c 0xffffff9c 0xffffff9c 0xffffff9c 0xffffff9c 0xffffff9c 0xffffff9c 0xffffff9c 0xffffff9c 0xffffff9c 0xffffff9c 0xffffff9c 0xffffff9c 0xffffff9c 0xffffff9c 0xffffff9c 0xffffff9c 0xffffff9c 0xffffff9c 0xffffff9c 0xffffff9c 0xffffff9c 0xffffff9c 0xffffff9c 0xffffff9c 0xffffff9c 0xffffff9c 0xffffff9c 0xffffff9c 0xffffff9c 0xffffff9c 0xffffff9c 0xffffff9c 0xffffff9c 0xffffff9c 0xffffff9c 0xffffff9c 0xffffff9c 0xffffff9c 0xffffff9c 0xffffff9c 0xffffff9c 0xffffff9c 0xffffff9c 0xffffff9c 0xffffff9c 0xffffff9c 0xffffff9c 0xffffff9c 0xffffff9c 0xffffff9c 0xffffff9c 0xffffff9c 0xffffff9c 0xffffff9c 0xffffff9c 0xffffff9c 0xffffff9c 0xffffff9c 0xffffff9c 0xffffff9c 0xffffff9c 0xffffff9c 0xffffff9c 0xffffff9c 0xffffff9c 0xffffff9c 0xffffff9c 0xffffff9c 0xffffff9c 0xffffff9c 0xffffff9c 0xffffff9c 0xffffff9c 0xffffff9c 0xffffff9c 0xffffff9c 0xffffff9c 0xffffff9c 0xffffff9c 0xffffff9c 0xffffff9c 0xffffff9c 0xffffff9c 0xffffff9c 0xffffff9c 0xffffff9c 0xffffff9c 0xffffff9c 0xffffff9c 0xffffff9c 0xffffff9c 0xffffff9c 0xffffff9c 0xffffff9c 0xffffff9c 0xffffff9c 0xffffff9c 0xffffff9c 0xffffff9c 0xffffff9c 0xffffff9c 0xffffff9c 0xffffff9c 0xffffff9c 0xffffff9c 0xffffff9c 0xffffff9c 0xffffff9c 0xffffff9c 0xffffff9c 0xffffff9c 0xffffff9c 0xffffff9c 0xffffff9c 0xffffff9c 0xffffff9c 0xffffff9c 0xffffff9c 0xffffff9c 0xffffff9c 0xffffff9c 0xffffff9c 0xffffff9c 0xffffff9c 0xffffff9c 0xffffff9c 0xffffff9c 0xffffff9c 0xffffff9c 0xffffff9c 0xffffff9c 0xffffff9c 0xffffff9c 0xffffff9c 0xffffff9c 0xffffff9c 0xffffff9c 0xffffff9c 0xffffff9c 0xffffff9c 0xffffff9c 0xffffff9c 0xffffff9c 0xffffff9c 0xffffff9c 0xffffff9c 0xffffff9c 0xffffff9c 0xffffff9c 0xffffff9c 0xffffff9c 0xffffff9c 0xffffff9c 0xffffff9c 0xffffff9c 0xffffff9c 0xffffff9c 0xffffff9c 0xffffff9c 0xffffff9c 0xffffff9c 0xffffff9c 0xffffff9c 0xffffff9c 0xffffff9c 0xffffff9c 0xffffff9c 0xffffff9c 0xffffff9c 0xffffff9c 0xffffff9c 0xffffff9c 0xffffff9c 0xffffff9c 0xffffff9c 0xffffff9c 0xffffff9c 0xffffff9c 0xffffff9c 0xffffff9c 0xffffff9c 0xffffff9c 0xffffff9c 0xffffff9c 0xffffff9c 0xffffff9c 0xffffff9c 0xffffff9c 0xffffff9c 0xffffff9c 0xffffff9c 0xffffff9c 0xffffff9c 0xffffff9c 0xffffff9c 0xffffff9c 0xffffff9c 0xffffff9c 0xffffff9c 0xffffff9c 0xffffff9c 0xffffff9c 0xffffff9c 0xffffff9c 0xffffff9c 0xffffff9c 0xffffff9c 0xffffff9c 0xffffff9c 0xffffff9c 0xffffff9c 0xffffff9c 0xffffff9c 0xffffff9c 0xffffff9c 0xffffff9c 0xffffff9c 0xffffff9c 0xffffff9c 0xffffff9c 0xffffff9c 0xffffff9c 0xffffff9c 0xffffff9c 0xffffff9c 0xffffff9c 0xffffff9c 0xffffff9c 0xffffff9c 0xffffff9c 0xffffff9c 0xffffff9c 0xffffff9c 0xffffff9c 0xffffff9c 0xffffff9c 0xffffff9c 0xffffff9c 0xffffff9c 0xffffff9c 0xffffff9c 0xffffff9c 0xffffff9c 0xffffff9c 0xffffff9c 0xffffff9c 0xffffff9c 0xffffff9c 0xffffff9c 0xffffff9c 0xffffff9c 0xffffff9c 0xffffff9c 0xffffff9c 0xffffff9c 0xffffff9c 0xffffff9c 0xffffff9c 0xffffff9c 0xffffff9c 0xffffff9c 0xffffff9c 0xffffff9c 0xffffff9c 0xffffff9c 0xffffff9c 0xffffff9c 0xffffff9c 0xffffff9c 0xffffff9c 0xffffff9c 0xffffff9c 0xffffff9c 0xffffff9c 0xffffff9c 0xffffff9c 0xffffff9c 0xffffff9c 0xffffff9c 0xffffff9c 0xffffff9c 0xffffff9c 0xffffff9c 0xffffff9c 0xffffff9c 0xffffff9c 0xffffff9c 0xffffff9c 0xffffff9c 0xffffff9c 0xffffff9c 0xffffff9c 0xffffff9c 0xffffff9c 0xffffff9c 0xffffff9c 0xffffff9c 0xffffff9c 0xffffff9c 0xffffff9c 0xffffff9c 0xffffff9c 0xffffff9c 0xffffff9c 0xffffff9c 0xffffff9c 0xffffff9c 0xffffff9c 0xffffff9c 0xffffff9c 0xffffff9c 0xffffff9c 0xffffff9c 0xffffff9c 0xffffff9c 0xffffff9c 0xffffff9c 0xffffff9c 0xffffff9c 0xffffff9c 0xffffff9c 0xffffff9c 0xffffff9c 0xffffff9c 0xffffff9c 0xffffff9c 0xffffff9c 0xffffff9c 0xffffff9c 0xffffff9c 0xffffff9c 0xffffff9c 0xffffff9c 0xffffff9c 0xffffff9c 0xffffff9c 0xffffff9c 0xffffff9c 0xffffff9c 0xffffff9c 0xffffff9c 0xffffff9c 0xffffff9c 0xffffff9c 0xffffff9c 0xffffff9c 0xffffff9c 0xffffff9c 0xffffff9c 0xffffff9c 0xffffff9c 0xffffff9c 0xffffff9c 0xffffff9c 0xffffff9c 0xffffff9c 0xffffff9c 0xffffff9c 0xffffff9c 0xffffff9c 0xffffff9c 0xffffff9c 0xffffff9c 0xffffff9c 0xffffff9c 0xffffff9c 0xffffff9c 0xffffff9c 0xffffff9c 0xffffff9c 0xffffff9c 0xffffff9c 0xffffff9c 0xffffff9c 0xffffff9c 0xffffff9c 0xffffff9c 0xffffff9c 0xffffff9c 0xffffff9c 0xffffff9c 0xffffff9c 0xffffff9c 0xffffff9c 0xffffff9c 0xffffff9c 0xffffff9c 0xffffff9c 0xffffff9c 0xffffff9c 0xffffff9c 0xffffff9c 0xffffff9c 0xffffff9c 0xffffff9c 0xffffff9c 0xffffff9c 0xffffff9c 0xffffff9c 0xffffff9c 0xffffff9c 0xffffff9c 0xffffff9c 0xffffff9c 0xffffff9c 0xffffff9c 0xffffff9c 0xffffff9c 0xffffff9c 0xffffff9c 0xffffff9c 0xffffff9c 0xffffff9c 0xffffff9c 0xffffff9c 0xffffff9c 0xffffff9c 0xffffff9c 0xffffff9c 0xffffff9c 0xffffff9c 0xffffff9c 0xffffff9c 0xffffff9c 0xffffff9c 0xffffff9c 0xffffff9c 0xffffff9c 0xffffff9c 0xffffff9c 0xffffff9c 0xffffff9c 0xffffff9c 0xffffff9c 0xffffff9c 0xffffff9c 0xffffff9c 0xffffff9c 0xffffff9c 0xffffff9c 0xffffff9c 0xffffff9c 0xffffff9c 0xffffff9c 0xffffff9c 0xffffff9c 0xffffff9c 0xffffff9c 0xffffff9c 0xffffff9c 0xffffff9c 0xffffff9c 0xffffff9c 0xffffff9c 0xffffff9c 0xffffff9c 0xffffff9c 0xffffff9c 0xffffff9c 0xffffff9c 0xffffff9c 0xffffff9c 0xffffff9c 0xffffff9c 0xffffff9c 0xffffff9c 0xffffff9c 0xffffff9c 0xffffff9c 0xffffff9c 0xffffff9c 0xffffff9c 0xffffff9c 0xffffff9c 0xffffff9c 0xffffff9c 0xffffff9c 0xffffff9c 0xffffff9c 0xffffff9c 0xffffff9c 0xffffff9c 0xffffff9c 0xffffff9c 0xffffff9c 0xffffff9c 0xffffff9c 0xffffff9c 0xffffff9c 0xffffff9c 0xffffff9c 0xffffff9c 0xffffff9c 0xffffff9c 0xffffff9c 0xffffff9c 0xffffff9c 0xffffff9c 0xffffff9c 0xffffff9c 0xffffff9c 0xffffff9c 0xffffff9c 0xffffff9c 0xffffff9c 0xffffff9c 0xffffff9c 0xffffff9c 0xffffff9c 0xffffff9c 0xffffff9c 0xffffff9c 0xffffff9c 0xffffff9c 0xffffff9c 0xffffff9c 0xffffff9c 0xffffff9c 0xffffff9c 0xffffff9c 0xffffff9c 0xffffff9c 0xffffff9c 0xffffff9c 0xffffff9c 0xffffff9c 0xffffff9c 0xffffff9c 0xffffff9c 0xffffff9c 0xffffff9c 0xffffff9c 0xffffff9c 0xffffff9c 0xffffff9c 0xffffff9c 0xffffff9c 0xffffff9c 0xffffff9c 0xffffff9c 0xffffff9c 0xffffff9c 0xffffff9c 0xffffff9c 0xffffff9c 0xffffff9c 0xffffff9c 0xffffff9c 0xffffff9c 0xffffff9c 0xffffff9c 0xffffff9c 0xffffff9c 0xffffff9c 0xffffff9c 0xffffff9c 0xffffff9c 0xffffff9c 0xffffff9c 0xffffff9c 0xffffff9c 0xffffff9c 0xffffff9c 0xffffff9c 0xffffff9c 0xffffff9c 0xffffff9c 0xffffff9c 0xffffff9c 0xffffff9c 0xffffff9c 0xffffff9c 0xffffff9c 0xffffff9c 0xffffff9c 0xffffff9c 0xffffff9c 0xffffff9c 0xffffff9c 0xffffff9c 0xffffff9c 0xffffff9c 0xffffff9c 0xffffff9c 0xffffff9c 0xffffff9c 0xffffff9c 0xffffff9c 0xffffff9c 0xffffff9c 0xffffff9c 0xffffff9c 0xffffff9c 0xffffff9c 0xffffff9c 0xffffff9c 0xffffff9c 0xffffff9c 0xffffff9c 0xffffff9c 0xffffff9c 0xffffff9c 0xffffff9c 0xffffff9c 0xffffff9c 0xffffff9c 0xffffff9c 0xffffff9c 0xffffff9c 0xffffff9c 0xffffff9c 0xffffff9c 0xffffff9c 0xffffff9c 0xffffff9c 0xffffff9c 0xffffff9c 0xffffff9c 0xffffff9c 0xffffff9c 0xffffff9c 0xffffff9c 0xffffff9c 0xffffff9c 0xffffff9c 0xffffff9c 0xffffff9c 0xffffff9c 0xffffff9c 0xffffff9c 0xffffff9c 0xffffff9c 0xffffff9c 0xffffff9c 0xffffff9c 0xffffff9c 0xffffff9c 0xffffff9c 0xffffff9c 0xffffff9c 0xffffff9c 0xffffff9c 0xffffff9c 0xffffff9c 0xffffff9c 0xffffff9c 0xffffff9c 0xffffff9c 0xffffff9c 0xffffff9c 0xffffff9c 0xffffff9c 0xffffff9c 0xffffff9c 0xffffff9c 0xffffff9c 0xffffff9c 0xffffff9c 0xffffff9c 0xffffff9c 0xffffff9c 0xffffff9c 0xffffff9c 0xffffff9c 0xffffff9c 0xffffff9c 0xffffff9c 0xffffff9c 0xffffff9c 0xffffff9c 0xffffff9c 0xffffff9c 0xffffff9c 0xffffff9c 0xffffff9c 0xffffff9c 0xffffff9c 0xffffff9c 0xffffff9c 0xffffff9c 0xffffff9c 0xffffff9c 0xffffff9c 0xffffff9c 0xffffff9c 0xffffff9c 0xffffff9c 0xffffff9c 0xffffff9c 0xffffff9c 0xffffff9c 0xffffff9c 0xffffff9c 0xffffff9c 0xffffff9c 0xffffff9c 0xffffff9c 0xffffff9c 0xffffff9c 0xffffff9c 0xffffff9c 0xffffff9c 0xffffff9c 0xffffff9c 0xffffff9c 0xffffff9c 0xffffff9c 0xffffff9c 0xffffff9c 0xffffff9c 0xffffff9c 0xffffff9c 0xffffff9c 0xffffff9c 0xffffff9c 0xffffff9c 0xffffff9c 0xffffff9c 0xffffff9c 0xffffff9c 0xffffff9c 0xffffff9c 0xffffff9c 0xffffff9c 0xffffff9c 0xffffff9c 0xffffff9c 0xffffff9c 0xffffff9c 0xffffff9c 0xffffff9c 0xffffff9c 0xffffff9c 0xffffff9c 0xffffff9c 0xffffff9c 0xffffff9c 0xffffff9c 0xffffff9c 0xffffff9c 0xffffff9c 0xffffff9c 0xffffff9c 0xffffff9c 0xffffff9c 0xffffff9c 0xffffff9c 0xffffff9c 0xffffff9c 0xffffff9c 0xffffff9c 0xffffff9c 0xffffff9c 0xffffff9c 0xffffff9c 0xffffff9c 0xffffff9c 0xffffff9c 0xffffff9c 0xffffff9c 0xffffff9c 0xffffff9c 0xffffff9c 0xffffff9c 0xffffff9c 0xffffff9c 0xffffff9c 0xffffff9c 0xffffff9c 0xffffff9c 0xffffff9c 0xffffff9c 0xffffff9c 0xffffff9c 0xffffff9c 0xffffff9c 0xffffff9c 0xffffff9c 0xffffff9c 0xffffff9c 0xffffff9c 0xffffff9c 0xffffff9c 0xffffff9c 0xffffff9c 0xffffff9c 0xffffff9c 0xffffff9c 0xffffff9c 0xffffff9c 0xffffff9c 0xffffff9c 0xffffff9c 0xffffff9c 0xffffff9c 0xffffff9c 0xffffff9c 0xffffff9c 0xffffff9c 0xffffff9c 0xffffff9c 0xffffff9c 0xffffff9c 0xffffff9c 0xffffff9c 0xffffff9c 0xffffff9c 0xffffff9c 0xffffff9c 0xffffff9c 0xffffff9c 0xffffff9c 0xffffff9c 0xffffff9c 0xffffff9c 0xffffff9c 0xffffff9c 0xffffff9c 0xffffff9c 0xffffff9c 0xffffff9c 0xffffff9c 0xffffff9c 0xffffff9c 0xffffff9c 0xffffff9c 0xffffff9c 0xffffff9c 0xffffff9c 0xffffff9c 0xffffff9c 0xffffff9c 0xffffff9c 0xffffff9c 0xffffff9c 0xffffff9c 0xffffff9c 0xffffff9c 0xffffff9c 0xffffff9c 0xffffff9c 0xffffff9c 0xffffff9c 0xffffff9c 0xffffff9c 0xffffff9c 0xffffff9c 0xffffff9c 0xffffff9c 0xffffff9c 0xffffff9c 0xffffff9c 0xffffff9c 0xffffff9c 0xffffff9c 0xffffff9c 0xffffff9c 0xffffff9c 0xffffff9c 0xffffff9c 0xffffff9c 0xffffff9c 0xffffff9c 0xffffff9c 0xffffff9c 0xffffff9c 0xffffff9c 0xffffff9c 0xffffff9c 0xffffff9c 0xffffff9c 0xffffff9c 0xffffff9c 0xffffff9c 0xffffff9c 0xffffff9c 0xffffff9c 0xffffff9c 0xffffff9c 0xffffff9c 0xffffff9c 0xffffff9c 0xffffff9c 0xffffff9c 0xffffff9c 0xffffff9c 0xffffff9c 0xffffff9c 0xffffff9c 0xffffff9c 0xffffff9c 0xffffff9c 0xffffff9c 0xffffff9c 0xffffff9c 0xffffff9c 0xffffff9c 0xffffff9c 0xffffff9c 0xffffff9c 0xffffff9c 0xffffff9c 0xffffff9c 0xffffff9c 0xffffff9c 0xffffff9c 0xffffff9c 0xffffff9c 0xffffff9c 0xffffff9c 0xffffff9c 0xffffff9c 0xffffff9c 0xffffff9c 0xffffff9c 0xffffff9c 0xffffff9c 0xffffff9c 0xffffff9c 0xffffff9c 0xffffff9c 0xffffff9c 0xffffff9c 0xffffff9c 0xffffff9c 0xffffff9c 0xffffff9c 0xffffff9c 0xffffff9c 0xffffff9c 0xffffff9c 0xffffff9c 0xffffff9c 0xffffff9c 0xffffff9c 0xffffff9c 0xffffff9c 0xffffff9c 0xffffff9c 0xffffff9c 0xffffff9c 0xffffff9c 0xffffff9c 0xffffff9c 0xffffff9c 0xffffff9c 0xffffff9c 0xffffff9c 0xffffff9c 0xffffff9c 0xffffff9c 0xffffff9c 0xffffff9c 0xffffff9c 0xffffff9c 0xffffff9c 0xffffff9c 0xffffff9c 0xffffff9c 0xffffff9c 0xffffff9c 0xffffff9c 0xffffff9c 0xffffff9c 0xffffff9c 0xffffff9c 0xffffff9c 0xffffff9c 0xffffff9c 0xffffff9c 0xffffff9c 0xffffff9c 0xffffff9c 0xffffff9c 0xffffff9c 0xffffff9c 0xffffff9c 0xffffff9c 0xffffff9c 0xffffff9c 0xffffff9c 0xffffff9c 0xffffff9c 0xffffff9c 0xffffff9c 0xffffff9c 0xffffff9c 0xffffff9c 0xffffff9c 0xffffff9c 0xffffff9c 0xffffff9c 0xffffff9c 0xffffff9c 0xffffff9c 0xffffff9c 0xffffff9c 0xffffff9c 0xffffff9c 0xffffff9c 0xffffff9c 0xffffff9c 0xffffff9c 0xffffff9c 0xffffff9c 0xffffff9c 0xffffff9c 0xffffff9c 0xffffff9c 0xffffff9c 0xffffff9c 0xffffff9c 0xffffff9c 0xffffff9c 0xffffff9c 0xffffff9c 0xffffff9c 0xffffff9c 0xffffff9c 0xffffff9c 0xffffff9c 0xffffff9c 0xffffff9c 0xffffff9c 0xffffff9c 0xffffff9c 0xffffff9c 0xffffff9c 0xffffff9c 0xffffff9c 0xffffff9c 0xffffff9c 0xffffff9c 0xffffff9c 0xffffff9c 0xffffff9c 0xffffff9c 0xffffff9c 0xffffff9c 0xffffff9c 0xffffff9c 0xffffff9c 0xffffff9c 0xffffff9c 0xffffff9c 0xffffff9c 0xffffff9c 0xffffff9c 0xffffff9c 0xffffff9c 0xffffff9c 0xffffff9c 0xffffff9c 0xffffff9c 0xffffff9c 0xffffff9c 0xffffff9c 0xffffff9c 0xffffff9c 0xffffff9c 0xffffff9c 0xffffff9c 0xffffff9c 0xffffff9c 0xffffff9c 0xffffff9c 0xffffff9c 0xffffff9c 0xffffff9c 0xffffff9c 0xffffff9c 0xffffff9c 0xffffff9c 0xffffff9c 0xffffff9c 0xffffff9c 0xffffff9c 0xffffff9c 0xffffff9c 0xffffff9c 0xffffff9c 0xffffff9c 0xffffff9c 0xffffff9c 0xffffff9c 0xffffff9c 0xffffff9c 0xffffff9c 0xffffff9c 0xfffffcae 0xfffffcae 0xffffff9c 0xffffff9c 0xffffff9c 0xffffff9c 0xffffff9c 0xffffff9c 0xffffff9c 0xffffff9c 0xffffff9c 0xffffff9c 0xffffff9c 0xffffff9c 0xffffff9c 0xffffff9c 0xffffff9c 0xffffff9c 0xffffff9c 0xffffff9c 0xffffff9c 0xffffff9c 0xffffff9c 0xffffff9c 0xffffff9c 0xffffff9c 0xffffff9c 0xffffff9c 0xffffff9c 0xffffff9c 0xffffff9c 0xffffff9c 0xffffff9c 0xffffff9c 0xffffff9c 0xffffff9c 0xffffff9c 0xffffff9c 0xffffff9c 0xffffff9c 0xffffff9c 0xffffff9c 0xffffff9c 0xffffff9c 0xffffff9c 0xffffff9c 0xffffff9c 0xffffff9c 0xffffff9c 0xffffff9c 0xffffff9c 0xffffff9c 0xffffff9c 0xffffff9c 0xffffff9c 0xffffff9c 0xffffff9c 0xffffff9c 0xffffff9c 0xffffff9c 0xffffff9c 0xffffff9c 0xffffff9c 0xffffff9c 0xffffff9c 0xffffff9c 0xffffff9c 0xffffff9c 0xffffff9c 0xffffff9c 0xffffff9c 0xffffff9c 0xffffff9c 0xffffff9c 0xffffff9c 0xffffff9c 0xffffff9c 0xffffff9c 0xffffff9c 0xffffff9c 0xffffff9c 0xffffff9c 0xffffff9c 0xffffff9c 0xffffff9c 0xffffff9c 0xffffff9c 0xffffff9c 0xffffff9c 0xffffff9c 0xffffff9c 0xffffff9c 0xffffff9c 0xffffff9c 0xffffff9c 0xffffff9c 0xffffff9c 0xffffff9c 0xffffff9c 0xffffff9c 0xffffff9c 0xffffff9c 0xffffff9c 0xffffff9c 0xffffff9c 0xffffff9c 0xffffff9c>;
				pt11_lo_limits_02 = <0xffffffc4 0xffffffc4 0xffffffc4 0xffffffc4 0xffffffc4 0xffffffc4 0xffffffc4 0xffffffc4 0xffffffc4 0xffffffc4 0xffffffc4 0xffffffc4 0xffffffc4 0xffffffc4 0xffffffc4 0xffffffc4 0xffffffc4 0xffffffc4 0xffffffc4 0xffffffc4 0xffffffc4 0xffffffc4 0xffffffc4 0xffffffc4 0xffffffc4 0xffffffc4 0xffffffc4 0xffffffc4 0xffffffc4 0xffffffc4 0xffffffc4 0xffffffc4 0xffffffc4 0xffffffc4 0xffffffc4 0xffffffc4 0xffffffc4 0xffffffc4 0xffffffc4 0xffffffc4 0xffffffc4 0xffffffc4 0xffffffc4 0xffffffc4 0xffffffc4 0xffffffc4 0xffffffc4 0xffffffc4 0xffffffc4 0xffffffc4 0xffffffc4 0xffffffc4 0xffffffc4 0xffffffc4 0xffffffc4 0xffffffc4 0xffffffc4 0xffffffc4 0xffffffc4 0xffffffc4 0xffffffc4 0xffffffc4 0xffffffc4 0xffffffc4 0xffffffc4 0xffffffc4 0xffffffc4 0xffffffc4 0xffffffc4 0xffffffc4 0xffffffc4 0xffffffc4 0xffffffc4 0xffffffc4 0xffffffc4 0xffffffc4 0xffffffc4 0xffffffc4 0xffffffc4 0xffffffc4 0xffffffc4 0xffffffc4 0xffffffc4 0xffffffc4 0xffffffc4 0xffffffc4 0xffffffc4 0xffffffc4 0xffffffc4 0xffffffc4 0xffffffc4 0xffffffc4 0xffffffc4 0xffffffc4 0xffffffc4 0xffffffc4 0xffffffc4 0xffffffc4 0xffffffc4 0xffffffc4 0xffffffc4 0xffffffc4 0xffffffc4 0xffffffc4 0xffffffc4 0xffffffc4 0xffffffc4 0xffffffc4 0xffffffc4 0xffffffc4 0xffffffc4 0xffffffc4 0xffffffc4 0xffffffc4 0xffffffc4 0xffffffc4 0xffffffc4 0xffffffc4 0xffffffc4 0xffffffc4 0xffffffc4 0xffffffc4 0xffffffc4 0xffffffc4 0xffffffc4 0xffffffc4 0xffffffc4 0xffffffc4 0xffffffc4 0xffffffc4 0xffffffc4 0xffffffc4 0xffffffc4 0xffffffc4 0xffffffc4 0xffffffc4 0xffffffc4 0xffffffc4 0xffffffc4 0xffffffc4 0xffffffc4 0xffffffc4 0xffffffc4 0xffffffc4 0xffffffc4 0xffffffc4 0xffffffc4 0xffffffc4 0xffffffc4 0xffffffc4 0xffffffc4 0xffffffc4 0xffffffc4 0xffffffc4 0xffffffc4 0xffffffc4 0xffffffc4 0xffffffc4 0xffffffc4 0xffffffc4 0xffffffc4 0xffffffc4 0xffffffc4 0xffffffc4 0xffffffc4 0xffffffc4 0xffffffc4 0xffffffc4 0xffffffc4 0xffffffc4 0xffffffc4 0xffffffc4 0xffffffc4 0xffffffc4 0xffffffc4 0xffffffc4 0xffffffc4 0xffffffc4 0xffffffc4 0xffffffc4 0xffffffc4 0xffffffc4 0xffffffc4 0xffffffc4 0xffffffc4 0xffffffc4 0xffffffc4 0xffffffc4 0xffffffc4 0xffffffc4 0xffffffc4 0xffffffc4 0xffffffc4 0xffffffc4 0xffffffc4 0xffffffc4 0xffffffc4 0xffffffc4 0xffffffc4 0xffffffc4 0xffffffc4 0xffffffc4 0xffffffc4 0xffffffc4 0xffffffc4 0xffffffc4 0xffffffc4 0xffffffc4 0xffffffc4 0xffffffc4 0xffffffc4 0xffffffc4 0xffffffc4 0xffffffc4 0xffffffc4 0xffffffc4 0xffffffc4 0xffffffc4 0xffffffc4 0xffffffc4 0xffffffc4 0xffffffc4 0xffffffc4 0xffffffc4 0xffffffc4 0xffffffc4 0xffffffc4 0xffffffc4 0xffffffc4 0xffffffc4 0xffffffc4 0xffffffc4 0xffffffc4 0xffffffc4 0xffffffc4 0xffffffc4 0xffffffc4 0xffffffc4 0xffffffc4 0xffffffc4 0xffffffc4 0xffffffc4 0xffffffc4 0xffffffc4 0xffffffc4 0xffffffc4 0xffffffc4 0xffffffc4 0xffffffc4 0xffffffc4 0xffffffc4 0xffffffc4 0xffffffc4 0xffffffc4 0xffffffc4 0xffffffc4 0xffffffc4 0xffffffc4 0xffffffc4 0xffffffc4 0xffffffc4 0xffffffc4 0xffffffc4 0xffffffc4 0xffffffc4 0xffffffc4 0xffffffc4 0xffffffc4 0xffffffc4 0xffffffc4 0xffffffc4 0xffffffc4 0xffffffc4 0xffffffc4 0xffffffc4 0xffffffc4 0xffffffc4 0xffffffc4 0xffffffc4 0xffffffc4 0xffffffc4 0xffffffc4 0xffffffc4 0xffffffc4 0xffffffc4 0xffffffc4 0xffffffc4 0xffffffc4 0xffffffc4 0xffffffc4 0xffffffc4 0xffffffc4 0xffffffc4 0xffffffc4 0xffffffc4 0xffffffc4 0xffffffc4 0xffffffc4 0xffffffc4 0xffffffc4 0xffffffc4 0xffffffc4 0xffffffc4 0xffffffc4 0xffffffc4 0xffffffc4 0xffffffc4 0xffffffc4 0xffffffc4 0xffffffc4 0xffffffc4 0xffffffc4 0xffffffc4 0xffffffc4 0xffffffc4 0xffffffc4 0xffffffc4 0xffffffc4 0xffffffc4 0xffffffc4 0xffffffc4 0xffffffc4 0xffffffc4 0xffffffc4 0xffffffc4 0xffffffc4 0xffffffc4 0xffffffc4 0xffffffc4 0xffffffc4 0xffffffc4 0xffffffc4 0xffffffc4 0xffffffc4 0xffffffc4 0xffffffc4 0xffffffc4 0xffffffc4 0xffffffc4 0xffffffc4 0xffffffc4 0xffffffc4 0xffffffc4 0xffffffc4 0xffffffc4 0xffffffc4 0xffffffc4 0xffffffc4 0xffffffc4 0xffffffc4 0xffffffc4 0xffffffc4 0xffffffc4 0xffffffc4 0xffffffc4 0xffffffc4 0xffffffc4 0xffffffc4 0xffffffc4 0xffffffc4 0xffffffc4 0xffffffc4 0xffffffc4 0xffffffc4 0xffffffc4 0xffffffc4 0xffffffc4 0xffffffc4 0xffffffc4 0xffffffc4 0xffffffc4 0xffffffc4 0xffffffc4 0xffffffc4 0xffffffc4 0xffffffc4 0xffffffc4 0xffffffc4 0xffffffc4 0xffffffc4 0xffffffc4 0xffffffc4 0xffffffc4 0xffffffc4 0xffffffc4 0xffffffc4 0xffffffc4 0xffffffc4 0xffffffc4 0xffffffc4 0xffffffc4 0xffffffc4 0xffffffc4 0xffffffc4 0xffffffc4 0xffffffc4 0xffffffc4 0xffffffc4 0xffffffc4 0xffffffc4 0xffffffc4 0xffffffc4 0xffffffc4 0xffffffc4 0xffffffc4 0xffffffc4 0xffffffc4 0xffffffc4 0xffffffc4 0xffffffc4 0xffffffc4 0xffffffc4 0xffffffc4 0xffffffc4 0xffffffc4 0xffffffc4 0xffffffc4 0xffffffc4 0xffffffc4 0xffffffc4 0xffffffc4 0xffffffc4 0xffffffc4 0xffffffc4 0xffffffc4 0xffffffc4 0xffffffc4 0xffffffc4 0xffffffc4 0xffffffc4 0xffffffc4 0xffffffc4 0xffffffc4 0xffffffc4 0xffffffc4 0xffffffc4 0xffffffc4 0xffffffc4 0xffffffc4 0xffffffc4 0xffffffc4 0xffffffc4 0xffffffc4 0xffffffc4 0xffffffc4 0xffffffc4 0xffffffc4 0xffffffc4 0xffffffc4 0xffffffc4 0xffffffc4 0xffffffc4 0xffffffc4 0xffffffc4 0xffffffc4 0xffffffc4 0xffffffc4 0xffffffc4 0xffffffc4 0xffffffc4 0xffffffc4 0xffffffc4 0xffffffc4 0xffffffc4 0xffffffc4 0xffffffc4 0xffffffc4 0xffffffc4 0xffffffc4 0xffffffc4 0xffffffc4 0xffffffc4 0xffffffc4 0xffffffc4 0xffffffc4 0xffffffc4 0xffffffc4 0xffffffc4 0xffffffc4 0xffffffc4 0xffffffc4 0xffffffc4 0xffffffc4 0xffffffc4 0xffffffc4 0xffffffc4 0xffffffc4 0xffffffc4 0xffffffc4 0xffffffc4 0xffffffc4 0xffffffc4 0xffffffc4 0xffffffc4 0xffffffc4 0xffffffc4 0xffffffc4 0xffffffc4 0xffffffc4 0xffffffc4 0xffffffc4 0xffffffc4 0xffffffc4 0xffffffc4 0xffffffc4 0xffffffc4 0xffffffc4 0xffffffc4 0xffffffc4 0xffffffc4 0xffffffc4 0xffffffc4 0xffffffc4 0xffffffc4 0xffffffc4 0xffffffc4 0xffffffc4 0xffffffc4 0xffffffc4 0xffffffc4 0xffffffc4 0xffffffc4 0xffffffc4 0xffffffc4 0xffffffc4 0xffffffc4 0xffffffc4 0xffffffc4 0xffffffc4 0xffffffc4 0xffffffc4 0xffffffc4 0xffffffc4 0xffffffc4 0xffffffc4 0xffffffc4 0xffffffc4 0xffffffc4 0xffffffc4 0xffffffc4 0xffffffc4 0xffffffc4 0xffffffc4 0xffffffc4 0xffffffc4 0xffffffc4 0xffffffc4 0xffffffc4 0xffffffc4 0xffffffc4 0xffffffc4 0xffffffc4 0xffffffc4 0xffffffc4 0xffffffc4 0xffffffc4 0xffffffc4 0xffffffc4 0xffffffc4 0xffffffc4 0xffffffc4 0xffffffc4 0xffffffc4 0xffffffc4 0xffffffc4 0xffffffc4 0xffffffc4 0xffffffc4 0xffffffc4 0xffffffc4 0xffffffc4 0xffffffc4 0xffffffc4 0xffffffc4 0xffffffc4 0xffffffc4 0xffffffc4 0xffffffc4 0xffffffc4 0xffffffc4 0xffffffc4 0xffffffc4 0xffffffc4 0xffffffc4 0xffffffc4 0xffffffc4 0xffffffc4 0xffffffc4 0xffffffc4 0xffffffc4 0xffffffc4 0xffffffc4 0xffffffc4 0xffffffc4 0xffffffc4 0xffffffc4 0xffffffc4 0xffffffc4 0xffffffc4 0xffffffc4 0xffffffc4 0xffffffc4 0xffffffc4 0xffffffc4 0xffffffc4 0xffffffc4 0xffffffc4 0xffffffc4 0xffffffc4 0xffffffc4 0xffffffc4 0xffffffc4 0xffffffc4 0xffffffc4 0xffffffc4 0xffffffc4 0xffffffc4 0xffffffc4 0xffffffc4 0xffffffc4 0xffffffc4 0xffffffc4 0xffffffc4 0xffffffc4 0xffffffc4 0xffffffc4 0xffffffc4 0xffffffc4 0xffffffc4 0xffffffc4 0xffffffc4 0xffffffc4 0xffffffc4 0xffffffc4 0xffffffc4 0xffffffc4 0xffffffc4 0xffffffc4 0xffffffc4 0xffffffc4 0xffffffc4 0xffffffc4 0xffffffc4 0xffffffc4 0xffffffc4 0xffffffc4 0xffffffc4 0xffffffc4 0xffffffc4 0xffffffc4 0xffffffc4 0xffffffc4 0xffffffc4 0xffffffc4 0xffffffc4 0xffffffc4 0xffffffc4 0xffffffc4 0xffffffc4 0xffffffc4 0xffffffc4 0xffffffc4 0xffffffc4 0xffffffc4 0xffffffc4 0xffffffc4 0xffffffc4 0xffffffc4 0xffffffc4 0xffffffc4 0xffffffc4 0xffffffc4 0xffffffc4 0xffffffc4 0xffffffc4 0xffffffc4 0xffffffc4 0xffffffc4 0xffffffc4 0xffffffc4 0xffffffc4 0xffffffc4 0xffffffc4 0xffffffc4 0xffffffc4 0xffffffc4 0xffffffc4 0xffffffc4 0xffffffc4 0xffffffc4 0xffffffc4 0xffffffc4 0xffffffc4 0xffffffc4 0xffffffc4 0xffffffc4 0xffffffc4 0xffffffc4 0xffffffc4 0xffffffc4 0xffffffc4 0xffffffc4 0xffffffc4 0xffffffc4 0xffffffc4 0xffffffc4 0xffffffc4 0xffffffc4 0xffffffc4 0xffffffc4 0xffffffc4 0xffffffc4 0xffffffc4 0xffffffc4 0xffffffc4 0xffffffc4 0xffffffc4 0xffffffc4 0xffffffc4 0xffffffc4 0xffffffc4 0xffffffc4 0xffffffc4 0xffffffc4 0xffffffc4 0xffffffc4 0xffffffc4 0xffffffc4 0xffffffc4 0xffffffc4 0xffffffc4 0xffffffc4 0xffffffc4 0xffffffc4 0xffffffc4 0xffffffc4 0xffffffc4 0xffffffc4 0xffffffc4 0xffffffc4 0xffffffc4 0xffffffc4 0xffffffc4 0xffffffc4 0xffffffc4 0xffffffc4 0xffffffc4 0xffffffc4 0xffffffc4 0xffffffc4 0xffffffc4 0xffffffc4 0xffffffc4 0xffffffc4 0xffffffc4 0xffffffc4 0xffffffc4 0xffffffc4 0xffffffc4 0xffffffc4 0xffffffc4 0xffffffc4 0xffffffc4 0xffffffc4 0xffffffc4 0xffffffc4 0xffffffc4 0xffffffc4 0xffffffc4 0xffffffc4 0xffffffc4 0xffffffc4 0xffffffc4 0xffffffc4 0xffffffc4 0xffffffc4 0xffffffc4 0xffffffc4 0xffffffc4 0xffffffc4 0xffffffc4 0xffffffc4 0xffffffc4 0xffffffc4 0xffffffc4 0xffffffc4 0xffffffc4 0xffffffc4 0xffffffc4 0xffffffc4 0xffffffc4 0xffffffc4 0xffffffc4 0xffffffc4 0xffffffc4 0xffffffc4 0xffffffc4 0xffffffc4 0xffffffc4 0xffffffc4 0xffffffc4 0xffffffc4 0xffffffc4 0xffffffc4 0xffffffc4 0xffffffc4 0xffffffc4 0xffffffc4 0xffffffc4 0xffffffc4 0xffffffc4 0xffffffc4 0xffffffc4 0xffffffc4 0xffffffc4 0xffffffc4 0xffffffc4 0xffffffc4 0xffffffc4 0xffffffc4 0xffffffc4 0xffffffc4 0xffffffc4 0xffffffc4 0xffffffc4 0xffffffc4 0xffffffc4 0xffffffc4 0xffffffc4 0xffffffc4 0xffffffc4 0xffffffc4 0xffffffc4 0xffffffc4 0xffffffc4 0xffffffc4 0xffffffc4 0xffffffc4 0xffffffc4 0xffffffc4 0xffffffc4 0xffffffc4 0xffffffc4 0xffffffc4 0xffffffc4 0xffffffc4 0xffffffc4 0xffffffc4 0xffffffc4 0xffffffc4 0xffffffc4 0xffffffc4 0xffffffc4 0xffffffc4 0xffffffc4 0xffffffc4 0xffffffc4 0xffffffc4 0xffffffc4 0xffffffc4 0xffffffc4 0xffffffc4 0xffffffc4 0xffffffc4 0xffffffc4 0xffffffc4 0xffffffc4 0xffffffc4 0xffffffc4 0xffffffc4 0xffffffc4 0xffffffc4 0xffffffc4 0xffffffc4 0xffffffc4 0xffffffc4 0xffffffc4 0xffffffc4 0xffffffc4 0xffffffc4 0xffffffc4 0xffffffc4 0xffffffc4 0xffffffc4 0xffffffc4 0xffffffc4 0xffffffc4 0xffffffc4 0xffffffc4 0xffffffc4 0xffffffc4 0xffffffc4 0xffffffc4 0xffffffc4 0xffffffc4 0xffffffc4 0xffffffc4 0xffffffc4 0xffffffc4 0xffffffc4 0xffffffc4 0xffffffc4 0xffffffc4 0xffffffc4 0xffffffc4 0xffffffc4 0xffffffc4 0xffffffc4 0xffffffc4 0xffffffc4 0xffffffc4 0xffffffc4 0xffffffc4 0xffffffc4 0xffffffc4 0xffffffc4 0xffffffc4 0xffffffc4 0xffffffc4 0xffffffc4 0xffffffc4 0xffffffc4 0xffffffc4 0xffffffc4 0xffffffc4 0xffffffc4 0xffffffc4 0xffffffc4 0xffffffc4 0xffffffc4 0xffffffc4 0xffffffc4 0xffffffc4 0xffffffc4 0xffffffc4 0xffffffc4 0xffffffc4 0xffffffc4 0xffffffc4 0xffffffc4 0xffffffc4 0xffffffc4 0xffffffc4 0xffffffc4 0xffffffc4 0xffffffc4 0xffffffc4 0xffffffc4 0xffffffc4 0xffffffc4 0xffffffc4 0xffffffc4 0xffffffc4 0xffffffc4 0xffffffc4 0xffffffc4 0xffffffc4 0xffffffc4 0xffffffc4 0xffffffc4 0xffffffc4 0xffffffc4 0xffffffc4 0xffffffc4 0xffffffc4 0xffffffc4 0xffffffc4 0xffffffc4 0xffffffc4 0xffffffc4 0xffffffc4 0xffffffc4 0xffffffc4 0xffffffc4 0xffffffc4 0xffffffc4 0xffffffc4 0xffffffc4 0xffffffc4 0xffffffc4 0xffffffc4 0xffffffc4 0xffffffc4 0xffffffc4 0xffffffc4 0xffffffc4 0xffffffc4 0xffffffc4 0xffffffc4 0xffffffc4 0xffffffc4 0xffffffc4 0xffffffc4 0xffffffc4 0xffffffc4 0xffffffc4 0xffffffc4 0xffffffc4 0xffffffc4 0xffffffc4 0xffffffc4 0xffffffc4 0xffffffc4 0xffffffc4 0xffffffc4 0xffffffc4 0xffffffc4 0xffffffc4 0xffffffc4 0xffffffc4 0xffffffc4 0xffffffc4 0xffffffc4 0xffffffc4 0xffffffc4 0xffffffc4 0xffffffc4 0xffffffc4 0xffffffc4 0xffffffc4 0xffffffc4 0xffffffc4 0xffffffc4 0xffffffc4 0xffffffc4 0xffffffc4 0xffffffc4 0xffffffc4 0xffffffc4 0xffffffc4 0xffffffc4 0xffffffc4 0xffffffc4 0xffffffc4 0xffffffc4 0xffffffc4 0xffffffc4 0xffffffc4 0xffffffc4 0xffffffc4 0xffffffc4 0xffffffc4 0xffffffc4 0xffffffc4 0xffffffc4 0xffffffc4 0xffffffc4 0xffffffc4 0xffffffc4 0xffffffc4 0xffffffc4 0xffffffc4 0xffffffc4 0xffffffc4 0xffffffc4 0xffffffc4 0xffffffc4 0xffffffc4 0xffffffc4 0xffffffc4 0xffffffc4 0xffffffc4 0xffffffc4 0xffffffc4 0xffffffc4 0xffffffc4 0xffffffc4 0xffffffc4 0xffffffc4 0xffffffc4 0xffffffc4 0xffffffc4 0xffffffc4 0xffffffc4 0xffffffc4 0xffffffc4 0xffffffc4 0xffffffc4 0xffffffc4 0xffffffc4 0xffffffc4 0xffffffc4 0xffffffc4 0xffffffc4 0xffffffc4 0xffffffc4 0xffffffc4 0xffffffc4 0xffffffc4 0xffffffc4 0xffffffc4 0xffffffc4 0xffffffc4 0xffffffc4 0xffffffc4 0xffffffc4 0xffffffc4 0xffffffc4 0xffffffc4 0xffffffc4 0xffffffc4 0xffffffc4 0xffffffc4 0xffffffc4 0xffffffc4 0xffffffc4 0xffffffc4 0xffffffc4 0xffffffc4 0xffffffc4 0xffffffc4 0xffffffc4 0xffffffc4 0xffffffc4 0xffffffc4 0xffffffc4 0xffffffc4 0xffffffc4 0xffffffc4 0xffffffc4 0xffffffc4 0xffffffc4 0xffffffc4 0xffffffc4 0xffffffc4 0xffffffc4 0xffffffc4 0xffffffc4 0xffffffc4 0xffffffc4 0xffffffc4 0xffffffc4 0xffffffc4 0xffffffc4 0xffffffc4 0xffffffc4 0xffffffc4 0xffffffc4 0xffffffc4 0xffffffc4 0xffffffc4 0xffffffc4 0xffffffc4 0xffffffc4 0xffffffc4 0xffffffc4 0xffffffc4 0xffffffc4 0xffffffc4 0xffffffc4 0xffffffc4 0xffffffc4 0xffffffc4 0xffffffc4 0xffffffc4 0xffffffc4 0xffffffc4 0xffffffc4 0xffffffc4 0xffffffc4 0xffffffc4 0xffffffc4 0xffffffc4 0xffffffc4 0xffffffc4 0xffffffc4 0xffffffc4 0xffffffc4 0xffffffc4 0xffffffc4 0xffffffc4 0xffffffc4 0xffffffc4 0xffffffc4 0xffffffc4 0xffffffc4 0xffffffc4 0xffffffc4 0xffffffc4 0xffffffc4 0xffffffc4 0xffffffc4 0xffffffc4 0xffffffc4 0xffffffc4 0xffffffc4 0xffffffc4 0xffffffc4 0xffffffc4 0xffffffc4 0xffffffc4 0xffffffc4 0xffffffc4 0xffffffc4 0xffffffc4 0xffffffc4 0xffffffc4 0xffffffc4 0xffffffc4 0xffffffc4 0xffffffc4 0xffffffc4 0xffffffc4 0xffffffc4 0xffffffc4 0xffffffc4 0xffffffc4 0xffffffc4 0xffffffc4 0xffffffc4 0xffffffc4 0xffffffc4 0xffffffc4 0xffffffc4 0xffffffc4 0xffffffc4 0xffffffc4 0xffffffc4 0xffffffc4 0xffffffc4 0xffffffc4 0xffffffc4 0xffffffc4 0xffffffc4 0xffffffc4 0xffffffc4 0xffffffc4 0xffffffc4 0xffffffc4 0xffffffc4 0xffffffc4 0xffffffc4 0xffffffc4 0xffffffc4 0xffffffc4 0xffffffc4 0xffffffc4 0xffffffc4 0xffffffc4 0xffffffc4 0xffffffc4 0xffffffc4 0xffffffc4 0xffffffc4 0xffffffc4 0xffffffc4 0xffffffc4 0xffffffc4 0xffffffc4 0xffffffc4 0xffffffc4 0xffffffc4 0xffffffc4 0xffffffc4 0xffffffc4 0xffffffc4 0xffffffc4 0xffffffc4 0xffffffc4 0xffffffc4 0xffffffc4 0xffffffc4 0xffffffc4 0xffffffc4 0xffffffc4 0xffffffc4 0xffffffc4 0xffffffc4 0xffffffc4 0xffffffc4 0xffffffc4 0xffffffc4 0xffffffc4 0xffffffc4 0xffffffc4 0xffffffc4 0xffffffc4 0xffffffc4 0xffffffc4 0xffffffc4 0xffffffc4 0xffffffc4 0xffffffc4 0xffffffc4 0xffffffc4 0xffffffc4 0xffffffc4 0xffffffc4 0xffffffc4 0xffffffc4 0xffffffc4 0xffffffc4 0xffffffc4 0xffffffc4 0xffffffc4 0xffffffc4 0xffffffc4 0xffffffc4 0xffffffc4 0xffffffc4 0xffffffc4 0xffffffc4 0xffffffc4 0xffffffc4 0xffffffc4 0xffffffc4 0xffffffc4 0xffffffc4 0xffffffc4 0xffffffc4 0xffffffc4 0xffffffc4 0xffffffc4 0xffffffc4 0xffffffc4 0xffffffc4 0xffffffc4 0xffffffc4 0xffffffc4 0xffffffc4 0xffffffc4 0xffffffc4 0xffffffc4 0xffffffc4 0xffffffc4 0xffffffc4 0xffffffc4 0xffffffc4 0xffffffc4 0xffffffc4 0xffffffc4 0xffffffc4 0xffffffc4 0xffffffc4 0xffffffc4 0xffffffc4 0xffffffc4 0xffffffc4 0xffffffc4 0xffffffc4 0xffffffc4 0xffffffc4 0xffffffc4 0xffffffc4 0xffffffc4 0xffffffc4 0xffffffc4 0xffffffc4 0xffffffc4 0xffffffc4 0xffffffc4 0xffffffc4 0xffffffc4 0xffffffc4 0xffffffc4 0xffffffc4 0xffffffc4 0xffffffc4 0xffffffc4 0xffffffc4 0xffffffc4 0xffffffc4 0xffffffc4 0xffffffc4 0xffffffc4 0xffffffc4 0xffffffc4 0xffffffc4 0xffffffc4 0xffffffc4 0xffffffc4 0xffffffc4 0xffffffc4 0xffffffc4 0xffffffc4 0xffffffc4 0xffffffc4 0xffffffc4 0xffffffc4 0xffffffc4 0xffffffc4 0xffffffc4 0xffffffc4 0xffffffc4 0xffffffc4 0xffffffc4 0xffffffc4 0xffffffc4 0xffffffc4 0xffffffc4 0xffffffc4 0xffffffc4 0xffffffc4 0xffffffc4 0xffffffc4 0xffffffc4 0xffffffc4 0xffffffc4 0xffffffc4 0xffffffc4 0xffffffc4 0xffffffc4 0xffffffc4 0xffffffc4 0xffffffc4 0xffffffc4 0xffffffc4 0xffffffc4 0xffffffc4 0xffffffc4 0xffffffc4 0xffffffc4 0xffffffc4 0xffffffc4 0xffffffc4 0xffffffc4 0xffffffc4 0xffffffc4 0xffffffc4 0xffffffc4 0xffffffc4 0xffffffc4 0xffffffc4 0xffffffc4 0xffffffc4 0xffffffc4 0xffffffc4 0xffffffc4 0xffffffc4 0xffffffc4 0xffffffc4 0xffffffc4 0xffffffc4 0xffffffc4 0xffffffc4 0xffffffc4 0xffffffc4 0xffffffc4 0xffffffc4 0xffffffc4 0xffffffc4 0xffffffc4 0xffffffc4 0xffffffc4>;
				pt11_lo_limits_cols_01 = <0x26>;
				pt11_lo_limits_cols_02 = <0x26>;
				pt11_lo_limits_row_01 = <0x26>;
				pt11_lo_limits_row_02 = <0x26>;
				pt7_hi_limits_01 = <0x5dc 0x5dc 0x5dc 0x5dc 0x5dc 0x5dc 0x5dc 0x5dc 0x5dc 0x5dc 0x5dc 0x5dc 0x5dc 0x5dc 0x5dc 0x5dc 0x5dc 0x5dc 0x5dc 0x5dc 0x5dc 0x5dc 0x5dc 0x5dc 0x5dc 0x5dc 0x5dc 0x5dc 0x5dc 0x5dc 0x5dc 0x5dc 0x5dc 0x5dc 0x5dc 0x5dc 0x5dc 0x5dc 0x5dc 0x5dc 0x5dc 0x5dc 0x5dc 0x5dc 0x5dc 0x5dc 0x5dc 0x5dc 0x5dc 0x5dc 0x5dc 0x5dc 0x5dc 0x5dc 0x5dc 0x5dc 0x5dc 0x5dc 0x5dc 0x5dc 0x5dc 0x5dc 0x5dc 0x5dc 0x5dc 0x5dc 0x5dc 0x5dc 0x5dc 0x5dc 0x5dc 0x5dc 0x5dc 0x5dc 0x5dc 0x5dc 0x5dc 0x5dc 0x5dc 0x5dc 0x5dc 0x5dc 0x5dc 0x5dc 0x5dc 0x5dc 0x5dc 0x5dc 0x5dc 0x5dc 0x5dc 0x5dc 0x5dc 0x5dc 0x5dc 0x5dc 0x5dc 0x5dc 0x5dc 0x5dc 0x5dc 0x5dc 0x5dc 0x5dc 0x5dc 0x5dc 0x5dc 0x5dc 0x5dc 0x5dc 0x5dc 0x5dc 0x5dc 0x5dc 0x5dc 0x5dc 0x5dc 0x5dc 0x5dc 0x5dc 0x5dc 0x5dc 0x5dc 0x5dc 0x5dc 0x5dc 0x5dc 0x5dc 0x5dc 0x5dc 0x5dc 0x5dc 0x5dc 0x5dc 0x5dc 0x5dc 0x5dc 0x5dc 0x5dc 0x5dc 0x5dc 0x5dc 0x5dc 0x5dc 0x5dc 0x5dc 0x5dc 0x5dc 0x5dc 0x5dc 0x5dc 0x5dc 0x5dc 0x5dc 0x5dc 0x5dc 0x5dc 0x5dc 0x5dc 0x5dc 0x5dc 0x5dc 0x5dc 0x5dc 0x5dc 0x5dc 0x5dc 0x5dc 0x5dc 0x5dc 0x5dc 0x5dc 0x5dc 0x5dc 0x5dc 0x5dc 0x5dc 0x5dc 0x5dc 0x5dc 0x5dc 0x5dc 0x5dc 0x5dc 0x5dc 0x5dc 0x5dc 0x5dc 0x5dc 0x5dc 0x5dc 0x5dc 0x5dc 0x5dc 0x5dc 0x5dc 0x5dc 0x5dc 0x5dc 0x5dc 0x5dc 0x5dc 0x5dc 0x5dc 0x5dc 0x5dc 0x5dc 0x5dc 0x5dc 0x5dc 0x5dc 0x5dc 0x5dc 0x5dc 0x5dc 0x5dc 0x5dc 0x5dc 0x5dc 0x5dc 0x5dc 0x5dc 0x5dc 0x5dc 0x5dc 0x5dc 0x5dc 0x5dc 0x5dc 0x5dc 0x5dc 0x5dc 0x5dc 0x5dc 0x5dc 0x5dc 0x5dc 0x5dc 0x5dc 0x5dc 0x5dc 0x5dc 0x5dc 0x5dc 0x5dc 0x5dc 0x5dc 0x5dc 0x5dc 0x5dc 0x5dc 0x5dc 0x5dc 0x5dc 0x5dc 0x5dc 0x5dc 0x5dc 0x5dc 0x5dc 0x5dc 0x5dc 0x5dc 0x5dc 0x5dc 0x5dc 0x5dc 0x5dc 0x5dc 0x5dc 0x5dc 0x5dc 0x5dc 0x5dc 0x5dc 0x5dc 0x5dc 0x5dc 0x5dc 0x5dc 0x5dc 0x5dc 0x5dc 0x5dc 0x5dc 0x5dc 0x5dc 0x5dc 0x5dc 0x5dc 0x5dc 0x5dc 0x5dc 0x5dc 0x5dc 0x5dc 0x5dc 0x5dc 0x5dc 0x5dc 0x5dc 0x5dc 0x5dc 0x5dc 0x5dc 0x5dc 0x5dc 0x5dc 0x5dc 0x5dc 0x5dc 0x5dc 0x5dc 0x5dc 0x5dc 0x5dc 0x5dc 0x5dc 0x5dc 0x5dc 0x5dc 0x5dc 0x5dc 0x5dc 0x5dc 0x5dc 0x5dc 0x5dc 0x5dc 0x5dc 0x5dc 0x5dc 0x5dc 0x5dc 0x5dc 0x5dc 0x5dc 0x5dc 0x5dc 0x5dc 0x5dc 0x5dc 0x5dc 0x5dc 0x5dc 0x5dc 0x5dc 0x5dc 0x5dc 0x5dc 0x5dc 0x5dc 0x5dc 0x5dc 0x5dc 0x5dc 0x5dc 0x5dc 0x5dc 0x5dc 0x5dc 0x5dc 0x5dc 0x5dc 0x5dc 0x5dc 0x5dc 0x5dc 0x5dc 0x5dc 0x5dc 0x5dc 0x5dc 0x5dc 0x5dc 0x5dc 0x5dc 0x5dc 0x5dc 0x5dc 0x5dc 0x5dc 0x5dc 0x5dc 0x5dc 0x5dc 0x5dc 0x5dc 0x5dc 0x5dc 0x5dc 0x5dc 0x5dc 0x5dc 0x5dc 0x5dc 0x5dc 0x5dc 0x5dc 0x5dc 0x5dc 0x5dc 0x5dc 0x5dc 0x5dc 0x5dc 0x5dc 0x5dc 0x5dc 0x5dc 0x5dc 0x5dc 0x5dc 0x5dc 0x5dc 0x5dc 0x5dc 0x5dc 0x5dc 0x5dc 0x5dc 0x5dc 0x5dc 0x5dc 0x5dc 0x5dc 0x5dc 0x5dc 0x5dc 0x5dc 0x5dc 0x5dc 0x5dc 0x5dc 0x5dc 0x5dc 0x5dc 0x5dc 0x5dc 0x5dc 0x5dc 0x5dc 0x5dc 0x5dc 0x5dc 0x5dc 0x5dc 0x5dc 0x5dc 0x5dc 0x5dc 0x5dc 0x5dc 0x5dc 0x5dc 0x5dc 0x5dc 0x5dc 0x5dc 0x5dc 0x5dc 0x5dc 0x5dc 0x5dc 0x5dc 0x5dc 0x5dc 0x5dc 0x5dc 0x5dc 0x5dc 0x5dc 0x5dc 0x5dc 0x5dc 0x5dc 0x5dc 0x5dc 0x5dc 0x5dc 0x5dc 0x5dc 0x5dc 0x5dc 0x5dc 0x5dc 0x5dc 0x5dc 0x5dc 0x5dc 0x5dc 0x5dc 0x5dc 0x5dc 0x5dc 0x5dc 0x5dc 0x5dc 0x5dc 0x5dc 0x5dc 0x5dc 0x5dc 0x5dc 0x5dc 0x5dc 0x5dc 0x5dc 0x5dc 0x5dc 0x5dc 0x5dc 0x5dc 0x5dc 0x5dc 0x5dc 0x5dc 0x5dc 0x5dc 0x5dc 0x5dc 0x5dc 0x5dc 0x5dc 0x5dc 0x5dc 0x5dc 0x5dc 0x5dc 0x5dc 0x5dc 0x5dc 0x5dc 0x5dc 0x5dc 0x5dc 0x5dc 0x5dc 0x5dc 0x5dc 0x5dc 0x5dc 0x5dc 0x5dc 0x5dc 0x5dc 0x5dc 0x5dc 0x5dc 0x5dc 0x5dc 0x5dc 0x5dc 0x5dc 0x5dc 0x5dc 0x5dc 0x5dc 0x5dc 0x5dc 0x5dc 0x5dc 0x5dc 0x5dc 0x5dc 0x5dc 0x5dc 0x5dc 0x5dc 0x5dc 0x5dc 0x5dc 0x5dc 0x5dc 0x5dc 0x5dc 0x5dc 0x5dc 0x5dc 0x5dc 0x5dc 0x5dc 0x5dc 0x5dc 0x5dc 0x5dc 0x5dc 0x5dc 0x5dc 0x5dc 0x5dc 0x5dc 0x5dc 0x5dc 0x5dc 0x5dc 0x5dc 0x5dc 0x5dc 0x5dc 0x5dc 0x5dc 0x5dc 0x5dc 0x5dc 0x5dc 0x5dc 0x5dc 0x5dc 0x5dc 0x5dc 0x5dc 0x5dc 0x5dc 0x5dc 0x5dc 0x5dc 0x5dc 0x5dc 0x5dc 0x5dc 0x5dc 0x5dc 0x5dc 0x5dc 0x5dc 0x5dc 0x5dc 0x5dc 0x5dc 0x5dc 0x5dc 0x5dc 0x5dc 0x5dc 0x5dc 0x5dc 0x5dc 0x5dc 0x5dc 0x5dc 0x5dc 0x5dc 0x5dc 0x5dc 0x5dc 0x5dc 0x5dc 0x5dc 0x5dc 0x5dc 0x5dc 0x5dc 0x5dc 0x5dc 0x5dc 0x5dc 0x5dc 0x5dc 0x5dc 0x5dc 0x5dc 0x5dc 0x5dc 0x5dc 0x5dc 0x5dc 0x5dc 0x5dc 0x5dc 0x5dc 0x5dc 0x5dc 0x5dc 0x5dc 0x5dc 0x5dc 0x5dc 0x5dc 0x5dc 0x5dc 0x5dc 0x5dc 0x5dc 0x5dc 0x5dc 0x5dc 0x5dc 0x5dc 0x5dc 0x5dc 0x5dc 0x5dc 0x5dc 0x5dc 0x5dc 0x5dc 0x5dc 0x5dc 0x5dc 0x5dc 0x5dc 0x5dc 0x5dc 0x5dc 0x5dc 0x5dc 0x5dc 0x5dc 0x5dc 0x5dc 0x5dc 0x5dc 0x5dc 0x5dc 0x5dc 0x5dc 0x5dc 0x5dc 0x5dc 0x5dc 0x5dc 0x5dc 0x5dc 0x5dc 0x5dc 0x5dc 0x5dc 0x5dc 0x5dc 0x5dc 0x5dc 0x5dc 0x5dc 0x5dc 0x5dc 0x5dc 0x5dc 0x5dc 0x5dc 0x5dc 0x5dc 0x5dc 0x5dc 0x5dc 0x5dc 0x5dc 0x5dc 0x5dc 0x5dc 0x5dc 0x5dc 0x5dc 0x5dc 0x5dc 0x5dc 0x5dc 0x5dc 0x5dc 0x5dc 0x5dc 0x5dc 0x5dc 0x5dc 0x5dc 0x5dc 0x5dc 0x5dc 0x5dc 0x5dc 0x5dc 0x5dc 0x5dc 0x5dc 0x5dc 0x5dc 0x5dc 0x5dc 0x5dc 0x5dc 0x5dc 0x5dc 0x5dc 0x5dc 0x5dc 0x5dc 0x5dc 0x5dc 0x5dc 0x5dc 0x5dc 0x5dc 0x5dc 0x5dc 0x5dc 0x5dc 0x5dc 0x5dc 0x5dc 0x5dc 0x5dc 0x5dc 0x5dc 0x5dc 0x5dc 0x5dc 0x5dc 0x5dc 0x5dc 0x5dc 0x5dc 0x5dc 0x5dc 0x5dc 0x5dc 0x5dc 0x5dc 0x5dc 0x5dc 0x5dc 0x5dc 0x5dc 0x5dc 0x5dc 0x5dc 0x5dc 0x5dc 0x5dc 0x5dc 0x5dc 0x5dc 0x5dc 0x5dc 0x5dc 0x5dc 0x5dc 0x5dc 0x5dc 0x5dc 0x5dc 0x5dc 0x5dc 0x5dc 0x5dc 0x5dc 0x5dc 0x5dc 0x5dc 0x5dc 0x5dc 0x5dc 0x5dc 0x5dc 0x5dc 0x5dc 0x5dc 0x5dc 0x5dc 0x5dc 0x5dc 0x5dc 0x5dc 0x5dc 0x5dc 0x5dc 0x5dc 0x5dc 0x5dc 0x5dc 0x5dc 0x5dc 0x5dc 0x5dc 0x5dc 0x5dc 0x5dc 0x5dc 0x5dc 0x5dc 0x5dc 0x5dc 0x5dc 0x5dc 0x5dc 0x5dc 0x5dc 0x5dc 0x5dc 0x5dc 0x5dc 0x5dc 0x5dc 0x5dc 0x5dc 0x5dc 0x5dc 0x5dc 0x5dc 0x5dc 0x5dc 0x5dc 0x5dc 0x5dc 0x5dc 0x5dc 0x5dc 0x5dc 0x5dc 0x5dc 0x5dc 0x5dc 0x5dc 0x5dc 0x5dc 0x5dc 0x5dc 0x5dc 0x5dc 0x5dc 0x5dc 0x5dc 0x5dc 0x5dc 0x5dc 0x5dc 0x5dc 0x5dc 0x5dc 0x5dc 0x5dc 0x5dc 0x5dc 0x5dc 0x5dc 0x5dc 0x5dc 0x5dc 0x5dc 0x5dc 0x5dc 0x5dc 0x5dc 0x5dc 0x5dc 0x5dc 0x5dc 0x5dc 0x5dc 0x5dc 0x5dc 0x5dc 0x5dc 0x5dc 0x5dc 0x5dc 0x5dc 0x5dc 0x5dc 0x5dc 0x5dc 0x5dc 0x5dc 0x5dc 0x5dc 0x5dc 0x5dc 0x5dc 0x5dc 0x5dc 0x5dc 0x5dc 0x5dc 0x5dc 0x5dc 0x5dc 0x5dc 0x5dc 0x5dc 0x5dc 0x5dc 0x5dc 0x5dc 0x5dc 0x5dc 0x5dc 0x5dc 0x5dc 0x5dc 0x5dc 0x5dc 0x5dc 0x5dc 0x5dc 0x5dc 0x5dc 0x5dc 0x5dc 0x5dc 0x5dc 0x5dc 0x5dc 0x5dc 0x5dc 0x5dc 0x5dc 0x5dc 0x5dc 0x5dc 0x5dc 0x5dc 0x5dc 0x5dc 0x5dc 0x5dc 0x5dc 0x5dc 0x5dc 0x5dc 0x5dc 0x5dc 0x5dc 0x5dc 0x5dc 0x5dc 0x5dc 0x5dc 0x5dc 0x5dc 0x5dc 0x5dc 0x5dc 0x5dc 0x5dc 0x5dc 0x5dc 0x5dc 0x5dc 0x5dc 0x5dc 0x5dc 0x5dc 0x5dc 0x5dc 0x5dc 0x5dc 0x5dc 0x5dc 0x5dc 0x5dc 0x5dc 0x5dc 0x5dc 0x5dc 0x5dc 0x5dc 0x5dc 0x5dc 0x5dc 0x5dc 0x5dc 0x5dc 0x5dc 0x5dc 0x5dc 0x5dc 0x5dc 0x5dc 0x5dc 0x5dc 0x5dc 0x5dc 0x5dc 0x5dc 0x5dc 0x5dc 0x5dc 0x5dc 0x5dc 0x5dc 0x5dc 0x5dc 0x5dc 0x5dc 0x5dc 0x5dc 0x5dc 0x5dc 0x5dc 0x5dc 0x5dc 0x5dc 0x5dc 0x5dc 0x5dc 0x5dc 0x5dc 0x5dc 0x5dc 0x5dc 0x5dc 0x5dc 0x5dc 0x5dc 0x5dc 0x5dc 0x5dc 0x5dc 0x5dc 0x5dc 0x5dc 0x5dc 0x5dc 0x5dc 0x5dc 0x5dc 0x5dc 0x5dc 0x5dc 0x5dc 0x5dc 0x5dc 0x5dc 0x5dc 0x5dc 0x5dc 0x5dc 0x5dc 0x5dc 0x5dc 0x5dc 0x5dc 0x5dc 0x5dc 0x5dc 0x5dc 0x5dc 0x5dc 0x5dc 0x5dc 0x5dc 0x5dc 0x5dc 0x5dc 0x5dc 0x5dc 0x5dc 0x5dc 0x5dc 0x5dc 0x5dc 0x5dc 0x5dc 0x5dc 0x5dc 0x5dc 0x5dc 0x5dc 0x5dc 0x5dc 0x5dc 0x5dc 0x5dc 0x5dc 0x5dc 0x5dc 0x5dc 0x5dc 0x5dc 0x5dc 0x5dc 0x5dc 0x5dc 0x5dc 0x5dc 0x5dc 0x5dc 0x5dc 0x5dc 0x5dc 0x5dc 0x5dc 0x5dc 0x5dc 0x5dc 0x5dc 0x5dc 0x5dc 0x5dc 0x5dc 0x5dc 0x5dc 0x5dc 0x5dc 0x5dc 0x5dc 0x5dc 0x5dc 0x5dc 0x5dc 0x5dc 0x5dc 0x5dc 0x1 0x1f4 0x5dc 0x5dc 0x5dc 0x5dc 0x5dc 0x5dc 0x5dc 0x5dc 0x5dc 0x5dc 0x5dc 0x5dc 0x5dc 0x5dc 0x5dc 0x5dc 0x5dc 0x5dc 0x5dc 0x5dc 0x5dc 0x5dc 0x5dc 0x5dc 0x5dc 0x5dc 0x5dc 0x5dc 0x5dc 0x5dc 0x5dc 0x5dc 0x5dc 0x5dc 0x5dc 0x5dc 0x5dc 0x5dc 0x5dc 0x5dc 0x5dc 0x5dc 0x5dc 0x5dc 0x5dc 0x5dc 0x5dc 0x5dc 0x5dc 0x5dc 0x5dc 0x5dc 0x5dc 0x5dc 0x5dc 0x5dc 0x5dc 0x5dc 0x5dc 0x5dc 0x5dc 0x5dc 0x5dc 0x5dc 0x5dc 0x5dc 0x5dc 0x5dc 0x5dc 0x5dc 0x5dc 0x5dc 0x5dc 0x5dc 0x5dc 0x5dc 0x5dc 0x5dc 0x5dc 0x5dc 0x5dc 0x5dc 0x5dc 0x5dc 0x5dc 0x5dc 0x5dc 0x5dc 0x5dc 0x5dc 0x5dc 0x5dc 0x5dc 0x5dc 0x5dc 0x5dc 0x5dc 0x5dc 0x5dc 0x5dc 0x5dc 0x5dc 0x5dc 0x5dc 0x5dc 0x5dc 0x5dc 0x5dc 0x5dc 0x5dc 0x5dc 0x5dc 0x5dc 0x5dc 0x5dc 0x5dc 0x5dc 0x5dc 0x5dc 0x5dc 0x5dc 0x5dc 0x5dc 0x5dc 0x5dc 0x5dc 0x5dc 0x5dc 0x5dc 0x5dc 0x5dc 0x5dc 0x5dc 0x5dc 0x4e20 0x4e20 0x5dc 0x5dc 0x5dc 0x5dc 0x5dc 0x5dc 0x5dc 0x5dc 0x5dc 0x5dc 0x5dc 0x5dc 0x5dc 0x5dc 0x5dc 0x5dc 0x5dc 0x5dc 0x5dc 0x5dc 0x5dc 0x5dc 0x5dc 0x5dc 0x5dc 0x5dc 0x5dc 0x5dc 0x5dc 0x5dc 0x5dc 0x5dc 0x5dc 0x5dc 0x5dc 0x5dc 0x5dc 0x5dc 0x5dc 0x5dc 0x5dc 0x5dc 0x5dc 0x5dc 0x5dc 0x5dc 0x5dc 0x5dc 0x5dc 0x5dc 0x5dc 0x5dc 0x5dc 0x5dc 0x5dc 0x5dc 0x5dc 0x5dc 0x5dc 0x5dc 0x5dc 0x5dc 0x5dc 0x5dc 0x5dc 0x5dc 0x5dc 0x5dc 0x5dc 0x5dc 0x5dc 0x5dc 0x5dc 0x5dc 0x5dc 0x5dc 0x5dc 0x5dc 0x5dc 0x5dc 0x5dc 0x5dc 0x5dc 0x5dc 0x5dc 0x5dc 0x5dc 0x5dc 0x5dc 0x5dc 0x5dc 0x5dc 0x5dc 0x5dc 0x5dc 0x5dc 0x5dc 0x5dc 0x5dc 0x5dc 0x5dc 0x5dc 0x5dc 0x5dc 0x5dc>;
				pt7_hi_limits_02 = <0x514 0x514 0x514 0x514 0x514 0x514 0x514 0x514 0x514 0x514 0x514 0x514 0x514 0x514 0x514 0x514 0x514 0x514 0x514 0x514 0x514 0x514 0x514 0x514 0x514 0x514 0x514 0x514 0x514 0x514 0x514 0x514 0x514 0x514 0x514 0x514 0x514 0x514 0x514 0x514 0x514 0x514 0x514 0x514 0x514 0x514 0x514 0x514 0x514 0x514 0x514 0x514 0x514 0x514 0x514 0x514 0x514 0x514 0x514 0x514 0x514 0x514 0x514 0x514 0x514 0x514 0x514 0x514 0x514 0x514 0x514 0x514 0x514 0x514 0x514 0x514 0x514 0x514 0x514 0x514 0x514 0x514 0x514 0x514 0x514 0x514 0x514 0x514 0x514 0x514 0x514 0x514 0x514 0x514 0x514 0x514 0x514 0x514 0x514 0x514 0x514 0x514 0x514 0x514 0x514 0x514 0x514 0x514 0x514 0x514 0x514 0x514 0x514 0x514 0x514 0x514 0x514 0x514 0x514 0x514 0x514 0x514 0x514 0x514 0x514 0x514 0x514 0x514 0x514 0x514 0x514 0x514 0x514 0x514 0x514 0x514 0x514 0x514 0x514 0x514 0x514 0x514 0x514 0x514 0x514 0x514 0x514 0x514 0x514 0x514 0x514 0x514 0x514 0x514 0x514 0x514 0x514 0x514 0x514 0x514 0x514 0x514 0x514 0x514 0x514 0x514 0x514 0x514 0x514 0x514 0x514 0x514 0x514 0x514 0x514 0x514 0x514 0x514 0x514 0x514 0x514 0x514 0x514 0x514 0x514 0x514 0x514 0x514 0x514 0x514 0x514 0x514 0x514 0x514 0x514 0x514 0x514 0x514 0x514 0x514 0x514 0x514 0x514 0x514 0x514 0x514 0x514 0x514 0x514 0x514 0x514 0x514 0x514 0x514 0x514 0x514 0x514 0x514 0x514 0x514 0x514 0x514 0x514 0x514 0x514 0x514 0x514 0x514 0x514 0x514 0x514 0x514 0x514 0x514 0x514 0x514 0x514 0x514 0x514 0x514 0x514 0x514 0x514 0x514 0x514 0x514 0x514 0x514 0x514 0x514 0x514 0x514 0x514 0x514 0x514 0x514 0x514 0x514 0x514 0x514 0x514 0x514 0x514 0x514 0x514 0x514 0x514 0x514 0x514 0x514 0x514 0x514 0x514 0x514 0x514 0x514 0x514 0x514 0x514 0x514 0x514 0x514 0x514 0x514 0x514 0x514 0x514 0x514 0x514 0x514 0x514 0x514 0x514 0x514 0x514 0x514 0x514 0x514 0x514 0x514 0x514 0x514 0x514 0x514 0x514 0x514 0x514 0x514 0x514 0x514 0x514 0x514 0x514 0x514 0x514 0x514 0x514 0x514 0x514 0x514 0x514 0x514 0x514 0x514 0x514 0x514 0x514 0x514 0x514 0x514 0x514 0x514 0x514 0x514 0x514 0x514 0x514 0x514 0x514 0x514 0x514 0x514 0x514 0x514 0x514 0x514 0x514 0x514 0x514 0x514 0x514 0x514 0x514 0x514 0x514 0x514 0x514 0x514 0x514 0x514 0x514 0x514 0x514 0x514 0x514 0x514 0x514 0x514 0x514 0x514 0x514 0x514 0x514 0x514 0x514 0x514 0x514 0x514 0x514 0x514 0x514 0x514 0x514 0x514 0x514 0x514 0x514 0x514 0x514 0x514 0x514 0x514 0x514 0x514 0x514 0x514 0x514 0x514 0x514 0x514 0x514 0x514 0x514 0x514 0x514 0x514 0x514 0x514 0x514 0x514 0x514 0x514 0x514 0x514 0x514 0x514 0x514 0x514 0x514 0x514 0x514 0x514 0x514 0x514 0x514 0x514 0x514 0x514 0x514 0x514 0x514 0x514 0x514 0x514 0x514 0x514 0x514 0x514 0x514 0x514 0x514 0x514 0x514 0x514 0x514 0x514 0x514 0x514 0x514 0x514 0x514 0x514 0x514 0x514 0x514 0x514 0x514 0x514 0x514 0x514 0x514 0x514 0x514 0x514 0x514 0x514 0x514 0x514 0x514 0x514 0x514 0x514 0x514 0x514 0x514 0x514 0x514 0x514 0x514 0x514 0x514 0x514 0x514 0x514 0x514 0x514 0x514 0x514 0x514 0x514 0x514 0x514 0x514 0x514 0x514 0x514 0x514 0x514 0x514 0x514 0x514 0x514 0x514 0x514 0x514 0x514 0x514 0x514 0x514 0x514 0x514 0x514 0x514 0x514 0x514 0x514 0x514 0x514 0x514 0x514 0x514 0x514 0x514 0x514 0x514 0x514 0x514 0x514 0x514 0x514 0x514 0x514 0x514 0x514 0x514 0x514 0x514 0x514 0x514 0x514 0x514 0x514 0x514 0x514 0x514 0x514 0x514 0x514 0x514 0x514 0x514 0x514 0x514 0x514 0x514 0x514 0x514 0x514 0x514 0x514 0x514 0x514 0x514 0x514 0x514 0x514 0x514 0x514 0x514 0x514 0x514 0x514 0x514 0x514 0x514 0x514 0x514 0x514 0x514 0x514 0x514 0x514 0x514 0x514 0x514 0x514 0x514 0x514 0x514 0x514 0x514 0x514 0x514 0x514 0x514 0x514 0x514 0x514 0x514 0x514 0x514 0x514 0x514 0x514 0x514 0x514 0x514 0x514 0x514 0x514 0x514 0x514 0x514 0x514 0x514 0x514 0x514 0x514 0x514 0x514 0x514 0x514 0x514 0x514 0x514 0x514 0x514 0x514 0x514 0x514 0x514 0x514 0x514 0x514 0x514 0x514 0x514 0x514 0x514 0x514 0x514 0x514 0x514 0x514 0x514 0x514 0x514 0x514 0x514 0x514 0x514 0x514 0x514 0x514 0x514 0x514 0x514 0x514 0x514 0x514 0x514 0x514 0x514 0x514 0x514 0x514 0x514 0x514 0x514 0x514 0x514 0x514 0x514 0x514 0x514 0x514 0x514 0x514 0x514 0x514 0x514 0x514 0x514 0x514 0x514 0x514 0x514 0x514 0x514 0x514 0x514 0x514 0x514 0x514 0x514 0x514 0x514 0x514 0x514 0x514 0x514 0x514 0x514 0x514 0x514 0x514 0x514 0x514 0x514 0x514 0x514 0x514 0x514 0x514 0x514 0x514 0x514 0x514 0x514 0x514 0x514 0x514 0x514 0x514 0x514 0x514 0x514 0x514 0x514 0x514 0x514 0x514 0x514 0x514 0x514 0x514 0x514 0x514 0x514 0x514 0x514 0x514 0x514 0x514 0x514 0x514 0x514 0x514 0x514 0x514 0x514 0x514 0x514 0x514 0x514 0x514 0x514 0x514 0x514 0x514 0x514 0x514 0x514 0x514 0x514 0x514 0x514 0x514 0x514 0x514 0x514 0x514 0x514 0x514 0x514 0x514 0x514 0x514 0x514 0x514 0x514 0x514 0x514 0x514 0x514 0x514 0x514 0x514 0x514 0x514 0x514 0x514 0x514 0x514 0x514 0x514 0x514 0x514 0x514 0x514 0x514 0x514 0x514 0x514 0x514 0x514 0x514 0x514 0x514 0x514 0x514 0x514 0x514 0x514 0x514 0x514 0x514 0x514 0x514 0x514 0x514 0x514 0x514 0x514 0x514 0x514 0x514 0x514 0x514 0x514 0x514 0x514 0x514 0x514 0x514 0x514 0x514 0x514 0x514 0x514 0x514 0x514 0x514 0x514 0x514 0x514 0x514 0x514 0x514 0x514 0x514 0x514 0x514 0x514 0x514 0x514 0x514 0x514 0x514 0x514 0x514 0x514 0x514 0x514 0x514 0x514 0x514 0x514 0x514 0x514 0x514 0x514 0x514 0x514 0x514 0x514 0x514 0x514 0x514 0x514 0x514 0x514 0x514 0x514 0x514 0x514 0x514 0x514 0x514 0x514 0x514 0x514 0x514 0x514 0x514 0x514 0x514 0x514 0x514 0x514 0x514 0x514 0x514 0x514 0x514 0x514 0x514 0x514 0x514 0x514 0x514 0x514 0x514 0x514 0x514 0x514 0x514 0x514 0x514 0x514 0x514 0x514 0x514 0x514 0x514 0x514 0x514 0x514 0x514 0x514 0x514 0x514 0x514 0x514 0x514 0x514 0x514 0x514 0x514 0x514 0x514 0x514 0x514 0x514 0x514 0x514 0x514 0x514 0x514 0x514 0x514 0x514 0x514 0x514 0x514 0x514 0x514 0x514 0x514 0x514 0x514 0x514 0x514 0x514 0x514 0x514 0x514 0x514 0x514 0x514 0x514 0x514 0x514 0x514 0x514 0x514 0x514 0x514 0x514 0x514 0x514 0x514 0x514 0x514 0x514 0x514 0x514 0x514 0x514 0x514 0x514 0x514 0x514 0x514 0x514 0x514 0x514 0x514 0x514 0x514 0x514 0x514 0x514 0x514 0x514 0x514 0x514 0x514 0x514 0x514 0x514 0x514 0x514 0x514 0x514 0x514 0x514 0x514 0x514 0x514 0x514 0x514 0x514 0x514 0x514 0x514 0x514 0x514 0x514 0x514 0x514 0x514 0x514 0x514 0x514 0x514 0x514 0x514 0x514 0x514 0x514 0x514 0x514 0x514 0x514 0x514 0x514 0x514 0x514 0x514 0x514 0x514 0x514 0x514 0x514 0x514 0x514 0x514 0x514 0x514 0x514 0x514 0x514 0x514 0x514 0x514 0x514 0x514 0x514 0x514 0x514 0x514 0x514 0x514 0x514 0x514 0x514 0x514 0x514 0x514 0x514 0x514 0x514 0x514 0x514 0x514 0x514 0x514 0x514 0x514 0x514 0x514 0x514 0x514 0x514 0x514 0x514 0x514 0x514 0x514 0x514 0x514 0x514 0x514 0x514 0x514 0x514 0x514 0x514 0x514 0x514 0x514 0x514 0x514 0x514 0x514 0x514 0x514 0x514 0x514 0x514 0x514 0x514 0x514 0x514 0x514 0x514 0x514 0x514 0x514 0x514 0x514 0x514 0x514 0x514 0x514 0x514 0x514 0x514 0x514 0x514 0x514 0x514 0x514 0x514 0x514 0x514 0x514 0x514 0x514 0x514 0x514 0x514 0x514 0x514 0x514 0x514 0x514 0x514 0x514 0x514 0x514 0x514 0x514 0x514 0x514 0x514 0x514 0x514 0x514 0x514 0x514 0x514 0x514 0x514 0x514 0x514 0x514 0x514 0x514 0x514 0x514 0x514 0x514 0x514 0x514 0x514 0x514 0x514 0x514 0x514 0x514 0x514 0x514 0x514 0x514 0x514 0x514 0x514 0x514 0x514 0x514 0x514 0x514 0x514 0x514 0x514 0x514 0x514 0x514 0x514 0x514 0x514 0x514 0x514 0x514 0x514 0x514 0x514 0x514 0x514 0x514 0x514 0x514 0x514 0x514 0x514 0x514 0x514 0x514 0x514 0x514 0x514 0x514 0x514 0x514 0x514 0x514 0x514 0x514 0x514 0x514 0x514 0x514 0x514 0x514 0x514 0x514 0x514 0x514 0x514 0x514 0x514 0x514 0x514 0x514 0x514 0x514 0x514 0x514 0x514 0x514 0x514 0x514 0x514 0x514 0x514 0x514 0x514 0x514 0x514 0x514 0x514 0x514 0x514 0x514 0x514 0x514 0x514 0x514 0x514 0x514 0x514 0x514 0x514 0x514 0x514 0x514 0x514 0x514 0x514 0x514 0x514 0x514 0x514 0x514 0x514 0x514 0x514 0x514 0x514 0x514 0x514 0x514 0x514 0x514 0x514 0x514 0x514 0x514 0x514 0x514 0x514 0x514 0x514 0x514 0x514 0x514 0x514 0x514 0x514 0x514 0x514 0x514 0x514 0x514 0x514 0x514 0x514 0x514 0x514 0x514 0x514 0x514 0x514 0x514 0x514 0x514 0x514 0x514 0x514 0x514 0x514 0x514 0x514 0x514 0x514 0x514 0x514 0x514 0x514 0x514 0x514 0x514 0x514 0x514 0x514 0x514 0x514 0x514 0x514 0x514 0x514 0x514 0x514 0x514 0x514 0x514 0x514 0x514 0x514 0x514 0x514 0x514 0x514 0x514 0x514 0x514 0x514 0x514 0x514 0x514 0x514 0x514 0x514 0x514 0x514 0x514 0x514 0x514 0x514 0x514 0x514 0x514 0x514 0x514 0x514 0x514 0x514 0x514 0x514 0x514 0x514 0x514 0x514 0x514 0x514 0x514 0x514 0x514 0x514 0x514 0x514 0x514 0x514 0x514 0x514 0x514 0x514 0x514 0x514 0x514 0x514 0x514 0x514 0x514 0x514 0x514 0x514 0x514 0x514 0x514 0x514 0x514 0x514 0x514 0x514 0x514 0x514 0x514 0x514 0x514 0x514 0x514>;
				pt7_hi_limits_cols_01 = <0x26>;
				pt7_hi_limits_cols_02 = <0x26>;
				pt7_hi_limits_row_01 = <0x26>;
				pt7_hi_limits_row_02 = <0x26>;
				pt7_lo_limits_01 = <0x1f4 0x1f4 0x1f4 0x1f4 0x1f4 0x1f4 0x1f4 0x1f4 0x1f4 0x1f4 0x1f4 0x1f4 0x1f4 0x1f4 0x1f4 0x1f4 0x1f4 0x1f4 0x1f4 0x1f4 0x1f4 0x1f4 0x1f4 0x1f4 0x1f4 0x1f4 0x1f4 0x1f4 0x1f4 0x1f4 0x1f4 0x1f4 0x1f4 0x1f4 0x1f4 0x1f4 0x1f4 0x1f4 0x1f4 0x1f4 0x1f4 0x1f4 0x1f4 0x1f4 0x1f4 0x1f4 0x1f4 0x1f4 0x1f4 0x1f4 0x1f4 0x1f4 0x1f4 0x1f4 0x1f4 0x1f4 0x1f4 0x1f4 0x1f4 0x1f4 0x1f4 0x1f4 0x1f4 0x1f4 0x1f4 0x1f4 0x1f4 0x1f4 0x1f4 0x1f4 0x1f4 0x1f4 0x1f4 0x1f4 0x1f4 0x1f4 0x1f4 0x1f4 0x1f4 0x1f4 0x1f4 0x1f4 0x1f4 0x1f4 0x1f4 0x1f4 0x1f4 0x1f4 0x1f4 0x1f4 0x1f4 0x1f4 0x1f4 0x1f4 0x1f4 0x1f4 0x1f4 0x1f4 0x1f4 0x1f4 0x1f4 0x1f4 0x1f4 0x1f4 0x1f4 0x1f4 0x1f4 0x1f4 0x1f4 0x1f4 0x1f4 0x1f4 0x1f4 0x1f4 0x1f4 0x1f4 0x1f4 0x1f4 0x1f4 0x1f4 0x1f4 0x1f4 0x1f4 0x1f4 0x1f4 0x1f4 0x1f4 0x1f4 0x1f4 0x1f4 0x1f4 0x1f4 0x1f4 0x1f4 0x1f4 0x1f4 0x1f4 0x1f4 0x1f4 0x1f4 0x1f4 0x1f4 0x1f4 0x1f4 0x1f4 0x1f4 0x1f4 0x1f4 0x1f4 0x1f4 0x1f4 0x1f4 0x1f4 0x1f4 0x1f4 0x1f4 0x1f4 0x1f4 0x1f4 0x1f4 0x1f4 0x1f4 0x1f4 0x1f4 0x1f4 0x1f4 0x1f4 0x1f4 0x1f4 0x1f4 0x1f4 0x1f4 0x1f4 0x1f4 0x1f4 0x1f4 0x1f4 0x1f4 0x1f4 0x1f4 0x1f4 0x1f4 0x1f4 0x1f4 0x1f4 0x1f4 0x1f4 0x1f4 0x1f4 0x1f4 0x1f4 0x1f4 0x1f4 0x1f4 0x1f4 0x1f4 0x1f4 0x1f4 0x1f4 0x1f4 0x1f4 0x1f4 0x1f4 0x1f4 0x1f4 0x1f4 0x1f4 0x1f4 0x1f4 0x1f4 0x1f4 0x1f4 0x1f4 0x1f4 0x1f4 0x1f4 0x1f4 0x1f4 0x1f4 0x1f4 0x1f4 0x1f4 0x1f4 0x1f4 0x1f4 0x1f4 0x1f4 0x1f4 0x1f4 0x1f4 0x1f4 0x1f4 0x1f4 0x1f4 0x1f4 0x1f4 0x1f4 0x1f4 0x1f4 0x1f4 0x1f4 0x1f4 0x1f4 0x1f4 0x1f4 0x1f4 0x1f4 0x1f4 0x1f4 0x1f4 0x1f4 0x1f4 0x1f4 0x1f4 0x1f4 0x1f4 0x1f4 0x1f4 0x1f4 0x1f4 0x1f4 0x1f4 0x1f4 0x1f4 0x1f4 0x1f4 0x1f4 0x1f4 0x1f4 0x1f4 0x1f4 0x1f4 0x1f4 0x1f4 0x1f4 0x1f4 0x1f4 0x1f4 0x1f4 0x1f4 0x1f4 0x1f4 0x1f4 0x1f4 0x1f4 0x1f4 0x1f4 0x1f4 0x1f4 0x1f4 0x1f4 0x1f4 0x1f4 0x1f4 0x1f4 0x1f4 0x1f4 0x1f4 0x1f4 0x1f4 0x1f4 0x1f4 0x1f4 0x1f4 0x1f4 0x1f4 0x1f4 0x1f4 0x1f4 0x1f4 0x1f4 0x1f4 0x1f4 0x1f4 0x1f4 0x1f4 0x1f4 0x1f4 0x1f4 0x1f4 0x1f4 0x1f4 0x1f4 0x1f4 0x1f4 0x1f4 0x1f4 0x1f4 0x1f4 0x1f4 0x1f4 0x1f4 0x1f4 0x1f4 0x1f4 0x1f4 0x1f4 0x1f4 0x1f4 0x1f4 0x1f4 0x1f4 0x1f4 0x1f4 0x1f4 0x1f4 0x1f4 0x1f4 0x1f4 0x1f4 0x1f4 0x1f4 0x1f4 0x1f4 0x1f4 0x1f4 0x1f4 0x1f4 0x1f4 0x1f4 0x1f4 0x1f4 0x1f4 0x1f4 0x1f4 0x1f4 0x1f4 0x1f4 0x1f4 0x1f4 0x1f4 0x1f4 0x1f4 0x1f4 0x1f4 0x1f4 0x1f4 0x1f4 0x1f4 0x1f4 0x1f4 0x1f4 0x1f4 0x1f4 0x1f4 0x1f4 0x1f4 0x1f4 0x1f4 0x1f4 0x1f4 0x1f4 0x1f4 0x1f4 0x1f4 0x1f4 0x1f4 0x1f4 0x1f4 0x1f4 0x1f4 0x1f4 0x1f4 0x1f4 0x1f4 0x1f4 0x1f4 0x1f4 0x1f4 0x1f4 0x1f4 0x1f4 0x1f4 0x1f4 0x1f4 0x1f4 0x1f4 0x1f4 0x1f4 0x1f4 0x1f4 0x1f4 0x1f4 0x1f4 0x1f4 0x1f4 0x1f4 0x1f4 0x1f4 0x1f4 0x1f4 0x1f4 0x1f4 0x1f4 0x1f4 0x1f4 0x1f4 0x1f4 0x1f4 0x1f4 0x1f4 0x1f4 0x1f4 0x1f4 0x1f4 0x1f4 0x1f4 0x1f4 0x1f4 0x1f4 0x1f4 0x1f4 0x1f4 0x1f4 0x1f4 0x1f4 0x1f4 0x1f4 0x1f4 0x1f4 0x1f4 0x1f4 0x1f4 0x1f4 0x1f4 0x1f4 0x1f4 0x1f4 0x1f4 0x1f4 0x1f4 0x1f4 0x1f4 0x1f4 0x1f4 0x1f4 0x1f4 0x1f4 0x1f4 0x1f4 0x1f4 0x1f4 0x1f4 0x1f4 0x1f4 0x1f4 0x1f4 0x1f4 0x1f4 0x1f4 0x1f4 0x1f4 0x1f4 0x1f4 0x1f4 0x1f4 0x1f4 0x1f4 0x1f4 0x1f4 0x1f4 0x1f4 0x1f4 0x1f4 0x1f4 0x1f4 0x1f4 0x1f4 0x1f4 0x1f4 0x1f4 0x1f4 0x1f4 0x1f4 0x1f4 0x1f4 0x1f4 0x1f4 0x1f4 0x1f4 0x1f4 0x1f4 0x1f4 0x1f4 0x1f4 0x1f4 0x1f4 0x1f4 0x1f4 0x1f4 0x1f4 0x1f4 0x1f4 0x1f4 0x1f4 0x1f4 0x1f4 0x1f4 0x1f4 0x1f4 0x1f4 0x1f4 0x1f4 0x1f4 0x1f4 0x1f4 0x1f4 0x1f4 0x1f4 0x1f4 0x1f4 0x1f4 0x1f4 0x1f4 0x1f4 0x1f4 0x1f4 0x1f4 0x1f4 0x1f4 0x1f4 0x1f4 0x1f4 0x1f4 0x1f4 0x1f4 0x1f4 0x1f4 0x1f4 0x1f4 0x1f4 0x1f4 0x1f4 0x1f4 0x1f4 0x1f4 0x1f4 0x1f4 0x1f4 0x1f4 0x1f4 0x1f4 0x1f4 0x1f4 0x1f4 0x1f4 0x1f4 0x1f4 0x1f4 0x1f4 0x1f4 0x1f4 0x1f4 0x1f4 0x1f4 0x1f4 0x1f4 0x1f4 0x1f4 0x1f4 0x1f4 0x1f4 0x1f4 0x1f4 0x1f4 0x1f4 0x1f4 0x1f4 0x1f4 0x1f4 0x1f4 0x1f4 0x1f4 0x1f4 0x1f4 0x1f4 0x1f4 0x1f4 0x1f4 0x1f4 0x1f4 0x1f4 0x1f4 0x1f4 0x1f4 0x1f4 0x1f4 0x1f4 0x1f4 0x1f4 0x1f4 0x1f4 0x1f4 0x1f4 0x1f4 0x1f4 0x1f4 0x1f4 0x1f4 0x1f4 0x1f4 0x1f4 0x1f4 0x1f4 0x1f4 0x1f4 0x1f4 0x1f4 0x1f4 0x1f4 0x1f4 0x1f4 0x1f4 0x1f4 0x1f4 0x1f4 0x1f4 0x1f4 0x1f4 0x1f4 0x1f4 0x1f4 0x1f4 0x1f4 0x1f4 0x1f4 0x1f4 0x1f4 0x1f4 0x1f4 0x1f4 0x1f4 0x1f4 0x1f4 0x1f4 0x1f4 0x1f4 0x1f4 0x1f4 0x1f4 0x1f4 0x1f4 0x1f4 0x1f4 0x1f4 0x1f4 0x1f4 0x1f4 0x1f4 0x1f4 0x1f4 0x1f4 0x1f4 0x1f4 0x1f4 0x1f4 0x1f4 0x1f4 0x1f4 0x1f4 0x1f4 0x1f4 0x1f4 0x1f4 0x1f4 0x1f4 0x1f4 0x1f4 0x1f4 0x1f4 0x1f4 0x1f4 0x1f4 0x1f4 0x1f4 0x1f4 0x1f4 0x1f4 0x1f4 0x1f4 0x1f4 0x1f4 0x1f4 0x1f4 0x1f4 0x1f4 0x1f4 0x1f4 0x1f4 0x1f4 0x1f4 0x1f4 0x1f4 0x1f4 0x1f4 0x1f4 0x1f4 0x1f4 0x1f4 0x1f4 0x1f4 0x1f4 0x1f4 0x1f4 0x1f4 0x1f4 0x1f4 0x1f4 0x1f4 0x1f4 0x1f4 0x1f4 0x1f4 0x1f4 0x1f4 0x1f4 0x1f4 0x1f4 0x1f4 0x1f4 0x1f4 0x1f4 0x1f4 0x1f4 0x1f4 0x1f4 0x1f4 0x1f4 0x1f4 0x1f4 0x1f4 0x1f4 0x1f4 0x1f4 0x1f4 0x1f4 0x1f4 0x1f4 0x1f4 0x1f4 0x1f4 0x1f4 0x1f4 0x1f4 0x1f4 0x1f4 0x1f4 0x1f4 0x1f4 0x1f4 0x1f4 0x1f4 0x1f4 0x1f4 0x1f4 0x1f4 0x1f4 0x1f4 0x1f4 0x1f4 0x1f4 0x1f4 0x1f4 0x1f4 0x1f4 0x1f4 0x1f4 0x1f4 0x1f4 0x1f4 0x1f4 0x1f4 0x1f4 0x1f4 0x1f4 0x1f4 0x1f4 0x1f4 0x1f4 0x1f4 0x1f4 0x1f4 0x1f4 0x1f4 0x1f4 0x1f4 0x1f4 0x1f4 0x1f4 0x1f4 0x1f4 0x1f4 0x1f4 0x1f4 0x1f4 0x1f4 0x1f4 0x1f4 0x1f4 0x1f4 0x1f4 0x1f4 0x1f4 0x1f4 0x1f4 0x1f4 0x1f4 0x1f4 0x1f4 0x1f4 0x1f4 0x1f4 0x1f4 0x1f4 0x1f4 0x1f4 0x1f4 0x1f4 0x1f4 0x1f4 0x1f4 0x1f4 0x1f4 0x1f4 0x1f4 0x1f4 0x1f4 0x1f4 0x1f4 0x1f4 0x1f4 0x1f4 0x1f4 0x1f4 0x1f4 0x1f4 0x1f4 0x1f4 0x1f4 0x1f4 0x1f4 0x1f4 0x1f4 0x1f4 0x1f4 0x1f4 0x1f4 0x1f4 0x1f4 0x1f4 0x1f4 0x1f4 0x1f4 0x1f4 0x1f4 0x1f4 0x1f4 0x1f4 0x1f4 0x1f4 0x1f4 0x1f4 0x1f4 0x1f4 0x1f4 0x1f4 0x1f4 0x1f4 0x1f4 0x1f4 0x1f4 0x1f4 0x1f4 0x1f4 0x1f4 0x1f4 0x1f4 0x1f4 0x1f4 0x1f4 0x1f4 0x1f4 0x1f4 0x1f4 0x1f4 0x1f4 0x1f4 0x1f4 0x1f4 0x1f4 0x1f4 0x1f4 0x1f4 0x1f4 0x1f4 0x1f4 0x1f4 0x1f4 0x1f4 0x1f4 0x1f4 0x1f4 0x1f4 0x1f4 0x1f4 0x1f4 0x1f4 0x1f4 0x1f4 0x1f4 0x1f4 0x1f4 0x1f4 0x1f4 0x1f4 0x1f4 0x1f4 0x1f4 0x1f4 0x1f4 0x1f4 0x1f4 0x1f4 0x1f4 0x1f4 0x1f4 0x1f4 0x1f4 0x1f4 0x1f4 0x1f4 0x1f4 0x1f4 0x1f4 0x1f4 0x1f4 0x1f4 0x1f4 0x1f4 0x1f4 0x1f4 0x1f4 0x1f4 0x1f4 0x1f4 0x1f4 0x1f4 0x1f4 0x1f4 0x1f4 0x1f4 0x1f4 0x1f4 0x1f4 0x1f4 0x1f4 0x1f4 0x1f4 0x1f4 0x1f4 0x1f4 0x1f4 0x1f4 0x1f4 0x1f4 0x1f4 0x1f4 0x1f4 0x1f4 0x1f4 0x1f4 0x1f4 0x1f4 0x1f4 0x1f4 0x1f4 0x1f4 0x1f4 0x1f4 0x1f4 0x1f4 0x1f4 0x1f4 0x1f4 0x1f4 0x1f4 0x1f4 0x1f4 0x1f4 0x1f4 0x1f4 0x1f4 0x1f4 0x1f4 0x1f4 0x1f4 0x1f4 0x1f4 0x1f4 0x1f4 0x1f4 0x1f4 0x1f4 0x1f4 0x1f4 0x1f4 0x1f4 0x1f4 0x1f4 0x1f4 0x1f4 0x1f4 0x1f4 0x1f4 0x1f4 0x1f4 0x1f4 0x1f4 0x1f4 0x1f4 0x1f4 0x1f4 0x1f4 0x1f4 0x1f4 0x1f4 0x1f4 0x1f4 0x1f4 0x1f4 0x1f4 0x1f4 0x1f4 0x1f4 0x1f4 0x1f4 0x1f4 0x1f4 0x1f4 0x1f4 0x1f4 0x1f4 0x1f4 0x1f4 0x1f4 0x1f4 0x1f4 0x1f4 0x1f4 0x1f4 0x1f4 0x1f4 0x1f4 0x1f4 0x1f4 0x1f4 0x1f4 0x1f4 0x1f4 0x1f4 0x1f4 0x1f4 0x1f4 0x1f4 0x1f4 0x1f4 0x1f4 0x1f4 0x1f4 0x1f4 0x1f4 0x1f4 0x1f4 0x1f4 0x1f4 0x1f4 0x1f4 0x1f4 0x1f4 0x1f4 0x1f4 0x1f4 0x1f4 0x1f4 0x1f4 0x1f4 0x1f4 0x1f4 0x1f4 0x1f4 0x1f4 0x1f4 0x1f4 0x1f4 0x1f4 0x1f4 0x1f4 0x1f4 0x1f4 0x1f4 0x1f4 0x1f4 0x1f4 0x1f4 0x1f4 0x1f4 0x1f4 0x1f4 0x1f4 0x1f4 0x1f4 0x1f4 0x1f4 0x1f4 0x1f4 0x1f4 0x1f4 0x1f4 0x1f4 0x1f4 0x1f4 0x1f4 0x1f4 0x1f4 0x1f4 0x1f4 0x1f4 0x1f4 0x1f4 0x1f4 0x1f4 0x1f4 0x1f4 0x1f4 0x1f4 0x1f4 0x1f4 0x1f4 0x1f4 0x1f4 0x1f4 0x1f4 0x1f4 0x1f4 0x1f4 0x1f4 0x1f4 0x1f4 0x1f4 0x1f4 0x1f4 0x1f4 0x1f4 0x1f4 0x1f4 0x1f4 0x1f4 0x1f4 0x1f4 0x1f4 0x1f4 0x1f4 0x1f4 0x1f4 0x1f4 0x1f4 0x1f4 0x1f4 0x1f4 0x1f4 0x1f4 0x1f4 0x1f4 0x1f4 0x1f4 0x1f4 0x1f4 0x1f4 0x1f4 0x1f4 0x1f4 0x1f4 0x1f4 0x1f4 0x1f4 0x1f4 0x1f4 0x1f4 0x1f4 0x1f4 0x1f4 0x1f4 0x1f4 0x1f4 0x1f4 0x1f4 0x1f4 0x1f4 0x1f4 0x1f4 0x1f4 0x1f4 0x1f4 0x1f4 0x1f4 0x1f4 0x1f4 0x1f4 0x1f4 0x1f4 0x1f4 0x1f4 0x1f4 0x1f4 0x1f4 0x1f4 0x1f4 0x1f4 0x1f4 0x1f4 0x1f4 0x1f4 0x1f4 0x1f4 0x1f4 0x1f4 0x1f4 0x1f4 0x1f4 0x1f4 0x1f4 0x1f4 0x1f4 0x1f4 0x1f4 0x1f4 0x1f4 0x1f4 0x1f4 0x1f4 0x1f4 0x1f4 0x1f4 0x1f4 0x1f4 0x1f4 0x1f4 0x1f4 0x1f4 0x1f4 0x1f4 0x1f4 0x1f4 0x1f4 0x1f4 0x1f4 0x1f4 0x1f4 0x1f4 0x1f4 0x1f4 0x1f4 0x1f4 0x1f4 0x1f4 0x1f4 0x1f4 0x1f4 0x1f4 0x1f4 0x1f4 0x1f4 0x1f4 0x1f4 0x1f4 0x1f4 0x1f4 0x1f4 0x1f4 0x1f4 0x1f4 0x1f4 0x1f4 0x1f4 0x1f4 0x1f4 0x1f4 0x1f4 0x1f4 0x1f4 0x1f4 0x1f4 0x1f4 0x1f4 0x1f4 0x1f4 0x1f4 0x0 0x0 0x1f4 0x1f4 0x1f4 0x1f4 0x1f4 0x1f4 0x1f4 0x1f4 0x1f4 0x1f4 0x1f4 0x1f4 0x1f4 0x1f4 0x1f4 0x1f4 0x1f4 0x1f4 0x1f4 0x1f4 0x1f4 0x1f4 0x1f4 0x1f4 0x1f4 0x1f4 0x1f4 0x1f4 0x1f4 0x1f4 0x1f4 0x1f4 0x1f4 0x1f4 0x1f4 0x1f4 0x1f4 0x1f4 0x1f4 0x1f4 0x1f4 0x1f4 0x1f4 0x1f4 0x1f4 0x1f4 0x1f4 0x1f4 0x1f4 0x1f4 0x1f4 0x1f4 0x1f4 0x1f4 0x1f4 0x1f4 0x1f4 0x1f4 0x1f4 0x1f4 0x1f4 0x1f4 0x1f4 0x1f4 0x1f4 0x1f4 0x1f4 0x1f4 0x1f4 0x1f4 0x1f4 0x1f4 0x1f4 0x1f4 0x1f4 0x1f4 0x1f4 0x1f4 0x1f4 0x1f4 0x1f4 0x1f4 0x1f4 0x1f4 0x1f4 0x1f4 0x1f4 0x1f4 0x1f4 0x1f4 0x1f4 0x1f4 0x1f4 0x1f4 0x1f4 0x1f4 0x1f4 0x1f4 0x1f4 0x1f4 0x1f4 0x1f4 0x1f4 0x1f4 0x1f4>;
				pt7_lo_limits_02 = <0x226 0x226 0x226 0x226 0x226 0x226 0x226 0x226 0x226 0x226 0x226 0x226 0x226 0x226 0x226 0x226 0x226 0x226 0x226 0x226 0x226 0x226 0x226 0x226 0x226 0x226 0x226 0x226 0x226 0x226 0x226 0x226 0x226 0x226 0x226 0x226 0x226 0x226 0x226 0x226 0x226 0x226 0x226 0x226 0x226 0x226 0x226 0x226 0x226 0x226 0x226 0x226 0x226 0x226 0x226 0x226 0x226 0x226 0x226 0x226 0x226 0x226 0x226 0x226 0x226 0x226 0x226 0x226 0x226 0x226 0x226 0x226 0x226 0x226 0x226 0x226 0x226 0x226 0x226 0x226 0x226 0x226 0x226 0x226 0x226 0x226 0x226 0x226 0x226 0x226 0x226 0x226 0x226 0x226 0x226 0x226 0x226 0x226 0x226 0x226 0x226 0x226 0x226 0x226 0x226 0x226 0x226 0x226 0x226 0x226 0x226 0x226 0x226 0x226 0x226 0x226 0x226 0x226 0x226 0x226 0x226 0x226 0x226 0x226 0x226 0x226 0x226 0x226 0x226 0x226 0x226 0x226 0x226 0x226 0x226 0x226 0x226 0x226 0x226 0x226 0x226 0x226 0x226 0x226 0x226 0x226 0x226 0x226 0x226 0x226 0x226 0x226 0x226 0x226 0x226 0x226 0x226 0x226 0x226 0x226 0x226 0x226 0x226 0x226 0x226 0x226 0x226 0x226 0x226 0x226 0x226 0x226 0x226 0x226 0x226 0x226 0x226 0x226 0x226 0x226 0x226 0x226 0x226 0x226 0x226 0x226 0x226 0x226 0x226 0x226 0x226 0x226 0x226 0x226 0x226 0x226 0x226 0x226 0x226 0x226 0x226 0x226 0x226 0x226 0x226 0x226 0x226 0x226 0x226 0x226 0x226 0x226 0x226 0x226 0x226 0x226 0x226 0x226 0x226 0x226 0x226 0x226 0x226 0x226 0x226 0x226 0x226 0x226 0x226 0x226 0x226 0x226 0x226 0x226 0x226 0x226 0x226 0x226 0x226 0x226 0x226 0x226 0x226 0x226 0x226 0x226 0x226 0x226 0x226 0x226 0x226 0x226 0x226 0x226 0x226 0x226 0x226 0x226 0x226 0x226 0x226 0x226 0x226 0x226 0x226 0x226 0x226 0x226 0x226 0x226 0x226 0x226 0x226 0x226 0x226 0x226 0x226 0x226 0x226 0x226 0x226 0x226 0x226 0x226 0x226 0x226 0x226 0x226 0x226 0x226 0x226 0x226 0x226 0x226 0x226 0x226 0x226 0x226 0x226 0x226 0x226 0x226 0x226 0x226 0x226 0x226 0x226 0x226 0x226 0x226 0x226 0x226 0x226 0x226 0x226 0x226 0x226 0x226 0x226 0x226 0x226 0x226 0x226 0x226 0x226 0x226 0x226 0x226 0x226 0x226 0x226 0x226 0x226 0x226 0x226 0x226 0x226 0x226 0x226 0x226 0x226 0x226 0x226 0x226 0x226 0x226 0x226 0x226 0x226 0x226 0x226 0x226 0x226 0x226 0x226 0x226 0x226 0x226 0x226 0x226 0x226 0x226 0x226 0x226 0x226 0x226 0x226 0x226 0x226 0x226 0x226 0x226 0x226 0x226 0x226 0x226 0x226 0x226 0x226 0x226 0x226 0x226 0x226 0x226 0x226 0x226 0x226 0x226 0x226 0x226 0x226 0x226 0x226 0x226 0x226 0x226 0x226 0x226 0x226 0x226 0x226 0x226 0x226 0x226 0x226 0x226 0x226 0x226 0x226 0x226 0x226 0x226 0x226 0x226 0x226 0x226 0x226 0x226 0x226 0x226 0x226 0x226 0x226 0x226 0x226 0x226 0x226 0x226 0x226 0x226 0x226 0x226 0x226 0x226 0x226 0x226 0x226 0x226 0x226 0x226 0x226 0x226 0x226 0x226 0x226 0x226 0x226 0x226 0x226 0x226 0x226 0x226 0x226 0x226 0x226 0x226 0x226 0x226 0x226 0x226 0x226 0x226 0x226 0x226 0x226 0x226 0x226 0x226 0x226 0x226 0x226 0x226 0x226 0x226 0x226 0x226 0x226 0x226 0x226 0x226 0x226 0x226 0x226 0x226 0x226 0x226 0x226 0x226 0x226 0x226 0x226 0x226 0x226 0x226 0x226 0x226 0x226 0x226 0x226 0x226 0x226 0x226 0x226 0x226 0x226 0x226 0x226 0x226 0x226 0x226 0x226 0x226 0x226 0x226 0x226 0x226 0x226 0x226 0x226 0x226 0x226 0x226 0x226 0x226 0x226 0x226 0x226 0x226 0x226 0x226 0x226 0x226 0x226 0x226 0x226 0x226 0x226 0x226 0x226 0x226 0x226 0x226 0x226 0x226 0x226 0x226 0x226 0x226 0x226 0x226 0x226 0x226 0x226 0x226 0x226 0x226 0x226 0x226 0x226 0x226 0x226 0x226 0x226 0x226 0x226 0x226 0x226 0x226 0x226 0x226 0x226 0x226 0x226 0x226 0x226 0x226 0x226 0x226 0x226 0x226 0x226 0x226 0x226 0x226 0x226 0x226 0x226 0x226 0x226 0x226 0x226 0x226 0x226 0x226 0x226 0x226 0x226 0x226 0x226 0x226 0x226 0x226 0x226 0x226 0x226 0x226 0x226 0x226 0x226 0x226 0x226 0x226 0x226 0x226 0x226 0x226 0x226 0x226 0x226 0x226 0x226 0x226 0x226 0x226 0x226 0x226 0x226 0x226 0x226 0x226 0x226 0x226 0x226 0x226 0x226 0x226 0x226 0x226 0x226 0x226 0x226 0x226 0x226 0x226 0x226 0x226 0x226 0x226 0x226 0x226 0x226 0x226 0x226 0x226 0x226 0x226 0x226 0x226 0x226 0x226 0x226 0x226 0x226 0x226 0x226 0x226 0x226 0x226 0x226 0x226 0x226 0x226 0x226 0x226 0x226 0x226 0x226 0x226 0x226 0x226 0x226 0x226 0x226 0x226 0x226 0x226 0x226 0x226 0x226 0x226 0x226 0x226 0x226 0x226 0x226 0x226 0x226 0x226 0x226 0x226 0x226 0x226 0x226 0x226 0x226 0x226 0x226 0x226 0x226 0x226 0x226 0x226 0x226 0x226 0x226 0x226 0x226 0x226 0x226 0x226 0x226 0x226 0x226 0x226 0x226 0x226 0x226 0x226 0x226 0x226 0x226 0x226 0x226 0x226 0x226 0x226 0x226 0x226 0x226 0x226 0x226 0x226 0x226 0x226 0x226 0x226 0x226 0x226 0x226 0x226 0x226 0x226 0x226 0x226 0x226 0x226 0x226 0x226 0x226 0x226 0x226 0x226 0x226 0x226 0x226 0x226 0x226 0x226 0x226 0x226 0x226 0x226 0x226 0x226 0x226 0x226 0x226 0x226 0x226 0x226 0x226 0x226 0x226 0x226 0x226 0x226 0x226 0x226 0x226 0x226 0x226 0x226 0x226 0x226 0x226 0x226 0x226 0x226 0x226 0x226 0x226 0x226 0x226 0x226 0x226 0x226 0x226 0x226 0x226 0x226 0x226 0x226 0x226 0x226 0x226 0x226 0x226 0x226 0x226 0x226 0x226 0x226 0x226 0x226 0x226 0x226 0x226 0x226 0x226 0x226 0x226 0x226 0x226 0x226 0x226 0x226 0x226 0x226 0x226 0x226 0x226 0x226 0x226 0x226 0x226 0x226 0x226 0x226 0x226 0x226 0x226 0x226 0x226 0x226 0x226 0x226 0x226 0x226 0x226 0x226 0x226 0x226 0x226 0x226 0x226 0x226 0x226 0x226 0x226 0x226 0x226 0x226 0x226 0x226 0x226 0x226 0x226 0x226 0x226 0x226 0x226 0x226 0x226 0x226 0x226 0x226 0x226 0x226 0x226 0x226 0x226 0x226 0x226 0x226 0x226 0x226 0x226 0x226 0x226 0x226 0x226 0x226 0x226 0x226 0x226 0x226 0x226 0x226 0x226 0x226 0x226 0x226 0x226 0x226 0x226 0x226 0x226 0x226 0x226 0x226 0x226 0x226 0x226 0x226 0x226 0x226 0x226 0x226 0x226 0x226 0x226 0x226 0x226 0x226 0x226 0x226 0x226 0x226 0x226 0x226 0x226 0x226 0x226 0x226 0x226 0x226 0x226 0x226 0x226 0x226 0x226 0x226 0x226 0x226 0x226 0x226 0x226 0x226 0x226 0x226 0x226 0x226 0x226 0x226 0x226 0x226 0x226 0x226 0x226 0x226 0x226 0x226 0x226 0x226 0x226 0x226 0x226 0x226 0x226 0x226 0x226 0x226 0x226 0x226 0x226 0x226 0x226 0x226 0x226 0x226 0x226 0x226 0x226 0x226 0x226 0x226 0x226 0x226 0x226 0x226 0x226 0x226 0x226 0x226 0x226 0x226 0x226 0x226 0x226 0x226 0x226 0x226 0x226 0x226 0x226 0x226 0x226 0x226 0x226 0x226 0x226 0x226 0x226 0x226 0x226 0x226 0x226 0x226 0x226 0x226 0x226 0x226 0x226 0x226 0x226 0x226 0x226 0x226 0x226 0x226 0x226 0x226 0x226 0x226 0x226 0x226 0x226 0x226 0x226 0x226 0x226 0x226 0x226 0x226 0x226 0x226 0x226 0x226 0x226 0x226 0x226 0x226 0x226 0x226 0x226 0x226 0x226 0x226 0x226 0x226 0x226 0x226 0x226 0x226 0x226 0x226 0x226 0x226 0x226 0x226 0x226 0x226 0x226 0x226 0x226 0x226 0x226 0x226 0x226 0x226 0x226 0x226 0x226 0x226 0x226 0x226 0x226 0x226 0x226 0x226 0x226 0x226 0x226 0x226 0x226 0x226 0x226 0x226 0x226 0x226 0x226 0x226 0x226 0x226 0x226 0x226 0x226 0x226 0x226 0x226 0x226 0x226 0x226 0x226 0x226 0x226 0x226 0x226 0x226 0x226 0x226 0x226 0x226 0x226 0x226 0x226 0x226 0x226 0x226 0x226 0x226 0x226 0x226 0x226 0x226 0x226 0x226 0x226 0x226 0x226 0x226 0x226 0x226 0x226 0x226 0x226 0x226 0x226 0x226 0x226 0x226 0x226 0x226 0x226 0x226 0x226 0x226 0x226 0x226 0x226 0x226 0x226 0x226 0x226 0x226 0x226 0x226 0x226 0x226 0x226 0x226 0x226 0x226 0x226 0x226 0x226 0x226 0x226 0x226 0x226 0x226 0x226 0x226 0x226 0x226 0x226 0x226 0x226 0x226 0x226 0x226 0x226 0x226 0x226 0x226 0x226 0x226 0x226 0x226 0x226 0x226 0x226 0x226 0x226 0x226 0x226 0x226 0x226 0x226 0x226 0x226 0x226 0x226 0x226 0x226 0x226 0x226 0x226 0x226 0x226 0x226 0x226 0x226 0x226 0x226 0x226 0x226 0x226 0x226 0x226 0x226 0x226 0x226 0x226 0x226 0x226 0x226 0x226 0x226 0x226 0x226 0x226 0x226 0x226 0x226 0x226 0x226 0x226 0x226 0x226 0x226 0x226 0x226 0x226 0x226 0x226 0x226 0x226 0x226 0x226 0x226 0x226 0x226 0x226 0x226 0x226 0x226 0x226 0x226 0x226 0x226 0x226 0x226 0x226 0x226 0x226 0x226 0x226 0x226 0x226 0x226 0x226 0x226 0x226 0x226 0x226 0x226 0x226 0x226 0x226 0x226 0x226 0x226 0x226 0x226 0x226 0x226 0x226 0x226 0x226 0x226 0x226 0x226 0x226 0x226 0x226 0x226 0x226 0x226 0x226 0x226 0x226 0x226 0x226 0x226 0x226 0x226 0x226 0x226 0x226 0x226 0x226 0x226 0x226 0x226 0x226 0x226 0x226 0x226 0x226 0x226 0x226 0x226 0x226 0x226 0x226 0x226 0x226 0x226 0x226 0x226 0x226 0x226 0x226 0x226 0x226 0x226 0x226 0x226 0x226 0x226 0x226 0x226 0x226 0x226 0x226 0x226 0x226 0x226 0x226 0x226 0x226 0x226 0x226 0x226 0x226 0x226 0x226 0x226 0x226 0x226 0x226 0x226 0x226 0x226 0x226 0x226 0x226 0x226 0x226 0x226 0x226 0x226 0x226 0x226 0x226 0x226 0x226 0x226 0x226 0x226 0x226 0x226 0x226 0x226 0x226 0x226 0x226 0x226 0x226 0x226 0x226 0x226 0x226 0x226 0x226 0x226 0x226 0x226 0x226 0x226 0x226 0x226 0x226 0x226 0x226 0x226 0x226 0x226 0x226 0x226 0x226 0x226 0x226 0x226 0x226 0x226 0x226 0x226 0x226 0x226 0x226 0x226 0x226>;
				pt7_lo_limits_cols_01 = <0x26>;
				pt7_lo_limits_cols_02 = <0x26>;
				pt7_lo_limits_row_01 = <0x26>;
				pt7_lo_limits_row_02 = <0x26>;
				reg = <0x0>;
				spi-max-frequency = <0x7a1200>;
				status = "okay";
			};
		};
	};

	fragment@12 {
		target = <0xffffffff>;

		__overlay__ {
			accdet-mic-mode = <0x1>;
			accdet-mic-vol = <0x6>;
			accdet-plugout-debounce = <0x1>;
			headset-eint-level-pol = <0x8>;
			headset-four-key-threshold = <0x0 0x3a 0x79 0xc0 0x190>;
			headset-mode-setting = <0x500 0x500 0x1 0x1f0 0x800 0x800 0x20 0x44>;
			headset-three-key-threshold = <0x0 0x50 0xdc 0x190>;
			headset-three-key-threshold-CDD = <0x0 0x79 0xc0 0x258>;
			status = "okay";
		};
	};

	fragment@13 {
		target = <0xffffffff>;

		__overlay__ {
			pinctrl-0 = <0xf>;
			pinctrl-names = "default";
		};
	};

	fragment@14 {
		target = <0xffffffff>;

		__overlay__ {

			kpdgpiodefault {
				phandle = <0xf>;

				pins_cmd_dat {
					bias-pull-up = <0x66>;
					input-enable;
					input-schmitt-enable;
					pinmux = <0x5d01>;
				};
			};
		};
	};

	fragment@15 {
		target = <0xffffffff>;

		__overlay__ {
			mt6370,intr_gpio = <0xffffffff 0x14 0x0>;
			mt6370,intr_gpio_num = <0x14>;
		};
	};

	fragment@16 {
		target = <0xffffffff>;

		__overlay__ {
			mt6370pd,intr_gpio = <0xffffffff 0x29 0x0>;
			mt6370pd,intr_gpio_num = <0x29>;
		};
	};

	fragment@17 {
		target = <0xffffffff>;

		__overlay__ {

			consys_default {
				phandle = <0x10>;
			};

			gpslna@0 {
				phandle = <0x11>;

				pins_cmd_dat {
					bias-disable;
					output-low;
					pinmux = <0x5b00>;
					slew-rate = <0x0>;
				};
			};

			gpslna@1 {
				phandle = <0x12>;

				pins_cmd_dat {
					output-high;
					pinmux = <0x5b00>;
					slew-rate = <0x1>;
				};
			};

			gpslna@2 {
				phandle = <0x13>;

				pins_cmd_dat {
					output-low;
					pinmux = <0x5b00>;
					slew-rate = <0x1>;
				};
			};
		};
	};

	fragment@18 {
		target = <0xffffffff>;

		__overlay__ {
			pinctrl-0 = <0x10>;
			pinctrl-1 = <0x11>;
			pinctrl-2 = <0x12>;
			pinctrl-3 = <0x13>;
			pinctrl-names = "default", "gps_lna_state_init", "gps_lna_state_oh", "gps_lna_state_ol";
			status = "okay";
		};
	};

	fragment@19 {
		target = <0xffffffff>;

		__overlay__ {

			irq_nfc {
				compatible = "mediatek,irq_nfc-eint";
				interrupt-parent = <0xffffffff>;
				interrupts = <0x1d 0x4 0x1d 0x0>;
				phandle = <0x5b>;
				status = "okay";
			};

			nfc {
				compatible = "mediatek,nfc-gpio-v2";
				gpio-irq = <0x1d>;
				gpio-irq-std = <0xffffffff 0x1d 0x0>;
				gpio-rst = <0x1e>;
				gpio-rst-std = <0xffffffff 0x1e 0x0>;
				phandle = <0x5a>;
			};
		};
	};

	fragment@2 {
		target = <0xffffffff>;

		__overlay__ {

			sgm41516d@6B {
				compatible = "mediatek,sgm41516d";
				led_ctl_gpio = <0xffffffff 0xa5 0x0>;
				phandle = <0x4c>;
				reg = <0x6b>;
				sgm41516d,intr_gpio = <0xffffffff 0x9 0x0>;
				sgm41516d,intr_gpio_num = <0x9>;
				status = "okay";
			};
		};
	};

	fragment@20 {
		target = <0xffffffff>;

		__overlay__ {
			status = "okay";

			nfc_nxp@28 {
				compatible = "nxp,pn544";
				nxp,pn544-fw-dwnld = <0xffffffff 0xa6 0x0>;
				nxp,pn544-irq = <0xffffffff 0x1d 0x0>;
				nxp,pn544-ven = <0xffffffff 0x1e 0x0>;
				reg = <0x28>;
			};
		};
	};

	fragment@21 {
		target = <0xffffffff>;

		__overlay__ {
			pinctrl-0 = <0x14>;
			pinctrl-1 = <0x15>;
			pinctrl-names = "irtx_gpio_led_default", "irtx_gpio_led_set";
			status = "okay";
		};
	};

	fragment@22 {
		target = <0xffffffff>;

		__overlay__ {

			irtx_gpio_led_def@gpio12 {
				phandle = <0x14>;

				pins_cmd_dat {
					bias-disable;
					input-schmitt-enable = <0x0>;
					output-low;
					pinmux = <0xc00>;
					slew-rate = <0x1>;
				};
			};

			irtx_gpio_led_set@gpio12 {
				phandle = <0x15>;

				pins_cmd_dat {
					output-high;
					pinmux = <0xc01>;
					slew-rate = <0x1>;
				};
			};
		};
	};

	fragment@23 {
		target = <0xffffffff>;

		__overlay__ {

			lcd_bias_enn0_gpio {
				phandle = <0x19>;

				pins_cmd_dat {
					output-low;
					pinmux = <0x9800>;
					slew-rate = <0x1>;
				};
			};

			lcd_bias_enn1_gpio {
				phandle = <0x18>;

				pins_cmd_dat {
					output-high;
					pinmux = <0x9800>;
					slew-rate = <0x1>;
				};
			};

			lcd_bias_enp0_gpio {
				phandle = <0x17>;

				pins_cmd_dat {
					output-low;
					pinmux = <0x9900>;
					slew-rate = <0x1>;
				};
			};

			lcd_bias_enp1_gpio {
				phandle = <0x16>;

				pins_cmd_dat {
					output-high;
					pinmux = <0x9900>;
					slew-rate = <0x1>;
				};
			};

			lcm_dsi_te {
				phandle = <0x1c>;

				pins_cmd_dat {
					pinmux = <0x2c01>;
				};
			};

			lcm_rst_out0_gpio {
				phandle = <0x1b>;

				pins_cmd_dat {
					output-low;
					pinmux = <0x2d00>;
					slew-rate = <0x1>;
				};
			};

			lcm_rst_out1_gpio {
				phandle = <0x1a>;

				pins_cmd_dat {
					output-high;
					pinmux = <0x2d00>;
					slew-rate = <0x1>;
				};
			};
		};
	};

	fragment@24 {
		target = <0xffffffff>;

		__overlay__ {
			pinctrl-0 = <0x16>;
			pinctrl-1 = <0x17>;
			pinctrl-2 = <0x18>;
			pinctrl-3 = <0x19>;
			pinctrl-4 = <0x1a>;
			pinctrl-5 = <0x1b>;
			pinctrl-6 = <0x1c>;
			pinctrl-names = "lcd_bias_enp1_gpio", "lcd_bias_enp0_gpio", "lcd_bias_enn1_gpio", "lcd_bias_enn0_gpio", "lcm_rst_out1_gpio", "lcm_rst_out0_gpio", "mode_te_te";
			status = "okay";
		};
	};

	fragment@25 {
		target = <0xffffffff>;

		__overlay__ {

			meta_high {
				phandle = <0x22>;

				pins_cmd_dat {
					output-high;
					pinmux = <0x800>;
					slew-rate = <0x1>;
				};
			};

			meta_init {
				phandle = <0x20>;

				pins_cmd_dat {
					pinmux = <0x800>;
					slew-rate = <0x1>;
				};
			};

			meta_low {
				phandle = <0x21>;

				pins_cmd_dat {
					output-low;
					pinmux = <0x800>;
					slew-rate = <0x1>;
				};
			};

			otg_high {
				phandle = <0x1f>;

				pins_cmd_dat {
					output-high;
					pinmux = <0xb200>;
					slew-rate = <0x1>;
				};
			};

			otg_init {
				phandle = <0x1d>;

				pins_cmd_dat {
					pinmux = <0xb200>;
					slew-rate = <0x1>;
				};
			};

			otg_low {
				phandle = <0x1e>;

				pins_cmd_dat {
					output-low;
					pinmux = <0xb200>;
					slew-rate = <0x1>;
				};
			};
		};
	};

	fragment@26 {
		target = <0xffffffff>;

		__overlay__ {
			mediatek,eye-disc = <0xd>;
			mediatek,eye-rev6 = <0x1>;
			mediatek,eye-term = <0x5>;
			mediatek,eye-vrt = <0x5>;
			mediatek,host-eye-disc = <0xd>;
			mediatek,host-eye-rev6 = <0x1>;
			mediatek,host-eye-term = <0x5>;
			mediatek,host-eye-vrt = <0x5>;
		};
	};

	fragment@27 {
		target = <0xffffffff>;

		__overlay__ {

			otg_iddig {
				compatible = "mediatek,usb_iddig_bi_eint";
				deb-gpios = <0xffffffff 0x29 0x0>;
				debounce = <0xfa00>;
				interrupt-parent = <0xffffffff>;
				interrupts = <0x29 0x2 0x29 0x0>;
				phandle = <0x5c>;
				status = "okay";
			};

			tran_battery {
				compatible = "tran,chg_fun";
				enable_pcb_tml;
				jeita_above_t4_chg_cur = <0x0>;
				jeita_above_t4_input_cur = <0xf4240>;
				jeita_below_t0_chg_cur = <0x0>;
				jeita_below_t0_input_cur = <0x16e360>;
				jeita_t0_to_t1_chg_cur = <0xf4240>;
				jeita_t0_to_t1_input_cur = <0x16e360>;
				jeita_t2_to_t3_chg_cur = <0x1e8480>;
				jeita_t2_to_t3_input_cur = <0x200b20>;
				jeita_t3_to_t4_chg_cur = <0x1e8480>;
				jeita_t3_to_t4_input_cur = <0x200b20>;
				pcb_cur_step_one = <0x1f4>;
				pcb_cur_step_two = <0x1f4>;
				pcb_min_chg_cur = <0xf4240>;
				pcb_temp_step_one = <0x9c40>;
				pcb_temp_step_two = <0xabe0>;
				phandle = <0x5d>;
				pinctrl-0 = <0x1d>;
				pinctrl-1 = <0x1e>;
				pinctrl-2 = <0x1f>;
				pinctrl-3 = <0x20>;
				pinctrl-4 = <0x21>;
				pinctrl-5 = <0x22>;
				pinctrl-names = "otg_gpio_init", "otg_gpio_low", "otg_gpio_high", "meta_gpio_init", "meta_gpio_low", "meta_gpio_high";
			};

			tran_battery_aging {
				battery_aging_module0 = <0x0>;
				battery_aging_module1 = <0x0>;
				battery_aging_module2 = <0x0>;
				battery_aging_module3 = <0x0>;
				compatible = "tran,chg_aging";
				phandle = <0x5e>;
			};
		};
	};

	fragment@28 {
		target = <0xffffffff>;

		__overlay__ {
			charger = <0xffffffff>;
			fake_typec_otg_detect;
			id-gpios = <0xffffffff 0x29 0x0>;
			io-channel-names = "AUX_CHG";
			io-channels = <0xffffffff 0x4>;
		};
	};

	fragment@29 {
		target = <0xffffffff>;

		__overlay__ {
			ac_charger_current = <0x2191c0>;
			ac_charger_input_current = <0x1e8480>;
			algorithm_name = "SwitchCharging";
			apple_1_0a_charger_current = <0x9eb10>;
			apple_2_1a_charger_current = <0xc3500>;
			battery_cv = <0x432380 0x432380 0x432380 0x432380>;
			bif_cv_under_threshold2 = <0x43e6d0>;
			bif_threshold1 = <0x40d990>;
			bif_threshold2 = <0x419ce0>;
			cable_imp_threshold = <0x2bb>;
			charging_host_charger_current = <0x16e360>;
			chg1_ta_ac_charger_current = <0x16e360>;
			chg2_ta_ac_charger_current = <0x16e360>;
			compatible = "mediatek,charger";
			disable_pd_dual;
			dual_polling_ieoc = <0x6ddd0>;
			enable_hvdcp20;
			enable_ir_comp;
			enable_min_charge_temp;
			enable_pe_2;
			enable_pe_plus;
			enable_sw_jeita;
			enable_tc30;
			high_temp_to_enter_pe40 = <0x27>;
			high_temp_to_leave_pe40 = <0x2e>;
			ibus_err = <0xe>;
			jeita_temp_above_t4_cv = <0x3e8fa0 0x3e8fa0 0x3e8fa0 0x3e8fa0>;
			jeita_temp_below_t0_cv = <0x432380 0x432380 0x432380 0x432380>;
			jeita_temp_t0_to_t1_cv = <0x432380 0x432380 0x432380 0x432380>;
			jeita_temp_t1_to_t2_cv = <0x432380 0x432380 0x432380 0x432380>;
			jeita_temp_t2_to_t3_cv = <0x432380 0x432380 0x432380 0x432380>;
			jeita_temp_t3_to_t4_cv = <0x3e8fa0 0x3e8fa0 0x3e8fa0 0x3e8fa0>;
			low_temp_to_enter_pe40 = <0x10>;
			low_temp_to_leave_pe40 = <0xa>;
			max_charge_temp = <0x35>;
			max_charge_temp_minus_x_degree = <0x34>;
			max_charger_voltage = <0x632ea0>;
			max_charging_time = <0x11940>;
			max_dmivr_charger_current = <0x155cc0>;
			min_charge_temp = <0x0>;
			min_charge_temp_plus_x_degree = <0x1>;
			min_charger_voltage = <0x4630c0>;
			min_charger_voltage_1 = <0x432380>;
			min_charger_voltage_2 = <0x401640>;
			multi_battery_cv;
			non_std_ac_charger_current = <0x124f80>;
			pd_ichg_level_threshold = <0xf4240>;
			pd_stop_battery_soc = <0x50>;
			pd_vbus_low_bound = <0x4c4b40>;
			pd_vbus_upper_bound = <0x4c4b40>;
			pe20_ichg_level_threshold = <0xf4240>;
			pe40_dual_charger_chg1_current = <0x1e8480>;
			pe40_dual_charger_chg2_current = <0x1e8480>;
			pe40_dual_charger_input_current = <0x2dc6c0>;
			pe40_r_cable_1a_lower = <0x206>;
			pe40_r_cable_2a_lower = <0x17f>;
			pe40_r_cable_3a_lower = <0xf5>;
			pe40_single_charger_current = <0x2dc6c0>;
			pe40_single_charger_input_current = <0x2dc6c0>;
			pe40_stop_battery_soc = <0x50>;
			pe_ichg_level_threshold = <0xf4240>;
			power_path_support;
			r_bat_comp = <0x1e>;
			slave_mivr_diff = <0x186a0>;
			ta_9v_support;
			ta_ac_12v_input_current = <0x30d400>;
			ta_ac_7v_input_current = <0x1e8480>;
			ta_ac_9v_input_current = <0x200b20>;
			ta_ac_charger_current = <0x2dc6c0>;
			ta_start_battery_soc = <0x0>;
			ta_stop_battery_soc = <0x5a>;
			temp_neg_10_thres = <0x2>;
			temp_t0_thres = <0x1>;
			temp_t0_thres_plus_x_degree = <0x1>;
			temp_t1_thres = <0x1>;
			temp_t1_thres_plus_x_degree = <0x1>;
			temp_t2_thres = <0xf>;
			temp_t2_thres_plus_x_degree = <0x10>;
			temp_t3_thres = <0x2d>;
			temp_t3_thres_minus_x_degree = <0x2c>;
			temp_t4_thres = <0x37>;
			temp_t4_thres_minus_x_degree = <0x33>;
			usb_charger_current = <0x7a120>;
			usb_charger_current_configured = <0x7a120>;
			usb_charger_current_suspend = <0x0>;
			usb_charger_current_unconfigured = <0x11170>;
			v_comp_max = <0x9c40>;
			vbat_cable_imp_threshold = <0x3b8260>;
			vsys_watt = <0x4c4b40>;
		};
	};

	fragment@3 {
		target = <0xffffffff>;

		__overlay__ {

			camera_af_hw_node {
				camaf_m1_pmic-supply = <0xffffffff>;
				compatible = "mediatek,camera_af_lens";
				phandle = <0x4e>;
			};

			fingerprint {
				compatible = "tran_fp";
				debounce = <0x7 0x0>;
				interrupt-parent = <0xffffffff>;
				interrupts = <0x7 0x1 0x7 0x0>;
				phandle = <0x58>;
				pinctrl-0 = <0x4>;
				pinctrl-1 = <0x5>;
				pinctrl-2 = <0x6>;
				pinctrl-3 = <0x7>;
				pinctrl-4 = <0x8>;
				pinctrl-names = "tran_fp_default", "tran_fp_pin_irq", "tran_fp_irq_pull_down", "tran_fp_reset_high", "tran_fp_reset_low";
				status = "okay";
			};

			flashlights_ocp81375 {
				compatible = "mediatek,flashlights_ocp81375";
				phandle = <0x4d>;
				pinctrl-0 = <0x1>;
				pinctrl-1 = <0x2>;
				pinctrl-2 = <0x3>;
				pinctrl-names = "ocp81375default", "ocp81375hwen_high", "ocp81375hwen_low";
				status = "okay";
			};

			led@0 {
				compatible = "mediatek,red";
				data = <0x1>;
				led_mode = <0x0>;
				phandle = <0x4f>;
				pwm_config = <0x0 0x0 0x0 0x0 0x0>;
			};

			led@1 {
				compatible = "mediatek,green";
				data = <0x1>;
				led_mode = <0x0>;
				phandle = <0x50>;
				pwm_config = <0x0 0x0 0x0 0x0 0x0>;
			};

			led@2 {
				compatible = "mediatek,blue";
				data = <0x2>;
				led_mode = <0x3>;
				phandle = <0x51>;
				pwm_config = <0x0 0x0 0x0 0x0 0x0>;
			};

			led@3 {
				compatible = "mediatek,jogball-backlight";
				data = <0x1>;
				led_mode = <0x0>;
				phandle = <0x52>;
				pwm_config = <0x0 0x0 0x0 0x0 0x0>;
			};

			led@4 {
				compatible = "mediatek,keyboard-backlight";
				data = <0x1>;
				led_mode = <0x0>;
				phandle = <0x53>;
				pwm_config = <0x0 0x0 0x0 0x0 0x0>;
			};

			led@5 {
				compatible = "mediatek,button-backlight";
				data = <0x1>;
				led_mode = <0x0>;
				phandle = <0x54>;
				pwm_config = <0x0 0x0 0x0 0x0 0x0>;
			};

			led@6 {
				compatible = "mediatek,lcd-backlight";
				data = <0x1>;
				led_mode = <0x5>;
				phandle = <0x55>;
				pwm_config = <0x1 0x0 0x0 0x0 0x0>;
			};

			tran_audio {
				compatible = "tran_audio,audio";
				fs_extamp_gpio = <0xffffffff 0x97 0x0>;
				fs_extamp_mode = <0x6>;
				fs_extamp_speech_mode = <0x6>;
				fs_receiver_mode = <0x3>;
				phandle = <0x57>;
			};

			vibrator@0 {
				compatible = "mediatek,vibrator";
				phandle = <0x56>;
				vib_limit = <0x9>;
				vib_timer = <0x19>;
				vib_vol = <0xb>;
			};
		};
	};

	fragment@30 {
		target = <0xffffffff>;

		__overlay__ {
			ac_charger_current = <0x16e360>;
			ac_charger_input_current = <0x16e360>;
			charging_host_charger_current = <0x16e360>;
			compatible = "mediatek,lk_charger";
			cur_threshold = <0x7a120>;
			enable_anime;
			enable_pd20_reset;
			enable_pe_plus;
			fast_charge_voltage = <0x2625a0>;
			max_charger_voltage = <0x632ea0>;
			non_std_ac_charger_current = <0x7a120>;
			pd_charger_current = <0x7a120>;
			power_path_support;
			ta_ac_charger_current = <0x2dc6c0>;
			temp_t1_threshold = <0x0>;
			temp_t2_threshold = <0xf>;
			temp_t3_threshold = <0x2d>;
			temp_t4_threshold = <0x32>;
			usb_charger_current = <0x7a120>;
		};
	};

	fragment@31 {
		target = <0xffffffff>;

		__overlay__ {

			adc_channel@ {
				compatible = "mediatek,adc_channel";
				mediatek,adc_fdd_rf_params_dynamic_custom_ch = <0x2>;
				mediatek,temperature0 = <0x0>;
				mediatek,temperature1 = <0x1>;
				status = "okay";
			};
		};
	};

	fragment@32 {
		target = <0xffffffff>;

		__overlay__ {
			io-channels = <0xffffffff 0x2>;
		};
	};

	fragment@33 {
		target = <0xffffffff>;

		__overlay__ {
			mediatek,clkbuf-config = <0x2 0x1 0x1 0x2 0x0 0x0 0x0>;
			mediatek,clkbuf-driving-current = <0x1 0x1 0x1 0x1 0x1 0x1 0x1>;
			mediatek,clkbuf-quantity = <0x7>;
			status = "okay";
		};
	};

	fragment@34 {
		target = <0xffffffff>;

		__overlay__ {
			#address-cells = <0x1>;
			#size-cells = <0x0>;
			clock-frequency = <0x61a80>;
			mediatek,use-open-drain;
		};
	};

	fragment@35 {
		target = <0xffffffff>;

		__overlay__ {
			#address-cells = <0x1>;
			#size-cells = <0x0>;
			clock-frequency = <0x61a80>;
			mediatek,use-open-drain;
		};
	};

	fragment@36 {
		target = <0xffffffff>;

		__overlay__ {
			#address-cells = <0x1>;
			#size-cells = <0x0>;
			clock-frequency = <0x61a80>;
			mediatek,use-open-drain;

			ccu_sensor_i2c_2_hw@11 {
				compatible = "mediatek,ccu_sensor_i2c_2_hw";
				phandle = <0x5f>;
				reg = <0x11>;
				status = "okay";
			};
		};
	};

	fragment@37 {
		target = <0xffffffff>;

		__overlay__ {
			#address-cells = <0x1>;
			#size-cells = <0x0>;
			clock-frequency = <0x61a80>;
			mediatek,use-open-drain;

			camera_main_two@10 {
				compatible = "mediatek,camera_main_two";
				phandle = <0x60>;
				reg = <0x10>;
				status = "okay";
			};

			camera_sub@2d {
				compatible = "mediatek,camera_sub";
				phandle = <0x61>;
				reg = <0x2d>;
				status = "okay";
			};

			camera_sub_eeprom@51 {
				compatible = "mediatek,camera_sub_eeprom";
				phandle = <0x62>;
				reg = <0x51>;
				status = "okay";
			};
		};
	};

	fragment@38 {
		target = <0xffffffff>;

		__overlay__ {
			#address-cells = <0x1>;
			#size-cells = <0x0>;
			clock-frequency = <0x61a80>;
			mediatek,use-open-drain;

			camera_main@1a {
				compatible = "mediatek,camera_main";
				phandle = <0x63>;
				reg = <0x1a>;
				status = "okay";
			};

			camera_main_af@0c {
				compatible = "mediatek,camera_main_af";
				phandle = <0x65>;
				reg = <0xc>;
				status = "okay";
			};

			camera_main_eeprom@50 {
				compatible = "mediatek,camera_main_eeprom";
				phandle = <0x64>;
				reg = <0x50>;
				status = "okay";
			};

			ccu_sensor_i2c_4_hw@12 {
				compatible = "mediatek,ccu_sensor_i2c_4_hw";
				phandle = <0x66>;
				reg = <0x12>;
				status = "okay";
			};
		};
	};

	fragment@39 {
		target = <0xffffffff>;

		__overlay__ {
			#address-cells = <0x1>;
			#size-cells = <0x0>;
			clock-frequency = <0x61a80>;
			mediatek,use-open-drain;

			subpmic_pmu@34 {
				compatible = "mediatek,subpmic_pmu";
				phandle = <0x67>;
				reg = <0x34>;
				status = "okay";
			};

			usb_type_c@4e {
				compatible = "mediatek,usb_type_c";
				phandle = <0x68>;
				reg = <0x4e>;
				status = "okay";
			};
		};
	};

	fragment@4 {
		target = <0xffffffff>;

		__overlay__ {

			fingerprint@0 {
				compatible = "tran_fp";
				debounce = <0x7 0x0>;
				interrupt-parent = <0xffffffff>;
				interrupts = <0x7 0x1 0x7 0x0>;
				irq-gpio = <0x7>;
				irq-gpio-std = <0xffffffff 0x7 0x0>;
				pinctrl-0 = <0x4>;
				pinctrl-1 = <0x5>;
				pinctrl-2 = <0x6>;
				pinctrl-3 = <0x7>;
				pinctrl-4 = <0x8>;
				pinctrl-names = "tran_fp_default", "tran_fp_pin_irq", "tran_fp_irq_pull_down", "tran_fp_reset_high", "tran_fp_reset_low";
				reg = <0x0>;
				reset-gpio = <0x6>;
				reset-gpio-std = <0xffffffff 0x6 0x0>;
				spi-max-frequency = <0x19bfcc0>;
				status = "okay";
			};
		};
	};

	fragment@40 {
		target = <0xffffffff>;

		__overlay__ {
			#address-cells = <0x1>;
			#size-cells = <0x0>;
			clock-frequency = <0x61a80>;
			mediatek,use-open-drain;

			i2c_lcd_bias@3e {
				compatible = "mediatek,i2c_lcd_bias";
				phandle = <0x69>;
				reg = <0x3e>;
				status = "okay";
			};

			strobe_main@63 {
				compatible = "mediatek,strobe_main";
				phandle = <0x6a>;
				reg = <0x63>;
				status = "okay";
			};
		};
	};

	fragment@41 {
		target = <0xffffffff>;

		__overlay__ {
			#address-cells = <0x1>;
			#size-cells = <0x0>;
			clock-frequency = <0x61a80>;
			mediatek,use-open-drain;

			nfc@28 {
				compatible = "mediatek,nfc";
				phandle = <0x6b>;
				reg = <0x28>;
				status = "okay";
			};

			slave_charger@4b {
				compatible = "mediatek,slave_charger";
				phandle = <0x6c>;
				reg = <0x4b>;
				status = "okay";
			};
		};
	};

	fragment@42 {
		target = <0xffffffff>;

		__overlay__ {
			#address-cells = <0x1>;
			#size-cells = <0x0>;
			clock-frequency = <0x61a80>;
			mediatek,use-open-drain;
		};
	};

	fragment@43 {
		target = <0xffffffff>;

		__overlay__ {
			GPIO_FDD_BAND_SUPPORT_DETECT_1ST_PIN = <0xffffffff 0x42 0x0>;
			GPIO_FDD_BAND_SUPPORT_DETECT_2ND_PIN = <0xffffffff 0x43 0x0>;
			GPIO_FDD_BAND_SUPPORT_DETECT_3RD_PIN = <0xffffffff 0x44 0x0>;
			GPIO_SIM1_HOT_PLUG = <0xffffffff 0x2f 0x0>;
			GPIO_SIM1_SCLK = <0xffffffff 0xac 0x0>;
			GPIO_SIM1_SIO = <0xffffffff 0xae 0x0>;
			GPIO_SIM1_SRST = <0xffffffff 0xad 0x0>;
			GPIO_SIM2_SCLK = <0xffffffff 0x9d 0x0>;
			GPIO_SIM2_SIO = <0xffffffff 0x9b 0x0>;
			GPIO_SIM2_SRST = <0xffffffff 0x9c 0x0>;
		};
	};

	fragment@44 {
		target = <0xffffffff>;

		__overlay__ {
			gpio_init_default = <0x0 0x0 0x1 0x0 0x1 0x0 0x1 0x1 0x0 0x0 0x0 0x1 0x1 0x1 0x2 0x0 0x0 0x0 0x1 0x0 0x1 0x3 0x0 0x0 0x0 0x1 0x0 0x1 0x4 0x0 0x0 0x0 0x1 0x1 0x1 0x5 0x0 0x0 0x0 0x1 0x1 0x0 0x6 0x0 0x1 0x1 0x1 0x1 0x0 0x7 0x0 0x0 0x0 0x1 0x0 0x0 0x8 0x0 0x0 0x0 0x1 0x1 0x0 0x9 0x0 0x0 0x0 0x1 0x0 0x0 0xa 0x0 0x0 0x0 0x1 0x1 0x0 0xb 0x1 0x0 0x0 0x1 0x0 0x0 0xc 0x2 0x0 0x0 0x1 0x0 0x0 0xd 0x2 0x0 0x0 0x1 0x0 0x0 0xe 0x2 0x1 0x0 0x0 0x0 0x0 0xf 0x2 0x1 0x0 0x0 0x0 0x0 0x10 0x2 0x1 0x0 0x0 0x0 0x0 0x11 0x0 0x0 0x0 0x1 0x0 0x1 0x12 0x0 0x0 0x0 0x1 0x1 0x1 0x13 0x0 0x0 0x0 0x1 0x1 0x1 0x14 0x0 0x0 0x0 0x1 0x1 0x1 0x15 0x2 0x0 0x0 0x0 0x0 0x0 0x16 0x5 0x0 0x0 0x1 0x0 0x0 0x17 0x0 0x1 0x0 0x0 0x0 0x0 0x18 0x5 0x0 0x0 0x1 0x0 0x0 0x19 0x2 0x0 0x0 0x1 0x1 0x0 0x1a 0x2 0x0 0x0 0x1 0x0 0x0 0x1b 0x2 0x1 0x0 0x1 0x1 0x0 0x1c 0x2 0x0 0x0 0x1 0x0 0x0 0x1d 0x0 0x0 0x0 0x1 0x0 0x0 0x1e 0x0 0x1 0x0 0x0 0x0 0x0 0x1f 0x0 0x0 0x0 0x1 0x0 0x0 0x20 0x1 0x0 0x0 0x1 0x0 0x0 0x21 0x1 0x1 0x0 0x1 0x1 0x0 0x22 0x1 0x1 0x0 0x1 0x0 0x0 0x23 0x1 0x1 0x0 0x1 0x0 0x0 0x24 0x2 0x1 0x0 0x0 0x0 0x0 0x25 0x2 0x1 0x0 0x0 0x0 0x0 0x26 0x2 0x1 0x0 0x0 0x0 0x0 0x27 0x0 0x0 0x0 0x1 0x1 0x1 0x28 0x2 0x0 0x0 0x1 0x0 0x0 0x29 0x0 0x0 0x0 0x1 0x1 0x1 0x2a 0x0 0x0 0x0 0x1 0x1 0x1 0x2b 0x1 0x1 0x0 0x1 0x0 0x0 0x2c 0x1 0x0 0x0 0x1 0x0 0x0 0x2d 0x0 0x1 0x0 0x1 0x0 0x0 0x2e 0x0 0x0 0x0 0x1 0x0 0x0 0x2f 0x1 0x0 0x0 0x1 0x1 0x0 0x30 0x1 0x0 0x0 0x1 0x1 0x1 0x31 0x1 0x0 0x0 0x1 0x1 0x1 0x32 0x1 0x0 0x0 0x1 0x1 0x1 0x33 0x1 0x0 0x0 0x1 0x1 0x1 0x34 0x1 0x0 0x0 0x1 0x0 0x0 0x35 0x1 0x0 0x0 0x1 0x0 0x0 0x36 0x1 0x0 0x0 0x1 0x0 0x0 0x37 0x1 0x0 0x0 0x1 0x0 0x0 0x38 0x1 0x0 0x0 0x1 0x0 0x0 0x39 0x1 0x0 0x0 0x1 0x0 0x0 0x3a 0x0 0x0 0x0 0x1 0x0 0x0 0x3b 0x1 0x0 0x0 0x1 0x0 0x0 0x3c 0x1 0x0 0x0 0x1 0x0 0x0 0x3d 0x1 0x0 0x0 0x1 0x0 0x0 0x3e 0x1 0x0 0x0 0x1 0x0 0x0 0x3f 0x1 0x0 0x0 0x1 0x0 0x0 0x40 0x1 0x0 0x0 0x1 0x0 0x0 0x41 0x1 0x0 0x0 0x1 0x0 0x0 0x42 0x0 0x0 0x0 0x1 0x0 0x0 0x43 0x0 0x0 0x0 0x1 0x0 0x0 0x44 0x0 0x0 0x0 0x1 0x0 0x0 0x45 0x1 0x0 0x0 0x1 0x0 0x0 0x46 0x1 0x0 0x0 0x1 0x0 0x0 0x47 0x1 0x0 0x0 0x1 0x0 0x0 0x48 0x1 0x0 0x0 0x1 0x0 0x0 0x49 0x1 0x0 0x0 0x1 0x0 0x0 0x4a 0x1 0x0 0x0 0x1 0x0 0x0 0x4b 0x1 0x0 0x0 0x1 0x0 0x0 0x4c 0x1 0x0 0x0 0x1 0x0 0x0 0x4d 0x1 0x0 0x0 0x1 0x0 0x0 0x4e 0x1 0x0 0x0 0x1 0x0 0x0 0x4f 0x0 0x0 0x0 0x1 0x0 0x0 0x50 0x0 0x0 0x0 0x1 0x0 0x0 0x51 0x2 0x0 0x0 0x1 0x1 0x1 0x52 0x1 0x0 0x0 0x1 0x1 0x1 0x53 0x1 0x0 0x0 0x1 0x1 0x1 0x54 0x2 0x0 0x0 0x1 0x1 0x1 0x55 0x2 0x0 0x0 0x1 0x0 0x0 0x56 0x2 0x1 0x0 0x0 0x0 0x0 0x57 0x2 0x1 0x0 0x0 0x0 0x0 0x58 0x2 0x1 0x0 0x0 0x0 0x0 0x59 0x1 0x0 0x0 0x1 0x1 0x1 0x5a 0x1 0x0 0x0 0x1 0x1 0x1 0x5b 0x0 0x1 0x0 0x0 0x0 0x0 0x5c 0x1 0x1 0x0 0x0 0x0 0x0 0x5d 0x1 0x0 0x0 0x1 0x1 0x0 0x5e 0x1 0x0 0x0 0x1 0x1 0x0 0x5f 0x1 0x0 0x0 0x1 0x1 0x0 0x60 0x1 0x1 0x0 0x0 0x0 0x0 0x61 0x0 0x1 0x0 0x0 0x0 0x0 0x62 0x0 0x1 0x0 0x0 0x0 0x0 0x63 0x1 0x1 0x0 0x0 0x0 0x0 0x64 0x1 0x1 0x0 0x0 0x0 0x0 0x65 0x0 0x1 0x0 0x0 0x0 0x0 0x66 0x0 0x1 0x0 0x0 0x0 0x0 0x67 0x1 0x0 0x0 0x1 0x1 0x1 0x68 0x1 0x0 0x0 0x1 0x1 0x1 0x69 0x1 0x0 0x0 0x1 0x1 0x1 0x6a 0x1 0x0 0x0 0x1 0x1 0x1 0x6b 0x0 0x1 0x0 0x0 0x0 0x0 0x6c 0x1 0x1 0x0 0x0 0x0 0x0 0x6d 0x0 0x1 0x0 0x0 0x0 0x0 0x6e 0x0 0x1 0x0 0x0 0x0 0x0 0x6f 0x1 0x1 0x0 0x0 0x0 0x0 0x70 0x0 0x0 0x0 0x0 0x0 0x0 0x71 0x0 0x0 0x0 0x1 0x0 0x0 0x72 0x0 0x0 0x0 0x1 0x0 0x0 0x73 0x0 0x0 0x0 0x1 0x0 0x0 0x74 0x0 0x0 0x0 0x1 0x0 0x0 0x75 0x0 0x0 0x0 0x1 0x0 0x0 0x76 0x0 0x0 0x0 0x1 0x0 0x0 0x77 0x0 0x0 0x0 0x1 0x0 0x0 0x78 0x0 0x0 0x0 0x1 0x0 0x0 0x79 0x0 0x0 0x0 0x1 0x0 0x0 0x86 0x1 0x0 0x0 0x1 0x0 0x1 0x87 0x1 0x1 0x0 0x0 0x0 0x0 0x88 0x1 0x1 0x0 0x0 0x0 0x0 0x89 0x1 0x1 0x0 0x0 0x0 0x0 0x8a 0x1 0x1 0x0 0x0 0x0 0x0 0x8b 0x1 0x1 0x0 0x0 0x0 0x0 0x8c 0x1 0x0 0x0 0x1 0x0 0x0 0x8d 0x1 0x0 0x0 0x1 0x0 0x0 0x8e 0x1 0x0 0x0 0x1 0x0 0x0 0x8f 0x1 0x0 0x0 0x1 0x0 0x0 0x90 0x1 0x0 0x0 0x1 0x0 0x0 0x91 0x1 0x1 0x0 0x0 0x0 0x0 0x92 0x1 0x1 0x0 0x0 0x0 0x0 0x93 0x1 0x1 0x0 0x0 0x0 0x0 0x94 0x1 0x1 0x0 0x0 0x0 0x0 0x95 0x1 0x1 0x0 0x0 0x0 0x0 0x96 0x0 0x1 0x0 0x0 0x0 0x0 0x97 0x0 0x1 0x0 0x1 0x0 0x0 0x98 0x0 0x1 0x0 0x1 0x0 0x0 0x99 0x0 0x1 0x0 0x1 0x0 0x0 0x9a 0x1 0x1 0x0 0x0 0x0 0x0 0x9b 0x1 0x0 0x0 0x1 0x1 0x0 0x9c 0x1 0x1 0x0 0x0 0x0 0x0 0x9d 0x1 0x1 0x0 0x0 0x0 0x0 0x9e 0x0 0x1 0x0 0x0 0x0 0x0 0x9f 0x0 0x1 0x0 0x0 0x0 0x0 0xa0 0x0 0x1 0x0 0x0 0x0 0x0 0xa1 0x1 0x0 0x0 0x1 0x1 0x1 0xa2 0x1 0x0 0x0 0x1 0x1 0x1 0xa3 0x1 0x0 0x0 0x1 0x1 0x1 0xa4 0x1 0x0 0x0 0x1 0x1 0x1 0xa5 0x0 0x1 0x0 0x0 0x0 0x0 0xa6 0x0 0x1 0x0 0x0 0x0 0x0 0xa7 0x1 0x0 0x0 0x1 0x0 0x0 0xa8 0x1 0x0 0x0 0x1 0x0 0x0 0xa9 0x4 0x1 0x0 0x0 0x0 0x0 0xaa 0x1 0x0 0x0 0x1 0x1 0x1 0xab 0x1 0x1 0x0 0x0 0x0 0x1 0xac 0x1 0x1 0x0 0x0 0x0 0x0 0xad 0x1 0x1 0x0 0x0 0x0 0x0 0xae 0x1 0x0 0x0 0x1 0x1 0x0 0xaf 0x1 0x0 0x0 0x1 0x1 0x1 0xb0 0x1 0x0 0x0 0x1 0x1 0x1 0xb2 0x0 0x1 0x0 0x0 0x0 0x0 0xb3 0x0 0x1 0x0 0x0 0x0 0x0 0xb4 0x0 0x0 0x0 0x1 0x0 0x0 0xb5 0x0 0x0 0x0 0x1 0x0 0x0 0xb6 0x0 0x0 0x0 0x1 0x0 0x0 0xb7 0x0 0x0 0x0 0x1 0x0 0x0 0xb8 0x0 0x0 0x0 0x1 0x0 0x0 0xb9 0x0 0x0 0x0 0x1 0x0 0x0 0xba 0x0 0x0 0x0 0x1 0x0 0x0>;
		};
	};

	fragment@45 {
		target = <0xffffffff>;

		__overlay__ {
			interrupt-parent = <0xffffffff>;
			interrupts = <0x1 0x2 0x1 0x0>;
			status = "okay";
		};
	};

	fragment@46 {
		target = <0xffffffff>;

		__overlay__ {
			deb-gpios = <0xffffffff 0x4 0x0>;
			debounce = <0x186a0>;
			interrupt-parent = <0xffffffff>;
			interrupts = <0x4 0x4 0x4 0x0>;
			status = "okay";
		};
	};

	fragment@47 {
		target = <0xffffffff>;

		__overlay__ {
			interrupt-parent = <0xffffffff>;
			interrupts = <0x9 0x1 0x9 0x0>;
			status = "okay";
		};
	};

	fragment@48 {
		target = <0xffffffff>;

		__overlay__ {
			interrupt-parent = <0xffffffff>;
			interrupts = <0x14 0x2 0x14 0x0>;
			status = "okay";
		};
	};

	fragment@49 {
		target = <0xffffffff>;

		__overlay__ {
			interrupt-parent = <0xffffffff>;
			interrupts = <0x2a 0x2 0x2a 0x0>;
			status = "okay";
		};
	};

	fragment@5 {
		target = <0xffffffff>;

		__overlay__ {

			fingerprint_default {
				phandle = <0x4>;
			};

			gpio7_eint {
				phandle = <0x5>;

				pins_cmd_dat {
					bias-disable;
					pinmux = <0x700>;
					slew-rate = <0x0>;
				};
			};

			gpio7_eint_pull_down {
				phandle = <0x6>;

				pins_cmd_dat {
					bias-pull-down = <0x0>;
					output-low;
					pinmux = <0x700>;
					slew-rate = <0x0>;
				};
			};

			rst_out_one {
				phandle = <0x7>;

				pins_cmd_dat {
					bias-disable;
					output-high;
					pinmux = <0x600>;
					slew-rate = <0x1>;
				};
			};

			rst_out_zero {
				phandle = <0x8>;

				pins_cmd_dat {
					bias-disable;
					output-low;
					pinmux = <0x600>;
					slew-rate = <0x1>;
				};
			};
		};
	};

	fragment@50 {
		target = <0xffffffff>;

		__overlay__ {
			interrupt-parent = <0xffffffff>;
			interrupts = <0x2c 0x1 0x2c 0x1>;
			status = "okay";
		};
	};

	fragment@51 {
		target = <0xffffffff>;

		__overlay__ {
			interrupt-parent = <0xffffffff>;
			interrupts = <0x90 0x4 0xb4 0x0>;
			status = "okay";
		};
	};

	fragment@52 {
		target = <0xffffffff>;

		__overlay__ {
			compatible = "mediatek,md1_sim1_hot_plug_eint-eint";
			debounce = <0x0 0x2710>;
			dedicated = <0x0 0x0>;
			interrupts = <0x0 0x8>;
			sockettype = <0x0 0x0>;
			src_pin = <0x0 0x1>;
			status = "okay";
		};
	};

	fragment@53 {
		target = <0xffffffff>;

		__overlay__ {
			regulator-default-on = <0x1>;
			regulator-name = "vcama1";
			status = "okay";
		};
	};

	fragment@54 {
		target = <0xffffffff>;

		__overlay__ {
			regulator-default-on = <0x1>;
			regulator-name = "vcama2";
			status = "okay";
		};
	};

	fragment@55 {
		target = <0xffffffff>;

		__overlay__ {
			regulator-default-on = <0x1>;
			regulator-name = "vsim1";
			status = "okay";
		};
	};

	fragment@56 {
		target = <0xffffffff>;

		__overlay__ {
			regulator-default-on = <0x1>;
			regulator-name = "vsim2";
			status = "okay";
		};
	};

	fragment@57 {
		target = <0xffffffff>;

		__overlay__ {
			regulator-default-on = <0x1>;
			regulator-name = "vcamd";
			status = "okay";
		};
	};

	fragment@58 {
		target = <0xffffffff>;

		__overlay__ {
			regulator-default-on = <0x1>;
			regulator-name = "vcamio";
			status = "okay";
		};
	};

	fragment@59 {
		target = <0xffffffff>;

		__overlay__ {
			regulator-default-on = <0x1>;
			regulator-name = "vldo28";
			status = "okay";
		};
	};

	fragment@6 {
		target = <0xffffffff>;

		__overlay__ {
			cam0_enable_sensor = "s5kjn1_mipi_raw";
			cam1_enable_sensor = "s5kgd2sp_mipi_raw";
			cam2_enable_sensor = "gc02m1_mipi_raw";
			cam3_enable_sensor = "fake_serial_yuv";
			camera_input_gpio = <0xffffffff 0x15 0x0>;
			pmic = <0xffffffff>;
		};
	};

	fragment@60 {
		target = <0xffffffff>;

		__overlay__ {
			status = "okay";
			vcama_main2-supply = <0xffffffff>;
			vcama_sub2-supply = <0xffffffff>;
			vcamaf-supply = <0xffffffff>;
			vcamd-supply = <0xffffffff>;
			vcamd_sub-supply = <0xffffffff>;
			vcamio-supply = <0xffffffff>;
			vcamio_main2-supply = <0xffffffff>;
			vcamio_sub-supply = <0xffffffff>;
		};
	};

	fragment@61 {
		target = <0xffffffff>;

		__overlay__ {
			status = "okay";
			vtouch-supply = <0xffffffff>;
		};
	};

	fragment@62 {
		target = <0xffffffff>;

		__overlay__ {
			mediatek,kpd-hw-dl-key0 = <0x0>;
			mediatek,kpd-hw-dl-key1 = <0x1>;
			mediatek,kpd-hw-dl-key2 = <0x8>;
			mediatek,kpd-hw-factory-key = <0x1>;
			mediatek,kpd-hw-init-map = <0x73 0x72 0x0 0x0 0x0 0x0 0x0 0x0 0x0 0x0 0x0 0x0 0x0 0x0 0x0 0x0 0x0 0x0 0x0 0x0 0x0 0x0 0x0 0x0 0x0 0x0 0x0 0x0 0x0 0x0 0x0 0x0 0x0 0x0 0x0 0x0 0x0 0x0 0x0 0x0 0x0 0x0 0x0 0x0 0x0 0x0 0x0 0x0 0x0 0x0 0x0 0x0 0x0 0x0 0x0 0x0 0x0 0x0 0x0 0x0 0x0 0x0 0x0 0x0 0x0 0x0 0x0 0x0 0x0 0x0 0x0 0x0>;
			mediatek,kpd-hw-map-num = <0x48>;
			mediatek,kpd-hw-pwrkey = <0x8>;
			mediatek,kpd-hw-recovery-key = <0x0>;
			mediatek,kpd-key-debounce = <0x400>;
			mediatek,kpd-pwkey-gpio-din = <0x0>;
			mediatek,kpd-pwrkey-eint-gpio = <0x0>;
			mediatek,kpd-sw-pwrkey = <0x74>;
			mediatek,kpd-use-extend-type = <0x0>;
			status = "okay";
		};
	};

	fragment@63 {
		target = <0xffffffff>;

		__overlay__ {

			camdefault {
				phandle = <0x23>;
			};

			camera0_mclk_2mA@gpio100 {
				phandle = <0x39>;

				pins_cmd_dat {
					drive-strength = <0x2>;
					pinmux = <0x6401>;
				};
			};

			camera0_mclk_4mA@gpio100 {
				phandle = <0x3a>;

				pins_cmd_dat {
					drive-strength = <0x4>;
					pinmux = <0x6401>;
				};
			};

			camera0_mclk_6mA@gpio100 {
				phandle = <0x3b>;

				pins_cmd_dat {
					drive-strength = <0x6>;
					pinmux = <0x6401>;
				};
			};

			camera0_mclk_8mA@gpio100 {
				phandle = <0x3c>;

				pins_cmd_dat {
					drive-strength = <0x7>;
					pinmux = <0x6401>;
				};
			};

			camera0_mclk_gpio_mode@gpio100 {
				phandle = <0x38>;

				pins_cmd_dat {
					drive-strength = <0x4>;
					pinmux = <0x6400>;
				};
			};

			camera0_pdn_output_high@gpio98 {
				phandle = <0x27>;

				pins_cmd_dat {
					output-high;
					pinmux = <0x6200>;
				};
			};

			camera0_pdn_output_low@gpio98 {
				phandle = <0x26>;

				pins_cmd_dat {
					output-low;
					pinmux = <0x6200>;
				};
			};

			camera0_rst_output_high@gpio102 {
				phandle = <0x25>;

				pins_cmd_dat {
					output-high;
					pinmux = <0x6600>;
				};
			};

			camera0_rst_output_low@gpio102 {
				phandle = <0x24>;

				pins_cmd_dat {
					output-low;
					pinmux = <0x6600>;
				};
			};

			camera0_vcama_output_high@gpio23 {
				phandle = <0x34>;

				pins_cmd_dat {
					output-high;
					pinmux = <0x1700>;
				};
			};

			camera0_vcama_output_low@gpio23 {
				phandle = <0x35>;

				pins_cmd_dat {
					output-low;
					pinmux = <0x1700>;
				};
			};

			camera1_mclk_2mA@gpio99 {
				phandle = <0x3e>;

				pins_cmd_dat {
					drive-strength = <0x2>;
					pinmux = <0x6301>;
				};
			};

			camera1_mclk_4mA@gpio99 {
				phandle = <0x3f>;

				pins_cmd_dat {
					drive-strength = <0x4>;
					pinmux = <0x6301>;
				};
			};

			camera1_mclk_6mA@gpio99 {
				phandle = <0x40>;

				pins_cmd_dat {
					drive-strength = <0x6>;
					pinmux = <0x6301>;
				};
			};

			camera1_mclk_8mA@gpio99 {
				phandle = <0x41>;

				pins_cmd_dat {
					drive-strength = <0x7>;
					pinmux = <0x6301>;
				};
			};

			camera1_mclk_gpio_mode@gpio99 {
				phandle = <0x3d>;

				pins_cmd_dat {
					drive-strength = <0x4>;
					pinmux = <0x6300>;
				};
			};

			camera1_pdn_output_high@gpio97 {
				phandle = <0x2b>;

				pins_cmd_dat {
					output-high;
					pinmux = <0x6100>;
				};
			};

			camera1_pdn_output_low@gpio97 {
				phandle = <0x2a>;

				pins_cmd_dat {
					output-low;
					pinmux = <0x6100>;
					slew-rate = <0x1>;
				};
			};

			camera1_rst_output_high@gpio101 {
				phandle = <0x29>;

				pins_cmd_dat {
					output-high;
					pinmux = <0x6500>;
				};
			};

			camera1_rst_output_low@gpio101 {
				phandle = <0x28>;

				pins_cmd_dat {
					output-low;
					pinmux = <0x6500>;
				};
			};

			camera1_vcama_output_high@gpio23 {
				phandle = <0x36>;

				pins_cmd_dat {
					output-high;
					pinmux = <0x1700>;
				};
			};

			camera1_vcama_output_low@gpio23 {
				phandle = <0x37>;

				pins_cmd_dat {
					output-low;
					pinmux = <0x1700>;
				};
			};

			camera2_mclk_2mA@gpio111 {
				phandle = <0x43>;

				pins_cmd_dat {
					drive-strength = <0x2>;
					pinmux = <0x6f01>;
				};
			};

			camera2_mclk_4mA@gpio111 {
				phandle = <0x44>;

				pins_cmd_dat {
					drive-strength = <0x4>;
					pinmux = <0x6f01>;
				};
			};

			camera2_mclk_6mA@gpio111 {
				phandle = <0x45>;

				pins_cmd_dat {
					drive-strength = <0x6>;
					pinmux = <0x6f01>;
				};
			};

			camera2_mclk_8mA@gpio111 {
				phandle = <0x46>;

				pins_cmd_dat {
					drive-strength = <0x7>;
					pinmux = <0x6f01>;
				};
			};

			camera2_mclk_gpio_mode@gpio111 {
				phandle = <0x42>;

				pins_cmd_dat {
					drive-strength = <0x4>;
					pinmux = <0x6f00>;
				};
			};

			camera2_pdn_output_high@gpio110 {
				phandle = <0x2f>;

				pins_cmd_dat {
					output-high;
					pinmux = <0x6e00>;
				};
			};

			camera2_pdn_output_low@gpio110 {
				phandle = <0x2e>;

				pins_cmd_dat {
					output-low;
					pinmux = <0x6e00>;
				};
			};

			camera2_rst_output_high@gpio112 {
				phandle = <0x2d>;

				pins_cmd_dat {
					output-high;
					pinmux = <0x7000>;
				};
			};

			camera2_rst_output_low@gpio112 {
				phandle = <0x2c>;

				pins_cmd_dat {
					output-low;
					pinmux = <0x7000>;
				};
			};

			camera3_mclk_2mA@gpio108 {
				phandle = <0x48>;

				pins_cmd_dat {
					drive-strength = <0x2>;
					pinmux = <0x6c01>;
				};
			};

			camera3_mclk_4mA@gpio108 {
				phandle = <0x49>;

				pins_cmd_dat {
					drive-strength = <0x4>;
					pinmux = <0x6c01>;
				};
			};

			camera3_mclk_6mA@gpio108 {
				phandle = <0x4a>;

				pins_cmd_dat {
					drive-strength = <0x6>;
					pinmux = <0x6c01>;
				};
			};

			camera3_mclk_8mA@gpio108 {
				phandle = <0x4b>;

				pins_cmd_dat {
					drive-strength = <0x7>;
					pinmux = <0x6c01>;
				};
			};

			camera3_mclk_gpio_mode@gpio108 {
				phandle = <0x47>;

				pins_cmd_dat {
					drive-strength = <0x4>;
					pinmux = <0x6c00>;
				};
			};

			camera3_pdn_output_high@gpio107 {
				phandle = <0x31>;

				pins_cmd_dat {
					output-high;
					pinmux = <0x6b00>;
				};
			};

			camera3_pdn_output_low@gpio107 {
				phandle = <0x30>;

				pins_cmd_dat {
					output-low;
					pinmux = <0x6b00>;
				};
			};

			camera3_rst_output_high@gpio107 {
				phandle = <0x33>;

				pins_cmd_dat {
					output-high;
					pinmux = <0x6b00>;
				};
			};

			camera3_rst_output_low@gpio107 {
				phandle = <0x32>;

				pins_cmd_dat {
					output-low;
					pinmux = <0x6b00>;
				};
			};
		};
	};

	fragment@64 {
		target = <0xffffffff>;

		__overlay__ {
			cam0_vcamaf-supply = <0xffffffff>;
			cam0_vcamd-supply = <0xffffffff>;
			cam0_vcamio-supply = <0xffffffff>;
			cam1_vcamd-supply = <0xffffffff>;
			cam1_vcamio-supply = <0xffffffff>;
			cam2_vcama-supply = <0xffffffff>;
			cam2_vcamio-supply = <0xffffffff>;
			cam3_vcama-supply = <0xffffffff>;
			pinctrl-0 = <0x23>;
			pinctrl-1 = <0x24>;
			pinctrl-10 = <0x2d>;
			pinctrl-11 = <0x2e>;
			pinctrl-12 = <0x2f>;
			pinctrl-13 = <0x30>;
			pinctrl-14 = <0x31>;
			pinctrl-15 = <0x32>;
			pinctrl-16 = <0x33>;
			pinctrl-17 = <0x34>;
			pinctrl-18 = <0x35>;
			pinctrl-19 = <0x36>;
			pinctrl-2 = <0x25>;
			pinctrl-20 = <0x37>;
			pinctrl-21 = <0x38>;
			pinctrl-22 = <0x39>;
			pinctrl-23 = <0x3a>;
			pinctrl-24 = <0x3b>;
			pinctrl-25 = <0x3c>;
			pinctrl-26 = <0x3d>;
			pinctrl-27 = <0x3e>;
			pinctrl-28 = <0x3f>;
			pinctrl-29 = <0x40>;
			pinctrl-3 = <0x26>;
			pinctrl-30 = <0x41>;
			pinctrl-31 = <0x42>;
			pinctrl-32 = <0x43>;
			pinctrl-33 = <0x44>;
			pinctrl-34 = <0x45>;
			pinctrl-35 = <0x46>;
			pinctrl-36 = <0x47>;
			pinctrl-37 = <0x48>;
			pinctrl-38 = <0x49>;
			pinctrl-39 = <0x4a>;
			pinctrl-4 = <0x27>;
			pinctrl-40 = <0x4b>;
			pinctrl-5 = <0x28>;
			pinctrl-6 = <0x29>;
			pinctrl-7 = <0x2a>;
			pinctrl-8 = <0x2b>;
			pinctrl-9 = <0x2c>;
			pinctrl-names = "default", "cam0_rst0", "cam0_rst1", "cam0_pnd0", "cam0_pnd1", "cam1_rst0", "cam1_rst1", "cam1_pnd0", "cam1_pnd1", "cam2_rst0", "cam2_rst1", "cam2_pnd0", "cam2_pnd1", "cam3_pnd0", "cam3_pnd1", "cam3_rst0", "cam3_rst1", "cam0_vcama_on", "cam0_vcama_off", "cam1_vcama_on", "cam1_vcama_off", "cam0_mclk_off", "cam0_mclk_2mA", "cam0_mclk_4mA", "cam0_mclk_6mA", "cam0_mclk_8mA", "cam1_mclk_off", "cam1_mclk_2mA", "cam1_mclk_4mA", "cam1_mclk_6mA", "cam1_mclk_8mA", "cam2_mclk_off", "cam2_mclk_2mA", "cam2_mclk_4mA", "cam2_mclk_6mA", "cam2_mclk_8mA", "cam3_mclk_off", "cam3_mclk_2mA", "cam3_mclk_4mA", "cam3_mclk_6mA", "cam3_mclk_8mA";
			status = "okay";
		};
	};

	fragment@65 {
		target = <0xffffffff>;

		__overlay__ {

			ocp81375default {
				phandle = <0x1>;
			};

			ocp81375hwen_high {
				phandle = <0x2>;

				pins_cmd_dat {
					output-high;
					pinmux = <0xa900>;
					slew-rate = <0x1>;
				};
			};

			ocp81375hwen_low {
				phandle = <0x3>;

				pins_cmd_dat {
					output-low;
					pinmux = <0xa900>;
					slew-rate = <0x1>;
				};
			};
		};
	};

	fragment@7 {
		target = <0xffffffff>;

		__overlay__ {
			cam0_enable_sensor = "s5kjn1_mipi_raw";
			cam1_enable_sensor = "s5kgd2sp_mipi_raw";
			cam2_enable_sensor = "gc02m1_mipi_raw";
			cam3_enable_sensor = "fake_serial_yuv";
			camera_input_gpio = <0xffffffff 0x15 0x0>;
			pmic = <0xffffffff>;
		};
	};

	fragment@8 {
		target = <0xffffffff>;

		__overlay__ {
			clock-frequency = <0x61a80>;

			mtk-usb@60 {
				compatible = "mediatek,mtk-usb";
				reg = <0x60>;
				status = "okay";
			};
		};
	};

	fragment@9 {
		target = <0xffffffff>;

		__overlay__ {
			compatible = "mediatek,touch";
			pinctrl-0 = <0x9>;
			pinctrl-1 = <0xa>;
			pinctrl-2 = <0xb>;
			pinctrl-3 = <0xc>;
			pinctrl-4 = <0xd>;
			pinctrl-5 = <0xe>;
			pinctrl-names = "default", "state_eint_as_int", "state_eint_output0", "state_eint_output1", "state_rst_output0", "state_rst_output1";
			status = "okay";
			tpd-filter-custom-prameters = <0x0 0x0 0x0 0x0 0x0 0x0 0x0 0x0 0x0 0x0 0x0 0x0>;
			tpd-filter-custom-speed = <0x0 0x0 0x0>;
			tpd-filter-enable = <0x0>;
			tpd-filter-pixel-density = <0xa8>;
			tpd-key-dim-local = <0x5a 0x373 0x64 0x28 0xe6 0x373 0x64 0x28 0x172 0x373 0x64 0x28 0x0 0x0 0x0 0x0>;
			tpd-key-local = <0x8b 0xac 0x9e 0x0>;
			tpd-key-num = <0x3>;
			tpd-max-touch-num = <0xa>;
			tpd-resolution = <0x438 0x968>;
			use-tpd-button = <0x0>;
		};
	};
};
